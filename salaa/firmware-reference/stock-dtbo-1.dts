/dts-v1/;

/ {

	fragment@0 {
		target = <0xffffffff>;

		__overlay__ {
		};
	};

	fragment@1 {
		target = <0xffffffff>;

		__overlay__ {
			atag,videolfb-fb_base_l = "~`P";
			atag,videolfb-fb_base_h = <0x00>;
			atag,videolfb-islcmfound = <0x01>;
			atag,videolfb-islcm_inited = <0x00>;
			atag,videolfb-fps = <0x1770>;
			atag,videolfb-vramSize = <0x1be0000>;
			atag,videolfb-lcmname = "nt35595_fhd_dsi_cmd_truly_nt50358_drv";
		};
	};

	fragment@2 {
		target = <0xffffffff>;

		__overlay__ {

			novatek@0 {
				compatible = "novatek,nf_nt36672c";
				reg = <0x00>;
				chip-name = "NT36672C_NF";
				status = "ok";
				spi-max-frequency = <0xe4e1c0>;
				reset-gpio = <0xffffffff 0x02 0x00>;
				interrupt-parent = <0xffffffff>;
				interrupts = <0x01 0x02 0x01 0x00>;
				irq-gpio = <0xffffffff 0x01 0x00>;
				touchpanel,tx-rx-num = <0x10 0x24>;
				touchpanel,max-num-support = <0x0a>;
				touchpanel,panel-coords = <0x438 0x960>;
				touchpanel,display-coords = <0x438 0x960>;
				touchpanel,touchmajor-limit = <0x00 0x36>;
				platform_support_project = <0x50ca>;
				platform_support_project_dir = <0x50ca>;
				platform_support_project_commandline = "nt36672c";
				incell_screen;
				fw_edge_limit_support;
				black_gesture_support;
				charger_pump_support;
				headset_pump_support;
				esd_handle_support;
				black_gesture_test_support;
				noflash_support;
				smart_gesture_support;
				pressure_report_support;
				fw_update_app_support;
				game_switch_support;
				drlimit_remove_support;
				lcd_trigger_load_tp_fw_support;
				fw_update_in_probe_with_headfile;
				touchpanel,button-type = <0x04>;
				spi_fast_read_support;
				irq_need_dev_resume_ok;
			};
		};
	};

	fragment@3 {
		target = <0xffffffff>;

		__overlay__ {
			clock-frequency = <0x61a80>;

			mtk-usb@60 {
				compatible = "mediatek,mtk-usb";
				reg = <0x60>;
				status = "okay";
			};
		};
	};

	fragment@4 {
		target = <0xffffffff>;

		__overlay__ {

			led@0 {
				compatible = "mediatek,red";
				led_mode = <0x00>;
				data = <0x01>;
				pwm_config = <0x00 0x00 0x00 0x00 0x00>;
				phandle = <0x65>;
			};

			led@1 {
				compatible = "mediatek,green";
				led_mode = <0x00>;
				data = <0x01>;
				pwm_config = <0x00 0x00 0x00 0x00 0x00>;
				phandle = <0x66>;
			};

			led@2 {
				compatible = "mediatek,blue";
				led_mode = <0x00>;
				data = <0x01>;
				pwm_config = <0x00 0x00 0x00 0x00 0x00>;
				phandle = <0x67>;
			};

			led@3 {
				compatible = "mediatek,jogball-backlight";
				led_mode = <0x00>;
				data = <0x01>;
				pwm_config = <0x00 0x00 0x00 0x00 0x00>;
				phandle = <0x68>;
			};

			led@4 {
				compatible = "mediatek,keyboard-backlight";
				led_mode = <0x00>;
				data = <0x01>;
				pwm_config = <0x00 0x00 0x00 0x00 0x00>;
				phandle = <0x69>;
			};

			led@5 {
				compatible = "mediatek,button-backlight";
				led_mode = <0x00>;
				data = <0x01>;
				pwm_config = <0x00 0x00 0x00 0x00 0x00>;
				phandle = <0x6a>;
			};

			led@6 {
				compatible = "mediatek,lcd-backlight";
				led_mode = <0x04>;
				data = <0x01>;
				pwm_config = <0x00 0x01 0x00 0x00 0x00>;
				phandle = <0x6b>;
			};

			vibrator@0 {
				compatible = "mediatek,vibrator";
				vib_timer = <0x19>;
				vib_limit = <0x09>;
				vib_vol = <0x0b>;
				phandle = <0x6c>;
			};

			usb_c_pinctrl {
				compatible = "mediatek,usb_c_pinctrl";
				pinctrl-names = "usb_default\0redrv_c1_init\0redrv_c1_low\0redrv_c1_hiz\0redrv_c1_high\0redrv_c2_init\0redrv_c2_low\0redrv_c2_hiz\0redrv_c2_high\0switch_sel1\0switch_sel2\0switch_enable\0switch_disable";
				pinctrl-0 = <0x01>;
				pinctrl-1 = <0x02>;
				pinctrl-2 = <0x03>;
				pinctrl-3 = <0x04>;
				pinctrl-4 = <0x05>;
				pinctrl-5 = <0x06>;
				pinctrl-6 = <0x07>;
				pinctrl-7 = <0x08>;
				pinctrl-8 = <0x09>;
				pinctrl-9 = <0x0a>;
				pinctrl-10 = <0x0b>;
				pinctrl-11 = <0x0c>;
				pinctrl-12 = <0x0d>;
				status = "okay";
				phandle = <0x6d>;

				usb_switch-data {
					en_pin_num = <0x00>;
					en_pin_val = <0x00>;
					sel_pin_num = <0x20>;
					sel_pin_val = <0x01>;
					c1_pin_num = <0x1f>;
					c1_pin_val = <0x02>;
					c2_pin_num = <0x1e>;
					c2_pin_val = <0x01>;
				};
			};

			kpd_volume_down {
				compatible = "mediatek, VOLUME_DOWN-eint";
				interrupt-parent = <0xffffffff>;
				interrupts = <0x3c 0x02 0x3c 0x00>;
				debounce = <0x7d00>;
				status = "okay";
				phandle = <0x6e>;
			};

			oplus_sim_detect {
				compatible = "oplus, sim_detect";
				Hw,sim_det = <0xffffffff 0x8c 0x00>;
			};

			gsensor_1 {
				status = "okay";
				sensor_name = <0x02>;
				i2c_num = <0x02>;
				i2c_addr = <0x44>;
				direction = <0x03>;
				eint_num = <0x0a>;
				step_count_7_en = <0x01>;
				config_miso = <0x01>;
				correct_y_bias = <0x01>;
				phandle = <0x6f>;
			};

			gsensor_2 {
				status = "okay";
				sensor_name = <0x04>;
				i2c_num = <0x02>;
				i2c_addr = <0x00>;
				direction = <0x00>;
				eint_num = <0x0a>;
				step_count_7_en = <0x01>;
				config_miso = <0x01>;
				correct_y_bias = <0x01>;
				phandle = <0x70>;
			};

			msensor_1 {
				status = "okay";
				sensor_name = <0x02>;
				i2c_num = <0x00>;
				i2c_addr = <0x30>;
				direction = <0x00>;
				eint_num = <0x00>;
				phandle = <0x71>;
			};

			msensor_2 {
				status = "okay";
				sensor_name = <0x04>;
				i2c_num = <0x00>;
				i2c_addr = <0x0c>;
				direction = <0x02>;
				eint_num = <0x00>;
				phandle = <0x72>;
			};

			proximity_1 {
				status = "okay";
				sensor_name = <0x07>;
				i2c_num = <0x00>;
				i2c_addr = <0x46>;
				direction = <0x04>;
				eint_num = <0x0c>;
				low_step = <0x64>;
				high_step = <0x96>;
				low_limit = <0x96>;
				high_limit = <0xfa>;
				dirty_low_step = <0x64>;
				dirty_high_step = <0x96>;
				ps_dirty_limit = <0x3ff>;
				ps_ir_limit = <0x1f4>;
				ps_adjust_min = <0x00>;
				ps_adjust_max = <0x258>;
				sampling_count = <0x05>;
				step_max = <0x190>;
				step_min = <0x64>;
				step_div = <0x5dc>;
				anti_shake_delta = <0x50>;
				dynamic_cali_max = <0x7d0>;
				raw2offset_radio = <0x3e8>;
				offset_max = <0xea60>;
				offset_range_min = <0x00>;
				offset_range_max = <0xfffe>;
				force_cali_limit = <0x7d0>;
				cali_jitter_limit = <0x1e>;
				cal_offset_margin = <0xbb8>;
				sensor-reg = <0x02 0x31>;
				phandle = <0x73>;
			};

			light_1 {
				status = "okay";
				sensor_name = <0x07>;
				i2c_num = <0x00>;
				i2c_addr = <0x46>;
				direction = <0x04>;
				eint_num = <0x0c>;
				als_ratio = <0xa9>;
				als_buffer_length = <0x08>;
				als_type = <0x01>;
				coefficient_mode = <0x01>;
				device_name = "stk33502";
				phandle = <0x74>;
			};

			pick_up {
				status = "okay";
				use-proximity = <0x01>;
				phandle = <0x75>;
			};

			lux_aod {
				status = "okay";
				use-proximity = <0x01>;
				phandle = <0x76>;
			};

			mtk_cali {
				status = "okay";
				mtk-cali-supported = <0x01>;
				phandle = <0x77>;
			};

			alsps_arch {
				status = "okay";
				new-arch-supported = <0x01>;
				phandle = <0x78>;
			};

			oplus_project {
				compatible = "oplus,oplus_project";
				phandle = <0x79>;
			};

			oplus_devinfo {
				compatible = "oplus-devinfo";
				sdcard-gpio = <0xffffffff 0x08 0x00>;
				phandle = <0x7a>;
			};

			nfc_chipset {
				compatible = "oplus-nfc-chipset";
				chipset-20682-146 = "NQ310";
				chipset-20682-148 = "NQ310";
				chipset-20682-92 = "NQ310";
				chipset-20682-94 = "NQ310";
				phandle = <0x7b>;
			};
		};
	};

	fragment@5 {
		target = <0xffffffff>;

		__overlay__ {

			lcd_bias_enp1_gpio {
				phandle = <0x0e>;

				pins_cmd_dat {
					pinmux = <0x1700>;
					slew-rate = <0x01>;
					output-high;
				};
			};

			lcd_bias_enp0_gpio {
				phandle = <0x0f>;

				pins_cmd_dat {
					pinmux = <0x1700>;
					slew-rate = <0x01>;
					output-low;
				};
			};

			lcd_bias_enn1_gpio {
				phandle = <0x10>;

				pins_cmd_dat {
					pinmux = <0xca00>;
					slew-rate = <0x01>;
					output-high;
				};
			};

			lcd_bias_enn0_gpio {
				phandle = <0x11>;

				pins_cmd_dat {
					pinmux = <0xca00>;
					slew-rate = <0x01>;
					output-low;
				};
			};

			lcm_rst_out1_gpio {
				phandle = <0x12>;

				pins_cmd_dat {
					pinmux = <0x2c00>;
					slew-rate = <0x01>;
					output-high;
				};
			};

			lcm_rst_out0_gpio {
				phandle = <0x13>;

				pins_cmd_dat {
					pinmux = <0x2c00>;
					slew-rate = <0x01>;
					output-low;
				};
			};

			lcm_dsi_te {
				phandle = <0x14>;

				pins_cmd_dat {
					pinmux = <0x2b01>;
				};
			};
		};
	};

	fragment@6 {
		target = <0xffffffff>;

		__overlay__ {
			vcamaf-supply = <0xffffffff>;
			status = "okay";
		};
	};

	fragment@7 {
		target = <0xffffffff>;

		__overlay__ {

			ldo2 {
				regulator-compatible = "LDO2";
				regulator-name = "vtp";
				regulator-min-microvolt = <0x124f80>;
				regulator-max-microvolt = <0x36ee80>;
				regulator-always-on;
				regulator-default-on = <0x01>;
				status = "okay";
				phandle = <0x64>;
			};
		};
	};

	fragment@8 {
		target = <0xffffffff>;

		__overlay__ {
			ldo5_ctrls = [00 80 01 2d a4];
			sdcard_det_en = <0x01>;
			sdcard_hlact = <0x00>;
		};
	};

	fragment@9 {
		target = <0xffffffff>;

		__overlay__ {

			phy_tuning {
				compatible = "mediatek,phy_tuning";
				u2_vrt_ref = <0x07>;
				u2_term_ref = <0x07>;
				u2_enhance = <0x02>;
			};
		};
	};

	fragment@10 {
		target = <0xffffffff>;

		__overlay__ {
			pinctrl-names = "lcd_bias_enp1_gpio\0lcd_bias_enp0_gpio\0lcd_bias_enn1_gpio\0lcd_bias_enn0_gpio\0lcm_rst_out1_gpio\0lcm_rst_out0_gpio\0mode_te_te";
			pinctrl-0 = <0x0e>;
			pinctrl-1 = <0x0f>;
			pinctrl-2 = <0x10>;
			pinctrl-3 = <0x11>;
			pinctrl-4 = <0x12>;
			pinctrl-5 = <0x13>;
			pinctrl-6 = <0x14>;
			status = "okay";
			oplus_display_twelvebits_support;
			oplus_display_cabc_support;
			oplus_display_cabc_cmdq_support;
			oplus_display_normal_max_brightness = <0x7ff>;
		};
	};

	fragment@11 {
		target = <0xffffffff>;

		__overlay__ {
			pinctrl-names = "lcm_rst_out1_gpio\0lcm_rst_out0_gpio\0mode_te_te";
			pinctrl-0 = <0x12>;
			pinctrl-1 = <0x13>;
			pinctrl-2 = <0x14>;
			status = "okay";
		};
	};

	fragment@12 {
		target = <0xffffffff>;

		__overlay__ {
			status = "okay";
			#address-cells = <0x01>;
			#size-cells = <0x00>;

			panel@0 {
				compatible = "truly,td4330,vdo";
				reg = <0x00>;
				pm-enable-gpios = <0xffffffff 0x29 0x00>;
				reset-gpios = <0xffffffff 0x2a 0x00>;
				bias-gpios = <0xffffffff 0x1c 0x00 0xffffffff 0x1d 0x00>;
				pinctrl-names = "default";

				port {

					endpoint {
						remote-endpoint = <0x15>;
						phandle = <0x16>;
					};
				};
			};

			ports {

				port {

					endpoint {
						remote-endpoint = <0x16>;
						phandle = <0x15>;
					};
				};
			};
		};
	};

	fragment@13 {
		target = <0xffffffff>;

		__overlay__ {
			accdet-mic-vol = <0x06>;
			headset-mode-setting = <0x500 0x500 0x01 0x1f0 0x2000 0x800 0x2000 0x44 0x00 0x07 0x05 0x09 0x09 0x0d 0x0e>;
			accdet-plugout-debounce = <0x01>;
			accdet-mic-mode = <0x02>;
			headset-three-key-threshold = <0x00 0x50 0xbe 0x190>;
			headset-three-key-threshold-CDD = <0x00 0x79 0xc0 0x258>;
			headset-four-key-threshold = <0x00 0x3a 0x79 0xc0 0x190>;
			moisture_detect_enable = <0x01>;
			eint_use_ext_res = <0x00>;
			eint_detect_mode = <0x05>;
			moisture_detect_mode = <0x05>;
			moisture_comp_vth = <0x02>;
			moisture_comp_vref2 = <0x00>;
			moisture_use_ext_res = <0x00>;
			moisture-external-r = <0x1e8480>;
			moisture-internal-r = <0xb798>;
			moisture-water-r = <0x2710>;
			status = "okay";
		};
	};

	fragment@14 {
		target = <0xffffffff>;

		__overlay__ {
			mtk_dsp_voip = <0x00 0x01 0xffffffff 0xffffffff 0x30000>;
			mtk_dsp_primary = <0x00 0x00 0xffffffff 0xffffffff 0x30000>;
			mtk_dsp_offload = <0x00 0x06 0xffffffff 0xffffffff 0x400000>;
			mtk_dsp_deep = <0x00 0x03 0xffffffff 0xffffffff 0x30000>;
			mtk_dsp_playback = <0x01 0x04 0x0f 0x13 0x30000>;
			mtk_dsp_music = <0x00 0xffffffff 0xffffffff 0xffffffff 0x00>;
			mtk_dsp_capture1 = <0x00 0xffffffff 0x0c 0x12 0x20000>;
			mtk_dsp_a2dp = <0x00 0xffffffff 0xffffffff 0xffffffff 0x40000>;
			mtk_dsp_dataprovider = <0x00 0xffffffff 0x0f 0xffffffff 0x30000>;
			mtk_dsp_call_final = <0x05 0x04 0x0f 0x13 0x18000>;
			mtk_dsp_fast = <0x00 0xffffffff 0xffffffff 0xffffffff 0x5000>;
			mtk_dsp_ktv = <0x00 0x08 0x11 0xffffffff 0x10000>;
			mtk_dsp_capture_raw = <0x00 0xffffffff 0xffffffff 0xffffffff 0x20000>;
			mtk_dsp_ver = <0x00>;
			swdsp_smartpa_process_enable = <0x05>;
			mtk_dsp_mem_afe = <0x01 0x40000>;
		};
	};

	fragment@15 {
		target = <0xffffffff>;

		__overlay__ {

			aw87339@58 {
				compatible = "awinic,aw87339_pa";
				reg = <0x58>;
				reset-gpio = <0xffffffff 0x18 0x00>;
				status = "okay";
			};

			aw87359@59 {
				compatible = "awinic,aw87359_pa";
				reg = <0x59>;
				status = "okay";
			};
		};
	};

	fragment@16 {
		target = <0xffffffff>;

		__overlay__ {
			status = "okay";

			nfc_nxp@28 {
				compatible = "nxp,pn544";
				reg = <0x28>;
				nxp,pn544-irq = <0xffffffff 0x05 0x00>;
				nxp,pn544-ven = <0xffffffff 0x7f 0x00>;
				nxp,pn544-fw-dwnld = <0xffffffff 0x06 0x00>;
				interrupt-parent = <0xffffffff>;
			};
		};
	};

	fragment@17 {
		target = <0xffffffff>;

		__overlay__ {
			mt6360,intr_gpio_num = <0x10>;
			mt6360,intr_gpio = <0xffffffff 0x10 0x00>;
		};
	};

	fragment@18 {
		target = <0xffffffff>;

		__overlay__ {
			pwr_off_seq = <0x6000204>;
		};
	};

	fragment@19 {
		target = <0xffffffff>;

		__overlay__ {
			mt6360pd,intr_gpio_num = <0x07>;
			mt6360pd,intr_gpio = <0xffffffff 0x07 0x00>;
		};
	};

	fragment@20 {
		target = <0xffffffff>;

		__overlay__ {

			usb_default {
				phandle = <0x01>;
			};

			c1_init {
				phandle = <0x02>;

				pins_cmd_dat {
					pinmux = <0x2800>;
					slew-rate = <0x01>;
					output-low;
				};
			};

			c1_low {
				phandle = <0x03>;

				pins_cmd_dat {
					pinmux = <0x2800>;
					slew-rate = <0x01>;
					output-low;
				};
			};

			c1_highz {
				phandle = <0x04>;

				pins_cmd_dat {
					pinmux = <0x2800>;
					slew-rate = <0x00>;
					bias-disable;
				};
			};

			c1_high {
				phandle = <0x05>;

				pins_cmd_dat {
					pinmux = <0x2800>;
					slew-rate = <0x01>;
					output-high;
				};
			};

			c2_init {
				phandle = <0x06>;

				pins_cmd_dat {
					pinmux = <0x1e00>;
					slew-rate = <0x01>;
					output-low;
				};
			};

			c2_low {
				phandle = <0x07>;

				pins_cmd_dat {
					pinmux = <0x1e00>;
					slew-rate = <0x01>;
					output-low;
				};
			};

			c2_highz {
				phandle = <0x08>;

				pins_cmd_dat {
					pinmux = <0x1e00>;
					slew-rate = <0x00>;
					bias-disable;
				};
			};

			c2_high {
				phandle = <0x09>;

				pins_cmd_dat {
					pinmux = <0x1e00>;
					slew-rate = <0x01>;
					output-high;
				};
			};

			u3_sw_sel1 {
				phandle = <0x0a>;

				pins_cmd_dat {
					pinmux = <0x2000>;
					slew-rate = <0x01>;
					output-low;
				};
			};

			u3_sw_sel2 {
				phandle = <0x0b>;

				pins_cmd_dat {
					pinmux = <0x2000>;
					slew-rate = <0x01>;
					output-high;
				};
			};

			u3_sw_en {
				phandle = <0x0c>;
			};

			u3_sw_dis {
				phandle = <0x0d>;
			};
		};
	};

	fragment@21 {
		target = <0xffffffff>;

		__overlay__ {
			keypad,volume-up = <0xffffffff 0x3b 0x00>;
			keypad,volume-down = <0xffffffff 0x3c 0x00>;
			pinctrl-names = "volume_up_as_int\0volume_down_as_int";
			pinctrl-0 = <0x17>;
			pinctrl-1 = <0x18>;
			status = "okay";
		};
	};

	fragment@22 {
		target = <0xffffffff>;

		__overlay__ {

			volume_up@0 {
				phandle = <0x17>;

				pins_cmd_dat {
					pinmux = <0x3b00>;
					slew-rate = <0x00>;
					bias-pull-up = <0x00>;
					input-enable;
				};
			};

			volume_down@0 {
				phandle = <0x18>;

				pins_cmd_dat {
					pinmux = <0x3c00>;
					slew-rate = <0x00>;
					bias-pull-up = <0x01>;
					input-enable;
				};
			};
		};
	};

	fragment@23 {
		target = <0xffffffff>;

		__overlay__ {

			consys_default {
				phandle = <0x19>;
			};

			gpslna@0 {
				phandle = <0x1a>;

				pins_cmd_dat {
					pinmux = <0x9b00>;
					slew-rate = <0x01>;
					bias-disable;
					output-low;
				};
			};

			gpslna@1 {
				phandle = <0x1b>;

				pins_cmd_dat {
					pinmux = <0x9b00>;
					slew-rate = <0x01>;
					output-high;
				};
			};

			gpslna@2 {
				phandle = <0x1c>;

				pins_cmd_dat {
					pinmux = <0x9b00>;
					slew-rate = <0x01>;
					output-low;
				};
			};
		};
	};

	fragment@24 {
		target = <0xffffffff>;

		__overlay__ {
			pinctrl-names = "default\0gps_lna_state_init\0gps_lna_state_oh\0gps_lna_state_ol";
			pinctrl-0 = <0x19>;
			pinctrl-1 = <0x1a>;
			pinctrl-2 = <0x1b>;
			pinctrl-3 = <0x1c>;
			status = "okay";
		};
	};

	fragment@25 {
		target = <0xffffffff>;

		__overlay__ {

			fpc_reset_default {
				phandle = <0x1d>;

				pins_cmd_dat {
					pinmux = <0x6900>;
					output-low;
				};
			};

			fpc_irq_default {
				phandle = <0x1e>;

				pins_cmd_dat {
					pinmux = <0x4b00>;
					input;
					bias-pull-up;
				};
			};

			fpc_pwr_default {
				phandle = <0x1f>;

				pins_cmd_dat {
					pinmux = <0x9300>;
					bias-disable;
					output-low;
				};
			};

			gpio_fpc_cs_func {
				phandle = <0x20>;

				pins_cmd_dat {
					pinmux = <0x1300>;
					drive-strength = <0x03>;
				};
			};
		};
	};

	fragment@26 {
		target = <0xffffffff>;

		__overlay__ {
			pinctrl-names = "default\0fpc_cs_func";
			fpc,irq-gpio = <0xffffffff 0x4b 0x00>;
			fpc,reset-gpio = <0xffffffff 0x69 0x00>;
			fpc,vdd-en = <0xffffffff 0x93 0x00>;
			fpc,gpio_cs = <0xffffffff 0x13 0x00>;
			pinctrl-0 = <0x1d 0x1e 0x1f>;
			pinctrl-1 = <0x20>;
			status = "okay";
			pw_en_gpio = <0xffffffff 0x93 0x00>;

			power_source_1 {
				power-mode = <0x02>;
				power-name = "pw_en_gpio";
				poweron-level = <0x00>;
				delay-time = <0x00>;
			};
		};
	};

	fragment@27 {
		target = <0xffffffff>;

		__overlay__ {

			goodix_reset_default {
				phandle = <0x21>;

				pins_cmd_dat {
					pinmux = <0x6900>;
					output-low;
				};
			};

			goodix_irq_out_low {
				phandle = <0x22>;

				pins_cmd_dat {
					pinmux = <0x4b00>;
					input;
					output-low;
				};
			};

			goodix_irq_no_pull {
				phandle = <0x23>;

				pins_cmd_dat {
					pinmux = <0x4b00>;
					bias-disable;
				};
			};
		};
	};

	fragment@28 {
		target = <0xffffffff>;

		__overlay__ {
			pinctrl-names = "goodix_reset_default\0goodix_irq_out_low\0goodix_irq_no_pull";
			pinctrl-0 = <0x21>;
			pinctrl-1 = <0x22>;
			pinctrl-2 = <0x23>;
			interrupt-parent = <0xffffffff>;
			interrupts = <0x4b 0x00>;
			gf,cs_gpio_disable = <0x01>;
			goodix,gpio_irq = <0xffffffff 0x4b 0x00>;
			goodix,gpio_reset = <0xffffffff 0x69 0x00>;
			spi-max-frequency = <0x7a1200>;
			status = "okay";
		};
	};

	fragment@29 {
		target = <0xffffffff>;

		__overlay__ {
			#address-cells = <0x01>;
			#size-cells = <0x00>;
			status = "okay";

			fingerprint@0 {
				compatible = "oplus,oplus_fp";
				reg = <0x00>;
				spi-max-frequency = <0x7a1200>;
				spi-id = <0x00>;
				spi-irq = <0x4b>;
				spi-reg = <0xa7ffd0>;
				power-num = <0x01>;
				vfp-supply = <0xffffffff>;
				vfp-config = <0x325aa0 0x325aa0 0x249f0>;
				status = "okay";
				fpc,pw_en = <0xffffffff 0x93 0x00>;
				phandle = <0x7c>;

				power_source_1 {
					power-mode = <0x01>;
					power-name = "vfp";
					power-config = "vfp-config";
					delay-time = <0x00>;
				};
			};
		};
	};

	fragment@30 {
		target = <0xffffffff>;

		__overlay__ {

			gpio_id0_default {
				phandle = <0x24>;

				pins_cmd_dat {
					pinmux = <0x6a00>;
					bias-pull-up;
				};
			};

			gpio_id0_pull_up {
				phandle = <0x25>;

				pins_cmd_dat {
					pinmux = <0x6a00>;
					bias-pull-up;
				};
			};

			gpio_id0_pull_down {
				phandle = <0x26>;

				pins_cmd_dat {
					pinmux = <0x6a00>;
					input;
					bias-pull-down;
				};
			};
		};
	};

	fragment@31 {
		target = <0xffffffff>;

		__overlay__ {
			compatible = "oplus,fp_common";
			oplus,fp_gpio_num = <0x01>;
			oplus,fp_gpio_0 = <0xffffffff 0x6a 0x00>;
			pinctrl-names = "default\0gpio_id0_pull_up\0gpio_id0_pull_down";
			pinctrl-0 = <0x24>;
			pinctrl-1 = <0x25>;
			pinctrl-2 = <0x26>;

			goodix_3626 {
				oplus,fp-id = <0x01>;
				vendor-chip = <0x10>;
				eng-menu = "-1,-1";
				chip-name = "G_3626_REAL";
			};

			fpc_1541 {
				oplus,fp-id = <0x00>;
				vendor-chip = <0x11>;
				eng-menu = "-1,-1";
				chip-name = "F_1541";
			};
		};
	};

	fragment@32 {
		target = <0xffffffff>;

		__overlay__ {

			vooc_ap_data {
				compatible = "mediatek, VOOC_AP_DATA-eint";
				interrupts = <0x43 0x02 0x43 0x00>;
				phandle = <0x7d>;
			};

			vooc_ap_data_new_function {
				compatible = "mediatek, VOOC_EINT_NEW_FUNCTION";
				phandle = <0x7e>;
			};
		};
	};

	fragment@33 {
		target = <0xffffffff>;

		__overlay__ {

			charger_gpio_as_output_low {
				phandle = <0x29>;

				pins_cmd_dat {
					pinmux = <0xc300>;
					slew-rate = <0x01>;
					output-low;
				};
			};

			charger_gpio_as_output_high {
				phandle = <0x2a>;

				pins_cmd_dat {
					pinmux = <0xc300>;
					slew-rate = <0x01>;
					output-high;
				};
			};

			ship_sleep {
				phandle = <0x2b>;

				pins_cmd_dat {
					pinmux = <0x1a00>;
					slew-rate = <0x01>;
					output-low;
				};
			};

			ship_active {
				phandle = <0x2c>;

				pins_cmd_dat {
					pinmux = <0x1a00>;
					slew-rate = <0x01>;
					output-high;
				};
			};

			dischg_disable {
				phandle = <0x2d>;

				pins_cmd_dat {
					pinmux = <0xd00>;
					slew-rate = <0x01>;
					output-low;
				};
			};

			dischg_enable {
				phandle = <0x2e>;

				pins_cmd_dat {
					pinmux = <0xd00>;
					slew-rate = <0x01>;
					output-high;
				};
			};

			chgvin_enable {
				phandle = <0x2f>;

				pins_cmd_dat {
					pinmux = <0x7f00>;
					slew-rate = <0x01>;
					bias-pull-up = <0x00>;
					output-low;
				};
			};

			chgvin_disable {
				phandle = <0x30>;

				pins_cmd_dat {
					pinmux = <0x7f00>;
					slew-rate = <0x01>;
					bias-pull-down = <0x00>;
					output-high;
				};
			};
		};
	};

	fragment@34 {
		target = <0xffffffff>;

		__overlay__ {

			charging_switch1_active {
				phandle = <0x34>;

				pins_cmd_dat {
					pinmux = <0x2200>;
					slew-rate = <0x01>;
					output-high;
				};
			};

			charging_switch1_sleep {
				phandle = <0x35>;

				pins_cmd_dat {
					pinmux = <0x2200>;
					slew-rate = <0x01>;
					output-low;
				};
			};

			charging_clock_active {
				phandle = <0x36>;

				pins_cmd_dat {
					pinmux = <0x4400>;
					slew-rate = <0x00>;
					bias-pull-up = <0x00>;
				};
			};

			charging_clock_sleep {
				phandle = <0x37>;

				pins_cmd_dat {
					pinmux = <0x4400>;
					slew-rate = <0x00>;
					bias-pull-down = <0x00>;
				};
			};

			charging_data_active {
				phandle = <0x38>;

				pins_cmd_dat {
					pinmux = <0x4300>;
					slew-rate = <0x00>;
					bias-pull-up = <0x00>;
				};
			};

			charging_data_sleep {
				phandle = <0x39>;

				pins_cmd_dat {
					pinmux = <0x4300>;
					slew-rate = <0x00>;
					bias-pull-down = <0x00>;
				};
			};

			charging_reset_active {
				phandle = <0x3a>;

				pins_cmd_dat {
					pinmux = <0xe00>;
					slew-rate = <0x01>;
					output-high;
				};
			};

			charging_reset_sleep {
				phandle = <0x3b>;

				pins_cmd_dat {
					pinmux = <0xe00>;
					slew-rate = <0x01>;
					output-low;
				};
			};
		};
	};

	fragment@35 {
		target = <0xffffffff>;

		__overlay__ {

			mps_otg_en_active {
				phandle = <0x31>;

				pins_cmd_dat {
					pinmux = <0x9700>;
					slew-rate = <0x01>;
					output-high;
				};
			};

			mps_otg_en_sleep {
				phandle = <0x32>;

				pins_cmd_dat {
					pinmux = <0x9700>;
					slew-rate = <0x01>;
					output-low;
				};
			};

			mps_otg_en_default {
				phandle = <0x33>;

				pins_cmd_dat {
					pinmux = <0x9700>;
					slew-rate = <0x01>;
					output-low;
				};
			};
		};
	};

	fragment@36 {
		target = <0xffffffff>;

		__overlay__ {
			pinctrl-names = "uart0_rx_gpio\0uart0_tx_gpio";
			pinctrl-0 = <0x27>;
			pinctrl-1 = <0x28>;
			status = "okay";
		};
	};

	fragment@37 {
		target = <0xffffffff>;

		__overlay__ {

			uart0_rx_gpio@gpio53 {
				phandle = <0x27>;

				pins_cmd_dat {
					pinmux = <0x3500>;
					input-enable;
					slew-rate = <0x00>;
					bias-disable;
				};
			};

			uart0_tx_gpio@gpio54 {
				phandle = <0x28>;

				pins_cmd_dat {
					pinmux = <0x3600>;
					input-enable;
					slew-rate = <0x00>;
					bias-disable;
				};
			};
		};
	};

	fragment@38 {
		target = <0xffffffff>;

		__overlay__ {
			io-channels = <0xffffffff 0x02 0xffffffff 0x03 0xffffffff 0x04 0xffffffff 0x05>;
			io-channel-names = "auxadc4-usb_temp_v_l\0auxadc5-usb_temp_v_r\0auxadc3-chargeric_temp\0thermistor-ch5_flashlight_ntc";
			pinctrl-names = "charger_gpio_as_output_low\0charger_gpio_as_output_high\0ship_sleep\0ship_active\0dischg_disable\0dischg_enable\0chgvin_enable\0chgvin_disable";
			pinctrl-0 = <0x29>;
			pinctrl-1 = <0x2a>;
			pinctrl-2 = <0x2b>;
			pinctrl-3 = <0x2c>;
			pinctrl-4 = <0x2d>;
			pinctrl-5 = <0x2e>;
			pinctrl-6 = <0x2f>;
			pinctrl-7 = <0x30>;
			qcom,chargerid_support;
			qcom,usbtemp_batttemp_gap = <0x12>;
			qcom,input_current_charger_ma = <0x898>;
			qcom,pd_input_current_charger_ma = <0x7d0>;
			qcom,qc_input_current_charger_ma = <0x7d0>;
			qcom,input_current_usb_ma = <0x1f4>;
			qcom,input_current_cdp_ma = <0x5dc>;
			qcom,input_current_led_ma = <0x4b0>;
			qcom,input_current_led_ma_forcmcc = <0x1f4>;
			qcom,input_current_camera_ma = <0x7d0>;
			qcom,input_current_calling_ma = <0x5dc>;
			qcom,input_current_led_ma_high = <0x4b0>;
			qcom,input_current_led_ma_limit_high = <0x4b0>;
			qcom,input_current_led_ma_warm = <0x5dc>;
			qcom,input_current_led_ma_normal = <0x7d0>;
			qcom,led_warm_bat_decidegc = <0x15e>;
			qcom,led_limit_high_bat_decidegc = <0x172>;
			qcom,input_current_vooc_led_ma_high = <0x4b0>;
			qcom,input_current_vooc_led_ma_warm = <0x708>;
			qcom,input_current_vooc_led_ma_normal = <0xe10>;
			qcom,input_current_vooc_ma_normal = <0xe10>;
			qcom,vooc_temp_bat_normal_decidegc = <0x15e>;
			qcom,input_current_vooc_ma_warm = <0xc80>;
			qcom,vooc_temp_bat_warm_decidegc = <0x172>;
			qcom,input_current_vooc_ma_high = <0x898>;
			qcom,led_high_bat_decidegc = <0x1b8>;
			qcom,vooc_temp_bat_hot_decidegc = <0x1b8>;
			qcom,charger_current_vooc_ma_normal = <0x708>;
			qcom,overtemp_bat_decidegc = <0x15e>;
			qcom,iterm_disabled = <0x00>;
			sw_full_count = <0x19>;
			qcom,iterm_ma = <0x73>;
			qcom,recharge-mv = <0x69>;
			qcom,batt_capacity_mah = <0x1194>;
			qcom,removed_bat_decidegc = <0xbe>;
			qcom,cold_bat_decidegc = <0x14>;
			qcom,temp_cold_vfloat_mv = <0xf8c>;
			qcom,temp_cold_fastchg_current_ma = <0x12c>;
			qcom,little_cold_bat_decidegc = <0x00>;
			qcom,temp_little_cold_vfloat_mv = <0x1153>;
			qcom,temp_little_cold_fastchg_current_ma_high = <0x3b6>;
			qcom,temp_little_cold_fastchg_current_ma_low = <0x3b6>;
			qcom,temp_little_cold_fastchg_current_ma = <0x3b6>;
			qcom,pd_temp_little_cold_fastchg_current_ma_high = <0x7d0>;
			qcom,pd_temp_little_cold_fastchg_current_ma_low = <0x578>;
			qcom,qc_temp_little_cold_fastchg_current_ma_high = <0x7d0>;
			qcom,qc_temp_little_cold_fastchg_current_ma_low = <0x578>;
			qcom,cool_bat_decidegc = <0x32>;
			qcom,temp_cool_vfloat_mv = <0x1153>;
			qcom,temp_cool_fastchg_current_ma_high = <0x3e8>;
			qcom,temp_cool_fastchg_current_ma_low = <0x44c>;
			qcom,pd_temp_cool_fastchg_current_ma_high = <0x7d0>;
			qcom,pd_temp_cool_fastchg_current_ma_low = <0x5dc>;
			qcom,qc_temp_cool_fastchg_current_ma_high = <0x7d0>;
			qcom,qc_temp_cool_fastchg_current_ma_low = <0x7d0>;
			qcom,little_cool_bat_decidegc = <0x78>;
			qcom,temp_little_cool_vfloat_mv = <0x1153>;
			qcom,temp_little_cool_fastchg_current_ma = <0x3e8>;
			qcom,pd_temp_little_cool_fastchg_current_ma = <0x7d0>;
			qcom,qc_temp_little_cool_fastchg_current_ma = <0x7d0>;
			qcom,normal_bat_decidegc = <0xa0>;
			qcom,temp_normal_fastchg_current_ma = <0x3e8>;
			qcom,temp_normal_vfloat_mv = <0x1153>;
			qcom,pd_temp_normal_fastchg_current_ma = <0x7d0>;
			qcom,qc_temp_normal_fastchg_current_ma = <0x7d0>;
			qcom,warm_bat_decidegc = <0x1b8>;
			qcom,temp_warm_vfloat_mv = <0x1018>;
			qcom,temp_warm_fastchg_current_ma = <0x226>;
			qcom,pd_temp_warm_fastchg_current_ma = <0x258>;
			qcom,qc_temp_warm_fastchg_current_ma = <0x258>;
			qcom,temp_warm_fastchg_current_ma_led_on = <0xfa>;
			qcom,hot_bat_decidegc = <0x212>;
			qcom,non_standard_vfloat_mv = <0xf8c>;
			qcom,non_standard_fastchg_current_ma = <0x200>;
			qcom,short_c_bat_cv_mv = <0x10ea>;
			qcom,short_c_bat_vfloat_mv = <0xed8>;
			qcom,short_c_bat_fastchg_current_ma = <0x200>;
			qcom,short_c_bat_vfloat_sw_limit = <0xea6>;
			qcom,cold_vfloat_sw_limit = <0xf5a>;
			qcom,little_cold_vfloat_sw_limit = <0x1121>;
			qcom,cool_vfloat_sw_limit = <0x1121>;
			qcom,little_cool_vfloat_sw_limit = <0x1121>;
			qcom,normal_vfloat_sw_limit = <0x1121>;
			qcom,warm_vfloat_sw_limit = <0xff0>;
			qcom,non_standard_vfloat_sw_limit = <0xf5a>;
			qcom,max_chg_time_sec = <0xecd0>;
			qcom,charger_hv_thr = <0x26ac>;
			qcom,charger_recv_thr = <0x251c>;
			qcom,charger_lv_thr = <0xd48>;
			qcom,vbatt_full_thr = <0x1130>;
			qcom,vbatt_hv_thr = <0x11c6>;
			qcom,vfloat_step_mv = <0x08>;
			qcom,non_standard_vfloat_over_sw_limit = <0xf8c>;
			qcom,cold_vfloat_over_sw_limit = <0xf8c>;
			qcom,little_cold_vfloat_over_sw_limit = <0x1158>;
			qcom,cool_vfloat_over_sw_limit = <0x1158>;
			qcom,little_cool_vfloat_over_sw_limit = <0x1158>;
			qcom,normal_vfloat_over_sw_limit = <0x1158>;
			qcom,warm_vfloat_over_sw_limit = <0x1027>;
			qcom,vbatt_power_off = <0xce4>;
			qcom,vbatt_soc_1 = <0xcee>;
			qcom,vooc_project = <0x03>;
			qcom,vbatt_num = <0x02>;
			qcom,new_ui_warning_support;
			qcom,ffc_support;
			qcom,dual_ffc;
			recharge_after_full;
			qcom,normal_vterm_hw_inc = <0x12>;
			qcom,non_normal_vterm_hw_inc = <0x12>;
			qcom,ff1_normal_fastchg_ma = <0x226>;
			qcom,ff1_warm_fastchg_ma = <0x226>;
			qcom,ffc2_normal_fastchg_ma = <0x15e>;
			qcom,ffc2_temp_warm_decidegc = <0x15e>;
			qcom,ffc2_warm_fastchg_ma = <0x15e>;
			qcom,ffc2_temp_high_decidegc = <0x190>;
			qcom,ffc2_temp_low_decidegc = <0x78>;
			qcom,ff1_exit_step_ma = <0x96>;
			qcom,ff1_warm_exit_step_ma = <0x96>;
			qcom,ffc2_exit_step_ma = <0x96>;
			qcom,ffc2_warm_exit_step_ma = <0x96>;
			qcom,ffc_normal_vfloat_sw_limit = <0x1167>;
			qcom,ffc_temp_normal_vfloat_mv = <0x1194>;
			qcom,ffc_normal_vfloat_over_sw_limit = <0x1194>;
			qcom,ffc_warm_vfloat_sw_limit = <0x1162>;
			qcom,ffc_temp_warm_vfloat_mv = <0x1194>;
			qcom,ffc_warm_vfloat_over_sw_limit = <0x1194>;
			qcom,ffc1_temp_normal_vfloat_mv = <0x1194>;
			qcom,ffc2_normal_vfloat_sw_limit = <0x115d>;
			qcom,ffc2_temp_normal_vfloat_mv = <0x1194>;
			qcom,ffc1_normal_vfloat_over_sw_limit = <0x1194>;
			qcom,ffc2_normal_vfloat_over_sw_limit = <0x1194>;
			qcom,ffc2_warm_vfloat_sw_limit = <0x1158>;
			qcom,ffc2_temp_warm_vfloat_mv = <0x1194>;
			qcom,ffc2_warm_vfloat_over_sw_limit = <0x1194>;
			qcom,default_iterm_ma = <0x73>;
			qcom,default_temp_normal_fastchg_current_ma = <0x898>;
			qcom,default_normal_vfloat_sw_limit = <0x1121>;
			qcom,default_temp_normal_vfloat_mv = <0x1153>;
			qcom,default_normal_vfloat_over_sw_limit = <0x1158>;
			qcom,default_temp_little_cool_fastchg_current_ma = <0x44c>;
			qcom,default_little_cool_vfloat_sw_limit = <0x1121>;
			qcom,default_temp_little_cool_vfloat_mv = <0x1153>;
			qcom,default_little_cool_vfloat_over_sw_limit = <0x115d>;
			qcom,check_batt_full_by_sw;
			qcom,external_gauge;
			qcom,chg_ctrl_by_calling;
			qcom,chg_ctrl_by_lcd;
			qcom,chg_ctrl_by_vooc;
			qcom,chg_ctrl_by_camera;
			qcom,sw_vfloat_over_protect_enable;
			qcom,vooc_show_ui_soc_decimal;
			qcom,ui_soc_decimal_speedmin = <0x14>;
			qcom,usb_ntc_support;
			qcom,vooc_enable_charger_first;
			qcom,vbatt_pdqc_to_5v_thr = <0x1004>;
			qcom,vbatt_pdqc_to_9v_thr = <0xfa0>;
			qcom,chargerid_switch-gpio = <0xffffffff 0xc3 0x00>;
			qcom,ship-gpio = <0xffffffff 0x1a 0x00>;
			qcom,dischg-gpio = <0xffffffff 0x0d 0x00>;
			qcom,chgvin = <0xffffffff 0x7f 0x00>;
		};
	};

	fragment@39 {
		target = <0xffffffff>;

		__overlay__ {
			status = "okay";
			clock-frequency = <0x186a0>;

			bq27541-battery@55 {
				status = "okay";
				compatible = "oplus,bq27541-battery";
				reg = <0x55 0x00>;
				qcom,modify-soc-smooth;
				qcom,batt_bq28z610 = <0x01>;
				qcom,sha1_key_index = <0x01>;
			};

			da9313-divider@68 {
				status = "okay";
				compatible = "oplus,da9313-divider";
				reg = <0x68 0x00>;
			};

			mp2650-charger@5c {
				status = "okay";
				compatible = "oplus,mp2650-charger";
				reg = <0x5c 0x00>;
				qcom,mps_otg_en-gpio = <0xffffffff 0x97 0x00>;
				pinctrl-names = "mps_otg_en_active\0mps_otg_en_sleep\0mps_otg_en_default";
				pinctrl-0 = <0x31>;
				pinctrl-1 = <0x32>;
				pinctrl-2 = <0x33>;
			};

			rk826_fastcg@0a {
				status = "okay";
				compatible = "oplus,rk826-fastcg";
				reg = <0x0a 0x00>;
				qcom,oplus_batt_4400mv;
				qcom,support_vooc_by_normal_charger_path;
				qcom,vooc-fw-type = <0x20>;
				qcom,vooc-low-temp = <0x32>;
				qcom,vooc-high-temp = <0x1b8>;
				qcom,vooc-low-soc = <0x01>;
				qcom,vooc-high-soc = <0x5a>;
				qcom,vooc-little-cool-temp = <0xa0>;
				qcom,vooc-cool-temp = <0x78>;
				qcom,vooc-little-cool-to-normal-temp = <0xb4>;
				qcom,vooc-normal-to-little-cool-current = <0x05>;
				qcom,vooc_multistep_adjust_current_support;
				qcom,vooc_multistep_initial_batt_temp = <0x136>;
				qcom,vooc_strategy_normal_current = <0x06>;
				qcom,vooc_batt_over_high_temp = <0x1b8>;
				qcom,vooc_batt_over_low_temp = <0x2d>;
				qcom,vooc_over_high_or_low_current = <0x00>;
				qcom,vooc_strategy1_batt_high_temp0 = <0x1a9>;
				qcom,vooc_strategy1_batt_high_temp1 = <0x1ae>;
				qcom,vooc_strategy1_batt_high_temp2 = <0x1b3>;
				qcom,vooc_strategy1_batt_low_temp2 = <0x1a4>;
				qcom,vooc_strategy1_batt_low_temp1 = <0x19f>;
				qcom,vooc_strategy1_batt_low_temp0 = <0x190>;
				qcom,vooc_strategy1_high_current0 = <0x04>;
				qcom,vooc_strategy1_high_current1 = <0x03>;
				qcom,vooc_strategy1_high_current2 = <0x02>;
				qcom,vooc_strategy1_low_current2 = <0x03>;
				qcom,vooc_strategy1_low_current1 = <0x04>;
				qcom,vooc_strategy1_low_current0 = <0x04>;
				qcom,vooc_strategy2_batt_up_temp1 = <0x177>;
				qcom,vooc_strategy2_batt_up_down_temp2 = <0x17c>;
				qcom,vooc_strategy2_batt_up_temp3 = <0x186>;
				qcom,vooc_strategy2_batt_up_down_temp4 = <0x190>;
				qcom,vooc_strategy2_batt_up_temp5 = <0x19a>;
				qcom,vooc_strategy2_batt_up_temp6 = <0x19f>;
				qcom,vooc_strategy2_high0_current = <0x05>;
				qcom,vooc_strategy2_high1_current = <0x04>;
				qcom,vooc_strategy2_high2_current = <0x03>;
				qcom,vooc_strategy2_high3_current = <0x02>;
				qcom,vooc_current_lvl = <0x3e8 0x5dc 0x7d0 0x9c4 0xbb8 0xdac 0xfa0 0x1194 0x1388 0x157c 0x1770 0x1964 0x1b58 0x1d4c 0x1f40 0x2134 0x2328 0x251c 0x2710 0x2904 0x2af8 0x2cec 0x2ee0 0x30d4>;
				pinctrl-names = "switch1_act_switch2_act\0switch1_sleep_switch2_sleep\0switch1_act_switch3_act\0switch1_sleep_switch3_sleep\0switch1_act_switch2_sleep\0switch1_sleep_switch2_act\0clock_active\0clock_sleep\0data_active\0data_sleep\0reset_active\0reset_sleep";
				pinctrl-0 = <0x34>;
				pinctrl-1 = <0x35>;
				pinctrl-2 = <0x34>;
				pinctrl-3 = <0x35>;
				pinctrl-4 = <0x34>;
				pinctrl-5 = <0x35>;
				pinctrl-6 = <0x36>;
				pinctrl-7 = <0x37>;
				pinctrl-8 = <0x38>;
				pinctrl-9 = <0x39>;
				pinctrl-10 = <0x3a>;
				pinctrl-11 = <0x3b>;
				qcom,charging_switch1-gpio = <0xffffffff 0x22 0x00>;
				qcom,charging_reset-gpio = <0xffffffff 0x0e 0x00>;
				qcom,charging_clock-gpio = <0xffffffff 0x44 0x00>;
				qcom,charging_data-gpio = <0xffffffff 0x43 0x00>;
				old_project_disable_hwid_check;
			};
		};
	};

	fragment@40 {
		target = <0xffffffff>;

		__overlay__ {

			camera0_rst_output_low@gpio119 {
				phandle = <0x3d>;

				pins_cmd_dat {
					pinmux = <0x7700>;
					output-low;
				};
			};

			camera0_rst_output_high@gpio119 {
				phandle = <0x3e>;

				pins_cmd_dat {
					pinmux = <0x7700>;
					output-high;
				};
			};

			camera0_vcamd_output_low@gpio123 {
				phandle = <0x3f>;

				pins_cmd_dat0 {
					pinmux = <0x7300>;
					output-low;
				};

				pins_cmd_dat1 {
					pinmux = <0x7b00>;
					output-low;
				};
			};

			camera0_vcamd_output_high@gpio123 {
				phandle = <0x40>;

				pins_cmd_dat0 {
					pinmux = <0x7300>;
					output-high;
				};

				pins_cmd_dat1 {
					pinmux = <0x7b00>;
					output-high;
				};
			};

			camera1_rst_output_low@gpio124 {
				phandle = <0x41>;

				pins_cmd_dat {
					pinmux = <0x7c00>;
					output-low;
				};
			};

			camera1_rst_output_high@gpio124 {
				phandle = <0x42>;

				pins_cmd_dat {
					pinmux = <0x7c00>;
					output-high;
				};
			};

			camera2_rst_output_low@gpio197 {
				phandle = <0x43>;

				pins_cmd_dat {
					pinmux = <0xc500>;
					output-low;
				};
			};

			camera2_rst_output_high@gpio197 {
				phandle = <0x44>;

				pins_cmd_dat {
					pinmux = <0xc500>;
					output-high;
				};
			};

			camera3_pnd_output_low@gpio125 {
				phandle = <0x45>;

				pins_cmd_dat {
					pinmux = <0x7d00>;
					output-low;
				};
			};

			camera3_pnd_output_high@gpio125 {
				phandle = <0x46>;

				pins_cmd_dat {
					pinmux = <0x7d00>;
					output-high;
				};
			};

			camera4_pnd_output_low@gpio118 {
				phandle = <0x47>;

				pins_cmd_dat {
					pinmux = <0x7600>;
					output-low;
				};
			};

			camera4_pnd_output_high@gpio118 {
				phandle = <0x48>;

				pins_cmd_dat {
					pinmux = <0x7600>;
					output-high;
				};
			};

			camera0_mclk_gpio_mode@gpio117 {
				phandle = <0x49>;

				pins_cmd_dat {
					pinmux = <0x7500>;
					drive-strength = <0x01>;
				};
			};

			camera0_mclk_2ma@gpio117 {
				phandle = <0x4a>;

				pins_cmd_dat {
					pinmux = <0x7501>;
					drive-strength = <0x00>;
				};
			};

			camera0_mclk_4ma@gpio117 {
				phandle = <0x4b>;

				pins_cmd_dat {
					pinmux = <0x7501>;
					drive-strength = <0x01>;
				};
			};

			camera0_mclk_6ma@gpio117 {
				phandle = <0x4c>;

				pins_cmd_dat {
					pinmux = <0x7501>;
					drive-strength = <0x02>;
				};
			};

			camera0_mclk_8ma@gpio117 {
				phandle = <0x4d>;

				pins_cmd_dat {
					pinmux = <0x7501>;
					drive-strength = <0x03>;
				};
			};

			camera1_mclk_gpio_mode@gpio196 {
				phandle = <0x4e>;

				pins_cmd_dat {
					pinmux = <0xc400>;
					drive-strength = <0x01>;
				};
			};

			camera1_mclk_2ma@gpio196 {
				phandle = <0x4f>;

				pins_cmd_dat {
					pinmux = <0xc401>;
					drive-strength = <0x00>;
				};
			};

			camera1_mclk_4ma@gpio196 {
				phandle = <0x50>;

				pins_cmd_dat {
					pinmux = <0xc401>;
					drive-strength = <0x01>;
				};
			};

			camera1_mclk_6ma@gpio196 {
				phandle = <0x51>;

				pins_cmd_dat {
					pinmux = <0xc401>;
					drive-strength = <0x02>;
				};
			};

			camera1_mclk_8ma@gpio196 {
				phandle = <0x52>;

				pins_cmd_dat {
					pinmux = <0xc401>;
					drive-strength = <0x03>;
				};
			};

			camera2_mclk_gpio_mode@gpio120 {
				phandle = <0x53>;

				pins_cmd_dat {
					pinmux = <0x7800>;
					drive-strength = <0x01>;
				};
			};

			camera2_mclk_2ma@gpio120 {
				phandle = <0x54>;

				pins_cmd_dat {
					pinmux = <0x7801>;
					drive-strength = <0x00>;
				};
			};

			camera2_mclk_4ma@gpio120 {
				phandle = <0x55>;

				pins_cmd_dat {
					pinmux = <0x7801>;
					drive-strength = <0x01>;
				};
			};

			camera2_mclk_6ma@gpio120 {
				phandle = <0x56>;

				pins_cmd_dat {
					pinmux = <0x7801>;
					drive-strength = <0x02>;
				};
			};

			camera2_mclk_8ma@gpio120 {
				phandle = <0x57>;

				pins_cmd_dat {
					pinmux = <0x7801>;
					drive-strength = <0x03>;
				};
			};

			camera3_mclk_gpio_mode@gpio121 {
				phandle = <0x58>;

				pins_cmd_dat {
					pinmux = <0x7900>;
					drive-strength = <0x01>;
				};
			};

			camera3_mclk_2ma@gpio121 {
				phandle = <0x59>;

				pins_cmd_dat {
					pinmux = <0x7901>;
					drive-strength = <0x00>;
				};
			};

			camera3_mclk_4ma@gpio121 {
				phandle = <0x5a>;

				pins_cmd_dat {
					pinmux = <0x7901>;
					drive-strength = <0x01>;
				};
			};

			camera3_mclk_6ma@gpio121 {
				phandle = <0x5b>;

				pins_cmd_dat {
					pinmux = <0x7901>;
					drive-strength = <0x02>;
				};
			};

			camera3_mclk_8ma@gpio121 {
				phandle = <0x5c>;

				pins_cmd_dat {
					pinmux = <0x7901>;
					drive-strength = <0x03>;
				};
			};

			camera4_mclk_gpio_mode@gpio116 {
				phandle = <0x5d>;

				pins_cmd_dat {
					pinmux = <0x7400>;
					drive-strength = <0x01>;
				};
			};

			camera4_mclk_2ma@gpio116 {
				phandle = <0x5e>;

				pins_cmd_dat {
					pinmux = <0x7401>;
					drive-strength = <0x00>;
				};
			};

			camera4_mclk_4ma@gpio116 {
				phandle = <0x5f>;

				pins_cmd_dat {
					pinmux = <0x7401>;
					drive-strength = <0x01>;
				};
			};

			camera4_mclk_6ma@gpio116 {
				phandle = <0x60>;

				pins_cmd_dat {
					pinmux = <0x7401>;
					drive-strength = <0x02>;
				};
			};

			camera4_mclk_8ma@gpio116 {
				phandle = <0x61>;

				pins_cmd_dat {
					pinmux = <0x7401>;
					drive-strength = <0x03>;
				};
			};

			camera_mipi_switch_low@gpio72 {
				phandle = <0x62>;

				pins_cmd_dat {
					pinmux = <0x4800>;
					output-low;
				};
			};

			camera_mipi_switch_high@gpio72 {
				phandle = <0x63>;

				pins_cmd_dat {
					pinmux = <0x4800>;
					output-high;
				};
			};

			camdefault {
				phandle = <0x3c>;
			};
		};
	};

	fragment@41 {
		target = <0xffffffff>;

		__overlay__ {
			pinctrl-names = "default\0cam0_rst0\0cam0_rst1\0cam0_ldo_vcamd_0\0cam0_ldo_vcamd_1\0cam1_rst0\0cam1_rst1\0cam2_rst0\0cam2_rst1\0cam3_pnd0\0cam3_pnd1\0cam4_pnd0\0cam4_pnd1\0cam0_mclk_off\0cam0_mclk_2mA\0cam0_mclk_4mA\0cam0_mclk_6mA\0cam0_mclk_8mA\0cam1_mclk_off\0cam1_mclk_2mA\0cam1_mclk_4mA\0cam1_mclk_6mA\0cam1_mclk_8mA\0cam2_mclk_off\0cam2_mclk_2mA\0cam2_mclk_4mA\0cam2_mclk_6mA\0cam2_mclk_8mA\0cam3_mclk_off\0cam3_mclk_2mA\0cam3_mclk_4mA\0cam3_mclk_6mA\0cam3_mclk_8mA\0cam4_mclk_off\0cam4_mclk_2mA\0cam4_mclk_4mA\0cam4_mclk_6mA\0cam4_mclk_8mA\0cam_mipi_switch_sel_0\0cam_mipi_switch_sel_1";
			pinctrl-0 = <0x3c>;
			pinctrl-1 = <0x3d>;
			pinctrl-2 = <0x3e>;
			pinctrl-3 = <0x3f>;
			pinctrl-4 = <0x40>;
			pinctrl-5 = <0x41>;
			pinctrl-6 = <0x42>;
			pinctrl-7 = <0x43>;
			pinctrl-8 = <0x44>;
			pinctrl-9 = <0x45>;
			pinctrl-10 = <0x46>;
			pinctrl-11 = <0x47>;
			pinctrl-12 = <0x48>;
			pinctrl-13 = <0x49>;
			pinctrl-14 = <0x4a>;
			pinctrl-15 = <0x4b>;
			pinctrl-16 = <0x4c>;
			pinctrl-17 = <0x4d>;
			pinctrl-18 = <0x4e>;
			pinctrl-19 = <0x4f>;
			pinctrl-20 = <0x50>;
			pinctrl-21 = <0x51>;
			pinctrl-22 = <0x52>;
			pinctrl-23 = <0x53>;
			pinctrl-24 = <0x54>;
			pinctrl-25 = <0x55>;
			pinctrl-26 = <0x56>;
			pinctrl-27 = <0x57>;
			pinctrl-28 = <0x58>;
			pinctrl-29 = <0x59>;
			pinctrl-30 = <0x5a>;
			pinctrl-31 = <0x5b>;
			pinctrl-32 = <0x5c>;
			pinctrl-33 = <0x5d>;
			pinctrl-34 = <0x5e>;
			pinctrl-35 = <0x5f>;
			pinctrl-36 = <0x60>;
			pinctrl-37 = <0x61>;
			pinctrl-38 = <0x62>;
			pinctrl-39 = <0x63>;
			cam0_vcamio-supply = <0xffffffff>;
			cam1_vcamio-supply = <0xffffffff>;
			cam2_vcamio-supply = <0xffffffff>;
			cam3_vcamio-supply = <0xffffffff>;
			cam4_vcamio-supply = <0xffffffff>;
			cam0_enable_sensor = "imx682_mipi_raw s5kgm1sp_mipi_raw salaa_qtech_main_s5kgm1sp";
			cam1_enable_sensor = "imx471_mipi_raw1";
			cam2_enable_sensor = "ov8856_mipi_raw sala_wide_ov8856";
			cam3_enable_sensor = "sala_ov02b10_mipi_raw";
			cam4_enable_sensor = "ov02b1b_mipi_mono";
			status = "okay";
		};
	};

	fragment@42 {
		target = <0xffffffff>;

		__overlay__ {

			adc_channel@ {
				compatible = "mediatek,adc_channel";
				mediatek,temperature0 = <0x00>;
				mediatek,temperature1 = <0x01>;
				mediatek,adc_fdd_rf_params_dynamic_custom_ch = <0x02>;
				status = "okay";
			};
		};
	};

	fragment@43 {
		target = <0xffffffff>;

		__overlay__ {
			io-channels = <0xffffffff 0x02>;
		};
	};

	fragment@44 {
		target = <0xffffffff>;

		__overlay__ {
			mediatek,clkbuf-quantity = <0x07>;
			mediatek,clkbuf-config = <0x02 0x01 0x01 0x02 0x00 0x00 0x01>;
			mediatek,clkbuf-output-impedance = <0x04 0x04 0x04 0x04 0x00 0x00 0x04>;
			mediatek,clkbuf-controls-for-desense = <0x00 0x04 0x00 0x03 0x00 0x00 0x00>;
			status = "okay";
		};
	};

	fragment@45 {
		target = <0xffffffff>;

		__overlay__ {
			#address-cells = <0x01>;
			#size-cells = <0x00>;
			clock-frequency = <0x61a80>;
			mediatek,use-open-drain;
		};
	};

	fragment@46 {
		target = <0xffffffff>;

		__overlay__ {
			#address-cells = <0x01>;
			#size-cells = <0x00>;
			clock-frequency = <0x61a80>;
			mediatek,use-open-drain;
		};
	};

	fragment@47 {
		target = <0xffffffff>;

		__overlay__ {
			#address-cells = <0x01>;
			#size-cells = <0x00>;
			clock-frequency = <0x61a80>;
			mediatek,use-open-drain;

			camera_main@1a {
				compatible = "mediatek,camera_main";
				reg = <0x1a>;
				status = "okay";
				phandle = <0x7f>;
			};

			camera_main_af@0c {
				compatible = "mediatek,camera_main_af";
				reg = <0x0c>;
				status = "okay";
				phandle = <0x80>;
			};

			camera_main_eeprom@50 {
				compatible = "mediatek,camera_main_eeprom";
				reg = <0x50>;
				status = "okay";
				phandle = <0x81>;
			};

			ccu_sensor_i2c_2_hw@33 {
				compatible = "mediatek,ccu_sensor_i2c_2_hw";
				reg = <0x33>;
				status = "okay";
				phandle = <0x82>;
			};
		};
	};

	fragment@48 {
		target = <0xffffffff>;

		__overlay__ {
			#address-cells = <0x01>;
			#size-cells = <0x00>;
			clock-frequency = <0x61a80>;
			mediatek,use-open-drain;

			nfc@08 {
				compatible = "mediatek,nfc";
				reg = <0x08>;
				status = "okay";
				phandle = <0x83>;
			};
		};
	};

	fragment@49 {
		target = <0xffffffff>;

		__overlay__ {
			#address-cells = <0x01>;
			#size-cells = <0x00>;
			clock-frequency = <0x61a80>;
			mediatek,use-open-drain;

			camera_sub@2d {
				compatible = "mediatek,camera_sub";
				reg = <0x2d>;
				status = "okay";
				phandle = <0x84>;
			};

			camera_sub_eeprom@52 {
				compatible = "mediatek,camera_sub_eeprom";
				reg = <0x52>;
				status = "okay";
				phandle = <0x85>;
			};

			camera_main_two@10 {
				compatible = "mediatek,camera_main_two";
				reg = <0x10>;
				status = "okay";
				phandle = <0x86>;
			};

			camera_main_two_af@0c {
				compatible = "mediatek,camera_main_two_af";
				reg = <0x0c>;
				status = "okay";
				phandle = <0x87>;
			};

			camera_main_two_eeprom@50 {
				compatible = "mediatek,camera_main_two_eeprom";
				reg = <0x50>;
				status = "okay";
				phandle = <0x88>;
			};

			ccu_sensor_i2c_4_hw@36 {
				compatible = "mediatek,ccu_sensor_i2c_4_hw";
				reg = <0x36>;
				status = "okay";
				phandle = <0x89>;
			};
		};
	};

	fragment@50 {
		target = <0xffffffff>;

		__overlay__ {
			#address-cells = <0x01>;
			#size-cells = <0x00>;
			clock-frequency = <0x33e140>;
			mediatek,use-push-pull;

			subpmic@34 {
				compatible = "mediatek,subpmic";
				reg = <0x34>;
				status = "okay";
				phandle = <0x8a>;
			};

			usb_type_c@4e {
				compatible = "mediatek,usb_type_c";
				reg = <0x4e>;
				status = "okay";
				phandle = <0x8b>;
			};

			subpmic_pmic@1a {
				compatible = "mediatek,subpmic_pmic";
				reg = <0x1a>;
				status = "okay";
				phandle = <0x8c>;
			};

			subpmic_ldo@64 {
				compatible = "mediatek,subpmic_ldo";
				reg = <0x64>;
				status = "okay";
				phandle = <0x8d>;
			};
		};
	};

	fragment@51 {
		target = <0xffffffff>;

		__overlay__ {
			#address-cells = <0x01>;
			#size-cells = <0x00>;
			clock-frequency = <0x61a80>;
			mediatek,use-open-drain;

			i2c_lcd_bias@73 {
				compatible = "mediatek,i2c_lcd_bias";
				reg = <0x73>;
				status = "okay";
				phandle = <0x8e>;
			};
		};
	};

	fragment@52 {
		target = <0xffffffff>;

		__overlay__ {
			#address-cells = <0x01>;
			#size-cells = <0x00>;
			clock-frequency = <0x186a0>;
			mediatek,use-open-drain;

			ccu_sensor_i2c_7_hw@43 {
				compatible = "mediatek,ccu_sensor_i2c_7_hw";
				reg = <0x43>;
				status = "okay";
				phandle = <0x8f>;
			};
		};
	};

	fragment@53 {
		target = <0xffffffff>;

		__overlay__ {
			#address-cells = <0x01>;
			#size-cells = <0x00>;
			clock-frequency = <0x61a80>;
			mediatek,use-open-drain;
		};
	};

	fragment@54 {
		target = <0xffffffff>;

		__overlay__ {
			#address-cells = <0x01>;
			#size-cells = <0x00>;
			clock-frequency = <0x33e140>;
			mediatek,use-open-drain;

			vproc_buck@6b {
				compatible = "mediatek,vproc_buck";
				reg = <0x6b>;
				status = "okay";
				phandle = <0x90>;
			};
		};
	};

	fragment@55 {
		target = <0xffffffff>;

		__overlay__ {
			GPIO_FDD_BAND_SUPPORT_DETECT_4TH_PIN = <0xffffffff 0x49 0x00>;
			GPIO_FDD_BAND_SUPPORT_DETECT_3RD_PIN = <0xffffffff 0x4a 0x00>;
			GPIO_FDD_BAND_SUPPORT_DETECT_1ST_PIN = <0xffffffff 0x57 0x00>;
			GPIO_FDD_BAND_SUPPORT_DETECT_2ND_PIN = <0xffffffff 0x58 0x00>;
			GPIO_SIM1_SIO = <0xffffffff 0x80 0x00>;
			GPIO_SIM1_SRST = <0xffffffff 0x81 0x00>;
			GPIO_SIM1_SCLK = <0xffffffff 0x82 0x00>;
			GPIO_SIM2_SCLK = <0xffffffff 0x83 0x00>;
			GPIO_SIM2_SRST = <0xffffffff 0x84 0x00>;
			GPIO_SIM2_SIO = <0xffffffff 0x85 0x00>;
			GPIO_SIM1_HOT_PLUG = <0xffffffff 0x8c 0x00>;
			GPIO_SIM2_HOT_PLUG = <0xffffffff 0x8d 0x00>;
		};
	};

	fragment@56 {
		target = <0xffffffff>;

		__overlay__ {
			gpio_init_default = <0x00 0x00 0x00 0x00 0x01 0x01 0x01 0x01 0x00 0x00 0x00 0x01 0x01 0x01 0x02 0x00 0x01 0x00 0x00 0x00 0x01 0x03 0x07 0x00 0x00 0x01 0x00 0x01 0x04 0x00 0x00 0x00 0x01 0x00 0x01 0x05 0x00 0x00 0x00 0x00 0x00 0x01 0x06 0x00 0x01 0x00 0x00 0x00 0x01 0x07 0x00 0x00 0x00 0x01 0x01 0x01 0x08 0x00 0x00 0x00 0x01 0x01 0x01 0x09 0x00 0x00 0x00 0x01 0x00 0x01 0x0a 0x00 0x00 0x00 0x01 0x01 0x01 0x0b 0x00 0x00 0x00 0x01 0x01 0x01 0x0c 0x00 0x00 0x00 0x01 0x01 0x00 0x0d 0x00 0x01 0x00 0x00 0x00 0x00 0x0e 0x00 0x01 0x00 0x00 0x00 0x00 0x0f 0x00 0x01 0x00 0x00 0x00 0x00 0x10 0x00 0x00 0x00 0x01 0x01 0x01 0x11 0x01 0x00 0x00 0x00 0x00 0x00 0x12 0x01 0x01 0x00 0x00 0x00 0x00 0x13 0x01 0x01 0x00 0x00 0x00 0x00 0x14 0x01 0x01 0x00 0x00 0x00 0x00 0x15 0x03 0x01 0x00 0x00 0x00 0x00 0x16 0x00 0x01 0x01 0x00 0x00 0x00 0x17 0x00 0x01 0x00 0x00 0x00 0x00 0x18 0x00 0x01 0x00 0x00 0x00 0x00 0x19 0x01 0x00 0x00 0x01 0x00 0x00 0x1a 0x00 0x01 0x00 0x00 0x00 0x00 0x1c 0x01 0x00 0x00 0x01 0x01 0x01 0x1d 0x01 0x00 0x00 0x01 0x01 0x01 0x1e 0x00 0x01 0x00 0x00 0x00 0x00 0x1f 0x00 0x01 0x00 0x00 0x00 0x00 0x20 0x00 0x01 0x00 0x00 0x00 0x00 0x21 0x00 0x00 0x00 0x01 0x00 0x00 0x22 0x00 0x01 0x00 0x00 0x00 0x00 0x23 0x06 0x00 0x00 0x01 0x00 0x00 0x24 0x06 0x00 0x00 0x00 0x00 0x00 0x25 0x06 0x00 0x00 0x01 0x00 0x00 0x26 0x06 0x01 0x00 0x00 0x00 0x00 0x27 0x06 0x00 0x00 0x01 0x00 0x00 0x28 0x06 0x00 0x00 0x01 0x00 0x00 0x29 0x06 0x00 0x00 0x01 0x00 0x00 0x2a 0x01 0x01 0x00 0x00 0x00 0x00 0x2b 0x01 0x00 0x00 0x01 0x00 0x00 0x2c 0x00 0x01 0x00 0x00 0x00 0x00 0x2d 0x01 0x00 0x00 0x01 0x01 0x01 0x2e 0x01 0x00 0x00 0x01 0x01 0x01 0x2f 0x01 0x00 0x00 0x01 0x00 0x00 0x30 0x01 0x01 0x00 0x00 0x00 0x00 0x31 0x01 0x01 0x00 0x00 0x00 0x00 0x32 0x01 0x01 0x00 0x00 0x00 0x00 0x33 0x01 0x00 0x00 0x01 0x01 0x01 0x34 0x01 0x00 0x00 0x01 0x01 0x01 0x35 0x01 0x00 0x00 0x01 0x01 0x00 0x36 0x01 0x01 0x01 0x00 0x00 0x00 0x37 0x01 0x00 0x00 0x01 0x01 0x01 0x38 0x01 0x00 0x00 0x01 0x01 0x01 0x39 0x00 0x00 0x00 0x01 0x00 0x00 0x3a 0x00 0x00 0x00 0x01 0x00 0x00 0x3b 0x01 0x00 0x00 0x01 0x01 0x00 0x3c 0x01 0x00 0x00 0x01 0x01 0x00 0x3d 0x02 0x00 0x00 0x01 0x01 0x01 0x3e 0x02 0x00 0x00 0x01 0x01 0x01 0x3f 0x02 0x00 0x00 0x01 0x00 0x00 0x40 0x02 0x01 0x00 0x00 0x00 0x00 0x41 0x02 0x01 0x00 0x00 0x00 0x00 0x42 0x02 0x01 0x00 0x00 0x00 0x00 0x43 0x00 0x00 0x00 0x00 0x00 0x01 0x44 0x00 0x00 0x00 0x00 0x00 0x01 0x45 0x00 0x00 0x00 0x01 0x01 0x01 0x46 0x01 0x00 0x00 0x01 0x00 0x00 0x47 0x01 0x01 0x00 0x00 0x00 0x01 0x48 0x01 0x00 0x00 0x01 0x00 0x00 0x49 0x00 0x00 0x00 0x00 0x00 0x00 0x4a 0x00 0x00 0x00 0x00 0x00 0x00 0x4b 0x01 0x00 0x00 0x01 0x00 0x00 0x4c 0x01 0x00 0x00 0x01 0x00 0x00 0x4d 0x01 0x00 0x00 0x01 0x00 0x00 0x4e 0x01 0x00 0x00 0x01 0x00 0x00 0x4f 0x01 0x00 0x00 0x01 0x00 0x00 0x50 0x01 0x00 0x00 0x01 0x00 0x00 0x51 0x01 0x00 0x00 0x01 0x00 0x00 0x52 0x01 0x00 0x00 0x01 0x00 0x00 0x53 0x01 0x00 0x00 0x01 0x00 0x00 0x54 0x01 0x00 0x00 0x01 0x00 0x00 0x55 0x01 0x00 0x00 0x01 0x00 0x00 0x56 0x01 0x00 0x00 0x01 0x00 0x00 0x57 0x00 0x00 0x00 0x00 0x00 0x00 0x58 0x00 0x00 0x00 0x00 0x00 0x00 0x59 0x01 0x00 0x00 0x01 0x00 0x00 0x5a 0x01 0x00 0x00 0x01 0x00 0x00 0x5b 0x01 0x00 0x00 0x01 0x00 0x00 0x5c 0x01 0x00 0x00 0x01 0x00 0x00 0x5d 0x01 0x00 0x00 0x01 0x00 0x00 0x5e 0x01 0x00 0x00 0x01 0x00 0x00 0x5f 0x01 0x00 0x00 0x01 0x00 0x00 0x60 0x01 0x00 0x00 0x01 0x00 0x00 0x61 0x01 0x00 0x00 0x01 0x00 0x00 0x62 0x01 0x00 0x00 0x01 0x00 0x00 0x63 0x01 0x00 0x00 0x01 0x00 0x00 0x64 0x01 0x00 0x00 0x01 0x00 0x00 0x65 0x01 0x00 0x00 0x01 0x00 0x00 0x66 0x01 0x00 0x00 0x01 0x00 0x00 0x67 0x01 0x00 0x00 0x01 0x00 0x00 0x68 0x01 0x00 0x00 0x01 0x00 0x00 0x69 0x00 0x01 0x00 0x01 0x01 0x00 0x6a 0x01 0x00 0x00 0x01 0x00 0x00 0x6b 0x01 0x00 0x00 0x01 0x00 0x00 0x6c 0x01 0x00 0x00 0x01 0x00 0x00 0x6d 0x00 0x00 0x00 0x00 0x00 0x00 0x6e 0x01 0x00 0x00 0x01 0x01 0x01 0x6f 0x01 0x00 0x00 0x01 0x01 0x01 0x70 0x01 0x00 0x00 0x01 0x01 0x01 0x71 0x01 0x00 0x00 0x01 0x01 0x01 0x72 0x00 0x01 0x00 0x00 0x00 0x00 0x73 0x00 0x01 0x00 0x00 0x00 0x00 0x74 0x01 0x01 0x00 0x00 0x00 0x00 0x75 0x01 0x01 0x00 0x00 0x00 0x00 0x76 0x00 0x01 0x00 0x00 0x00 0x00 0x77 0x00 0x01 0x00 0x00 0x00 0x00 0x78 0x01 0x01 0x00 0x00 0x00 0x00 0x79 0x01 0x01 0x00 0x00 0x00 0x00 0x7a 0x00 0x01 0x00 0x00 0x00 0x00 0x7b 0x00 0x01 0x00 0x00 0x00 0x00 0x7c 0x00 0x01 0x00 0x00 0x00 0x00 0x7d 0x00 0x01 0x00 0x00 0x00 0x00 0x7e 0x00 0x01 0x00 0x00 0x00 0x00 0x7f 0x00 0x01 0x00 0x00 0x00 0x00 0x80 0x01 0x00 0x00 0x01 0x01 0x01 0x81 0x01 0x01 0x00 0x00 0x00 0x01 0x82 0x01 0x01 0x00 0x00 0x00 0x01 0x83 0x01 0x01 0x00 0x00 0x00 0x01 0x84 0x01 0x01 0x00 0x00 0x00 0x01 0x85 0x01 0x00 0x00 0x01 0x01 0x01 0x86 0x01 0x01 0x00 0x00 0x00 0x01 0x87 0x01 0x00 0x00 0x01 0x01 0x01 0x88 0x01 0x00 0x00 0x01 0x01 0x01 0x89 0x01 0x00 0x00 0x01 0x01 0x01 0x8a 0x01 0x00 0x00 0x01 0x01 0x01 0x8b 0x01 0x00 0x00 0x01 0x01 0x01 0x8c 0x01 0x00 0x00 0x01 0x01 0x01 0x8d 0x01 0x00 0x00 0x01 0x01 0x01 0x8e 0x01 0x01 0x00 0x00 0x00 0x00 0x8f 0x01 0x01 0x00 0x00 0x00 0x01 0x90 0x01 0x01 0x00 0x00 0x00 0x01 0x91 0x01 0x01 0x00 0x00 0x00 0x01 0x92 0x01 0x00 0x00 0x01 0x00 0x01 0x93 0x00 0x00 0x00 0x01 0x00 0x00 0x94 0x00 0x00 0x00 0x01 0x00 0x00 0x95 0x00 0x00 0x00 0x01 0x00 0x00 0x96 0x01 0x01 0x00 0x00 0x00 0x00 0x97 0x01 0x00 0x00 0x01 0x01 0x01 0x98 0x01 0x00 0x00 0x01 0x01 0x01 0x99 0x01 0x01 0x00 0x01 0x01 0x00 0x9a 0x00 0x00 0x00 0x01 0x00 0x00 0x9b 0x00 0x01 0x00 0x00 0x00 0x00 0x9c 0x00 0x01 0x00 0x00 0x00 0x00 0x9d 0x00 0x01 0x00 0x00 0x00 0x00 0x9e 0x00 0x01 0x00 0x00 0x00 0x00 0x9f 0x00 0x01 0x00 0x00 0x00 0x00 0xa0 0x00 0x01 0x00 0x00 0x00 0x00 0xa1 0x00 0x01 0x00 0x00 0x00 0x00 0xa2 0x00 0x01 0x00 0x00 0x00 0x00 0xa3 0x00 0x01 0x00 0x00 0x00 0x00 0xa4 0x00 0x01 0x00 0x00 0x00 0x00 0xa5 0x01 0x01 0x00 0x01 0x01 0x00 0xa6 0x01 0x00 0x00 0x01 0x01 0x00 0xb3 0x01 0x00 0x00 0x01 0x00 0x00 0xb4 0x01 0x00 0x00 0x01 0x00 0x00 0xb5 0x01 0x01 0x00 0x00 0x00 0x00 0xb6 0x01 0x01 0x00 0x00 0x00 0x00 0xb7 0x01 0x01 0x00 0x00 0x00 0x00 0xb8 0x01 0x00 0x00 0x01 0x00 0x00 0xb9 0x01 0x01 0x00 0x00 0x00 0x00 0xba 0x01 0x00 0x00 0x01 0x00 0x00 0xbb 0x01 0x01 0x00 0x00 0x00 0x00 0xbc 0x01 0x00 0x00 0x01 0x00 0x01 0xbd 0x01 0x01 0x00 0x00 0x00 0x01 0xbe 0x01 0x01 0x00 0x00 0x00 0x01 0xbf 0x01 0x01 0x00 0x00 0x00 0x01 0xc0 0x01 0x01 0x00 0x00 0x00 0x01 0xc1 0x01 0x00 0x00 0x01 0x00 0x01 0xc2 0x01 0x00 0x00 0x01 0x00 0x01 0xc3 0x00 0x01 0x00 0x00 0x00 0x00 0xc4 0x01 0x01 0x00 0x00 0x00 0x00 0xc5 0x00 0x01 0x00 0x00 0x00 0x00 0xc6 0x01 0x00 0x00 0x01 0x01 0x01 0xc7 0x01 0x00 0x00 0x01 0x01 0x01 0xc8 0x01 0x00 0x00 0x01 0x01 0x00 0xc9 0x01 0x01 0x00 0x00 0x00 0x00 0xca 0x00 0x01 0x00 0x00 0x00 0x00 0xcb 0x00 0x00 0x00 0x01 0x00 0x00 0xcc 0x00 0x00 0x00 0x01 0x00 0x00 0xcd 0x00 0x00 0x00 0x01 0x00 0x00 0xce 0x00 0x00 0x00 0x01 0x00 0x00 0xcf 0x00 0x00 0x00 0x01 0x00 0x00 0xd0 0x00 0x00 0x00 0x01 0x00 0x00 0xd1 0x00 0x00 0x00 0x01 0x00 0x00 0xd2 0x00 0x00 0x00 0x01 0x00 0x00>;
		};
	};

	fragment@57 {
		target = <0xffffffff>;

		__overlay__ {
			interrupt-parent = <0xffffffff>;
			interrupts = <0x00 0x08 0x00 0x00>;
			deb-gpios = <0xffffffff 0x00 0x00>;
			debounce = <0x7d000>;
			status = "okay";
		};
	};

	fragment@58 {
		target = <0xffffffff>;

		__overlay__ {
			interrupt-parent = <0xffffffff>;
			interrupts = <0x01 0x02 0x01 0x00>;
			status = "okay";
		};
	};

	fragment@59 {
		target = <0xffffffff>;

		__overlay__ {
			interrupt-parent = <0xffffffff>;
			interrupts = <0x05 0x04 0x05 0x00>;
			status = "okay";
		};
	};

	fragment@60 {
		target = <0xffffffff>;

		__overlay__ {
			interrupt-parent = <0xffffffff>;
			interrupts = <0x07 0x02 0x07 0x00>;
			status = "okay";
		};
	};

	fragment@61 {
		target = <0xffffffff>;

		__overlay__ {
			interrupt-parent = <0xffffffff>;
			interrupts = <0x08 0x08 0x08 0x00>;
			status = "okay";
		};
	};

	fragment@62 {
		target = <0xffffffff>;

		__overlay__ {
			interrupt-parent = <0xffffffff>;
			interrupts = <0x10 0x02 0x10 0x00>;
			status = "okay";
		};
	};

	fragment@63 {
		target = <0xffffffff>;

		__overlay__ {
			interrupt-parent = <0xffffffff>;
			interrupts = <0x2b 0x01 0x2b 0x01>;
			status = "okay";
		};
	};

	fragment@64 {
		target = <0xffffffff>;

		__overlay__ {
			interrupt-parent = <0xffffffff>;
			interrupts = <0x45 0x08 0x45 0x00>;
			status = "okay";
		};
	};

	fragment@65 {
		target = <0xffffffff>;

		__overlay__ {
			interrupt-parent = <0xffffffff>;
			interrupts = <0x4b 0x02 0x4b 0x01>;
			status = "okay";
		};
	};

	fragment@66 {
		target = <0xffffffff>;

		__overlay__ {
			interrupt-parent = <0xffffffff>;
			interrupts = <0x6d 0x04 0x6d 0x00>;
			deb-gpios = <0xffffffff 0x6d 0x00>;
			debounce = <0x7d000>;
			status = "okay";
		};
	};

	fragment@67 {
		target = <0xffffffff>;

		__overlay__ {
			interrupt-parent = <0xffffffff>;
			interrupts = <0xc1 0x04 0xd1 0x00>;
			status = "okay";
		};
	};

	fragment@68 {
		target = <0xffffffff>;

		__overlay__ {
			compatible = "mediatek,md1_sim1_hot_plug_eint-eint";
			interrupts = <0x00 0x08>;
			debounce = <0x00 0xc350>;
			dedicated = <0x00 0x00>;
			src_pin = <0x00 0x01>;
			sockettype = <0x00 0x00>;
			status = "okay";
		};
	};

	fragment@69 {
		target = <0xffffffff>;

		__overlay__ {
			compatible = "mediatek,md1_sim2_hot_plug_eint-eint";
			interrupts = <0x01 0x08>;
			debounce = <0x01 0xc350>;
			dedicated = <0x01 0x00>;
			src_pin = <0x01 0x02>;
			sockettype = <0x01 0x00>;
			status = "okay";
		};
	};

	fragment@70 {
		target = <0xffffffff>;

		__overlay__ {
			regulator-name = "vcamio";
			regulator-default-on = <0x01>;
			status = "okay";
		};
	};

	fragment@71 {
		target = <0xffffffff>;

		__overlay__ {
			vcamio-supply = <0xffffffff>;
			vcamio_sub-supply = <0xffffffff>;
			vcamio_main2-supply = <0xffffffff>;
			vcamaf-supply = <0xffffffff>;
			vcamaf_main2-supply = <0xffffffff>;
			status = "okay";
		};
	};

	fragment@72 {
		target = <0xffffffff>;

		__overlay__ {
			vtouch-supply = <0x64>;
			status = "okay";
		};
	};

	fragment@73 {
		target = <0xffffffff>;

		__overlay__ {
			mediatek,kpd-key-debounce = <0x400>;
			mediatek,kpd-sw-pwrkey = <0x74>;
			mediatek,kpd-hw-pwrkey = <0x08>;
			mediatek,kpd-sw-rstkey = <0x73>;
			mediatek,kpd-hw-rstkey = <0x11>;
			mediatek,kpd-use-extend-type = <0x00>;
			mediatek,kpd-hw-map-num = <0x48>;
			mediatek,kpd-hw-init-map = <0x00 0x72 0x00 0x00 0x00 0x00 0x00 0x00 0x00 0x00 0x00 0x00 0x00 0x00 0x00 0x00 0x00 0x00 0x00 0x00 0x00 0x00 0x00 0x00 0x00 0x00 0x00 0x00 0x00 0x00 0x00 0x00 0x00 0x00 0x00 0x00 0x00 0x00 0x00 0x00 0x00 0x00 0x00 0x00 0x00 0x00 0x00 0x00 0x00 0x00 0x00 0x00 0x00 0x00 0x00 0x00 0x00 0x00 0x00 0x00 0x00 0x00 0x00 0x00 0x00 0x00 0x00 0x00 0x00 0x00 0x00 0x00>;
			mediatek,kpd-pwrkey-eint-gpio = <0x00>;
			mediatek,kpd-pwkey-gpio-din = <0x00>;
			mediatek,kpd-hw-dl-key0 = <0x11>;
			mediatek,kpd-hw-dl-key1 = <0x01>;
			mediatek,kpd-hw-recovery-key = <0x01>;
			mediatek,kpd-hw-factory-key = <0x11>;
			status = "okay";
		};
	};

	__symbols__ {
		led0 = "/fragment@4/__overlay__/led@0";
		led1 = "/fragment@4/__overlay__/led@1";
		led2 = "/fragment@4/__overlay__/led@2";
		led3 = "/fragment@4/__overlay__/led@3";
		led4 = "/fragment@4/__overlay__/led@4";
		led5 = "/fragment@4/__overlay__/led@5";
		led6 = "/fragment@4/__overlay__/led@6";
		vibrator0 = "/fragment@4/__overlay__/vibrator@0";
		usb_c_pinctrl = "/fragment@4/__overlay__/usb_c_pinctrl";
		kpd_volume_down = "/fragment@4/__overlay__/kpd_volume_down";
		gsensor_1 = "/fragment@4/__overlay__/gsensor_1";
		gsensor_2 = "/fragment@4/__overlay__/gsensor_2";
		msensor_1 = "/fragment@4/__overlay__/msensor_1";
		msensor_2 = "/fragment@4/__overlay__/msensor_2";
		proximity_1 = "/fragment@4/__overlay__/proximity_1";
		light_1 = "/fragment@4/__overlay__/light_1";
		pick_up = "/fragment@4/__overlay__/pick_up";
		lux_aod = "/fragment@4/__overlay__/lux_aod";
		mtk_cali = "/fragment@4/__overlay__/mtk_cali";
		alsps_arch = "/fragment@4/__overlay__/alsps_arch";
		oplus_project = "/fragment@4/__overlay__/oplus_project";
		oplus_devinfo = "/fragment@4/__overlay__/oplus_devinfo";
		nfc_chipset = "/fragment@4/__overlay__/nfc_chipset";
		mtkfb_pins_lcd_bias_enp1 = "/fragment@5/__overlay__/lcd_bias_enp1_gpio";
		mtkfb_pins_lcd_bias_enp0 = "/fragment@5/__overlay__/lcd_bias_enp0_gpio";
		mtkfb_pins_lcd_bias_enn1 = "/fragment@5/__overlay__/lcd_bias_enn1_gpio";
		mtkfb_pins_lcd_bias_enn0 = "/fragment@5/__overlay__/lcd_bias_enn0_gpio";
		mtkfb_pins_lcm_rst_out1_gpio = "/fragment@5/__overlay__/lcm_rst_out1_gpio";
		mtkfb_pins_lcm_rst_out0_gpio = "/fragment@5/__overlay__/lcm_rst_out0_gpio";
		mtkfb_pins_lcm_dsi_te = "/fragment@5/__overlay__/lcm_dsi_te";
		mt_pmic_vtp_ldo_reg = "/fragment@7/__overlay__/ldo2";
		panel_in = "/fragment@12/__overlay__/panel@0/port/endpoint";
		dsi_out = "/fragment@12/__overlay__/ports/port/endpoint";
		usb_default = "/fragment@20/__overlay__/usb_default";
		gpio_redriver_c1_init = "/fragment@20/__overlay__/c1_init";
		gpio_redriver_c1_low = "/fragment@20/__overlay__/c1_low";
		gpio_redriver_c1_hiz = "/fragment@20/__overlay__/c1_highz";
		gpio_redriver_c1_high = "/fragment@20/__overlay__/c1_high";
		gpio_redriver_c2_init = "/fragment@20/__overlay__/c2_init";
		gpio_redriver_c2_low = "/fragment@20/__overlay__/c2_low";
		gpio_redriver_c2_hiz = "/fragment@20/__overlay__/c2_highz";
		gpio_redriver_c2_high = "/fragment@20/__overlay__/c2_high";
		gpio_u3_switch_sel1 = "/fragment@20/__overlay__/u3_sw_sel1";
		gpio_u3_switch_sel2 = "/fragment@20/__overlay__/u3_sw_sel2";
		gpio_u3_switch_enable = "/fragment@20/__overlay__/u3_sw_en";
		gpio_u3_switch_disable = "/fragment@20/__overlay__/u3_sw_dis";
		volume_up_gpio_eint = "/fragment@22/__overlay__/volume_up@0";
		volume_down_gpio_eint = "/fragment@22/__overlay__/volume_down@0";
		consys_pins_default = "/fragment@23/__overlay__/consys_default";
		gpslna_pins_init = "/fragment@23/__overlay__/gpslna@0";
		gpslna_pins_oh = "/fragment@23/__overlay__/gpslna@1";
		gpslna_pins_ol = "/fragment@23/__overlay__/gpslna@2";
		fpc_reset_default = "/fragment@25/__overlay__/fpc_reset_default";
		fpc_irq_default = "/fragment@25/__overlay__/fpc_irq_default";
		fpc_pwr_default = "/fragment@25/__overlay__/fpc_pwr_default";
		gpio_fpc_cs_func = "/fragment@25/__overlay__/gpio_fpc_cs_func";
		goodix_reset_default = "/fragment@27/__overlay__/goodix_reset_default";
		goodix_irq_out_low = "/fragment@27/__overlay__/goodix_irq_out_low";
		goodix_irq_no_pull = "/fragment@27/__overlay__/goodix_irq_no_pull";
		oplus_fp = "/fragment@29/__overlay__/fingerprint@0";
		gpio_id0_default = "/fragment@30/__overlay__/gpio_id0_default";
		gpio_id0_pull_up = "/fragment@30/__overlay__/gpio_id0_pull_up";
		gpio_id0_pull_down = "/fragment@30/__overlay__/gpio_id0_pull_down";
		vooc_ap_data = "/fragment@32/__overlay__/vooc_ap_data";
		vooc_ap_data_new_function = "/fragment@32/__overlay__/vooc_ap_data_new_function";
		charger_pins_eint_output0 = "/fragment@33/__overlay__/charger_gpio_as_output_low";
		charger_pins_eint_output1 = "/fragment@33/__overlay__/charger_gpio_as_output_high";
		ship_sleep_gpio = "/fragment@33/__overlay__/ship_sleep";
		ship_active_gpio = "/fragment@33/__overlay__/ship_active";
		charging_enable_gpio = "/fragment@33/__overlay__/dischg_disable";
		charging_disable_gpio = "/fragment@33/__overlay__/dischg_enable";
		chgvin_enable = "/fragment@33/__overlay__/chgvin_enable";
		chgvin_disable = "/fragment@33/__overlay__/chgvin_disable";
		charging_switch1_active = "/fragment@34/__overlay__/charging_switch1_active";
		charging_switch1_sleep = "/fragment@34/__overlay__/charging_switch1_sleep";
		charging_clock_active = "/fragment@34/__overlay__/charging_clock_active";
		charging_clock_sleep = "/fragment@34/__overlay__/charging_clock_sleep";
		charging_data_active = "/fragment@34/__overlay__/charging_data_active";
		charging_data_sleep = "/fragment@34/__overlay__/charging_data_sleep";
		charging_reset_active = "/fragment@34/__overlay__/charging_reset_active";
		charging_reset_sleep = "/fragment@34/__overlay__/charging_reset_sleep";
		mps_otg_en_active = "/fragment@35/__overlay__/mps_otg_en_active";
		mps_otg_en_sleep = "/fragment@35/__overlay__/mps_otg_en_sleep";
		mps_otg_en_default = "/fragment@35/__overlay__/mps_otg_en_default";
		uart0_rx_gpio_input = "/fragment@37/__overlay__/uart0_rx_gpio@gpio53";
		uart0_tx_gpio_input = "/fragment@37/__overlay__/uart0_tx_gpio@gpio54";
		camera0_rst_low = "/fragment@40/__overlay__/camera0_rst_output_low@gpio119";
		camera0_rst_high = "/fragment@40/__overlay__/camera0_rst_output_high@gpio119";
		camera0_vcamd_off = "/fragment@40/__overlay__/camera0_vcamd_output_low@gpio123";
		camera0_vcamd_on = "/fragment@40/__overlay__/camera0_vcamd_output_high@gpio123";
		camera1_rst_low = "/fragment@40/__overlay__/camera1_rst_output_low@gpio124";
		camera1_rst_high = "/fragment@40/__overlay__/camera1_rst_output_high@gpio124";
		camera2_rst_low = "/fragment@40/__overlay__/camera2_rst_output_low@gpio197";
		camera2_rst_high = "/fragment@40/__overlay__/camera2_rst_output_high@gpio197";
		camera3_pnd_low = "/fragment@40/__overlay__/camera3_pnd_output_low@gpio125";
		camera3_pnd_high = "/fragment@40/__overlay__/camera3_pnd_output_high@gpio125";
		camera4_pnd_low = "/fragment@40/__overlay__/camera4_pnd_output_low@gpio118";
		camera4_pnd_high = "/fragment@40/__overlay__/camera4_pnd_output_high@gpio118";
		camera0_mclk_off = "/fragment@40/__overlay__/camera0_mclk_gpio_mode@gpio117";
		camera0_mclk_2ma = "/fragment@40/__overlay__/camera0_mclk_2ma@gpio117";
		camera0_mclk_4ma = "/fragment@40/__overlay__/camera0_mclk_4ma@gpio117";
		camera0_mclk_6ma = "/fragment@40/__overlay__/camera0_mclk_6ma@gpio117";
		camera0_mclk_8ma = "/fragment@40/__overlay__/camera0_mclk_8ma@gpio117";
		camera1_mclk_off = "/fragment@40/__overlay__/camera1_mclk_gpio_mode@gpio196";
		camera1_mclk_2ma = "/fragment@40/__overlay__/camera1_mclk_2ma@gpio196";
		camera1_mclk_4ma = "/fragment@40/__overlay__/camera1_mclk_4ma@gpio196";
		camera1_mclk_6ma = "/fragment@40/__overlay__/camera1_mclk_6ma@gpio196";
		camera1_mclk_8ma = "/fragment@40/__overlay__/camera1_mclk_8ma@gpio196";
		camera2_mclk_off = "/fragment@40/__overlay__/camera2_mclk_gpio_mode@gpio120";
		camera2_mclk_2ma = "/fragment@40/__overlay__/camera2_mclk_2ma@gpio120";
		camera2_mclk_4ma = "/fragment@40/__overlay__/camera2_mclk_4ma@gpio120";
		camera2_mclk_6ma = "/fragment@40/__overlay__/camera2_mclk_6ma@gpio120";
		camera2_mclk_8ma = "/fragment@40/__overlay__/camera2_mclk_8ma@gpio120";
		camera3_mclk_off = "/fragment@40/__overlay__/camera3_mclk_gpio_mode@gpio121";
		camera3_mclk_2ma = "/fragment@40/__overlay__/camera3_mclk_2ma@gpio121";
		camera3_mclk_4ma = "/fragment@40/__overlay__/camera3_mclk_4ma@gpio121";
		camera3_mclk_6ma = "/fragment@40/__overlay__/camera3_mclk_6ma@gpio121";
		camera3_mclk_8ma = "/fragment@40/__overlay__/camera3_mclk_8ma@gpio121";
		camera4_mclk_off = "/fragment@40/__overlay__/camera4_mclk_gpio_mode@gpio116";
		camera4_mclk_2ma = "/fragment@40/__overlay__/camera4_mclk_2ma@gpio116";
		camera4_mclk_4ma = "/fragment@40/__overlay__/camera4_mclk_4ma@gpio116";
		camera4_mclk_6ma = "/fragment@40/__overlay__/camera4_mclk_6ma@gpio116";
		camera4_mclk_8ma = "/fragment@40/__overlay__/camera4_mclk_8ma@gpio116";
		camera_mipi_switch_low = "/fragment@40/__overlay__/camera_mipi_switch_low@gpio72";
		camera_mipi_switch_high = "/fragment@40/__overlay__/camera_mipi_switch_high@gpio72";
		camera_pins_default = "/fragment@40/__overlay__/camdefault";
		camera_main_mtk = "/fragment@47/__overlay__/camera_main@1a";
		camera_main_af_mtk = "/fragment@47/__overlay__/camera_main_af@0c";
		camera_main_eeprom_mtk = "/fragment@47/__overlay__/camera_main_eeprom@50";
		ccu_sensor_i2c_2_hw_mtk = "/fragment@47/__overlay__/ccu_sensor_i2c_2_hw@33";
		nfc_mtk = "/fragment@48/__overlay__/nfc@08";
		camera_sub_mtk = "/fragment@49/__overlay__/camera_sub@2d";
		camera_sub_eeprom_mtk = "/fragment@49/__overlay__/camera_sub_eeprom@52";
		camera_main_two_mtk = "/fragment@49/__overlay__/camera_main_two@10";
		camera_main_two_af_mtk = "/fragment@49/__overlay__/camera_main_two_af@0c";
		camera_main_two_eeprom_mtk = "/fragment@49/__overlay__/camera_main_two_eeprom@50";
		ccu_sensor_i2c_4_hw_mtk = "/fragment@49/__overlay__/ccu_sensor_i2c_4_hw@36";
		subpmic_mtk = "/fragment@50/__overlay__/subpmic@34";
		usb_type_c_mtk = "/fragment@50/__overlay__/usb_type_c@4e";
		subpmic_pmic_mtk = "/fragment@50/__overlay__/subpmic_pmic@1a";
		subpmic_ldo_mtk = "/fragment@50/__overlay__/subpmic_ldo@64";
		i2c_lcd_bias_mtk = "/fragment@51/__overlay__/i2c_lcd_bias@73";
		ccu_sensor_i2c_7_hw_mtk = "/fragment@52/__overlay__/ccu_sensor_i2c_7_hw@43";
		vproc_buck_mtk = "/fragment@54/__overlay__/vproc_buck@6b";
	};

	__fixups__ {
		reserved_memory = "/fragment@0:target:0";
		chosen = "/fragment@1:target:0";
		spi3 = "/fragment@2:target:0";
		pio = "/fragment@2/__overlay__/novatek@0:reset-gpio:0\0/fragment@2/__overlay__/novatek@0:interrupt-parent:0\0/fragment@2/__overlay__/novatek@0:irq-gpio:0\0/fragment@4/__overlay__/kpd_volume_down:interrupt-parent:0\0/fragment@4/__overlay__/oplus_sim_detect:Hw,sim_det:0\0/fragment@4/__overlay__/oplus_devinfo:sdcard-gpio:0\0/fragment@5:target:0\0/fragment@12/__overlay__/panel@0:pm-enable-gpios:0\0/fragment@12/__overlay__/panel@0:reset-gpios:0\0/fragment@12/__overlay__/panel@0:bias-gpios:0\0/fragment@12/__overlay__/panel@0:bias-gpios:12\0/fragment@15/__overlay__/aw87339@58:reset-gpio:0\0/fragment@16/__overlay__/nfc_nxp@28:nxp,pn544-irq:0\0/fragment@16/__overlay__/nfc_nxp@28:nxp,pn544-ven:0\0/fragment@16/__overlay__/nfc_nxp@28:nxp,pn544-fw-dwnld:0\0/fragment@16/__overlay__/nfc_nxp@28:interrupt-parent:0\0/fragment@17/__overlay__:mt6360,intr_gpio:0\0/fragment@19/__overlay__:mt6360pd,intr_gpio:0\0/fragment@20:target:0\0/fragment@21/__overlay__:keypad,volume-up:0\0/fragment@21/__overlay__:keypad,volume-down:0\0/fragment@22:target:0\0/fragment@23:target:0\0/fragment@25:target:0\0/fragment@26/__overlay__:fpc,irq-gpio:0\0/fragment@26/__overlay__:fpc,reset-gpio:0\0/fragment@26/__overlay__:fpc,vdd-en:0\0/fragment@26/__overlay__:fpc,gpio_cs:0\0/fragment@26/__overlay__:pw_en_gpio:0\0/fragment@27:target:0\0/fragment@28/__overlay__:interrupt-parent:0\0/fragment@28/__overlay__:goodix,gpio_irq:0\0/fragment@28/__overlay__:goodix,gpio_reset:0\0/fragment@29/__overlay__/fingerprint@0:fpc,pw_en:0\0/fragment@30:target:0\0/fragment@31/__overlay__:oplus,fp_gpio_0:0\0/fragment@33:target:0\0/fragment@34:target:0\0/fragment@35:target:0\0/fragment@37:target:0\0/fragment@38/__overlay__:qcom,chargerid_switch-gpio:0\0/fragment@38/__overlay__:qcom,ship-gpio:0\0/fragment@38/__overlay__:qcom,dischg-gpio:0\0/fragment@38/__overlay__:qcom,chgvin:0\0/fragment@39/__overlay__/mp2650-charger@5c:qcom,mps_otg_en-gpio:0\0/fragment@39/__overlay__/rk826_fastcg@0a:qcom,charging_switch1-gpio:0\0/fragment@39/__overlay__/rk826_fastcg@0a:qcom,charging_reset-gpio:0\0/fragment@39/__overlay__/rk826_fastcg@0a:qcom,charging_clock-gpio:0\0/fragment@39/__overlay__/rk826_fastcg@0a:qcom,charging_data-gpio:0\0/fragment@40:target:0\0/fragment@55/__overlay__:GPIO_FDD_BAND_SUPPORT_DETECT_4TH_PIN:0\0/fragment@55/__overlay__:GPIO_FDD_BAND_SUPPORT_DETECT_3RD_PIN:0\0/fragment@55/__overlay__:GPIO_FDD_BAND_SUPPORT_DETECT_1ST_PIN:0\0/fragment@55/__overlay__:GPIO_FDD_BAND_SUPPORT_DETECT_2ND_PIN:0\0/fragment@55/__overlay__:GPIO_SIM1_SIO:0\0/fragment@55/__overlay__:GPIO_SIM1_SRST:0\0/fragment@55/__overlay__:GPIO_SIM1_SCLK:0\0/fragment@55/__overlay__:GPIO_SIM2_SCLK:0\0/fragment@55/__overlay__:GPIO_SIM2_SRST:0\0/fragment@55/__overlay__:GPIO_SIM2_SIO:0\0/fragment@55/__overlay__:GPIO_SIM1_HOT_PLUG:0\0/fragment@55/__overlay__:GPIO_SIM2_HOT_PLUG:0\0/fragment@57/__overlay__:interrupt-parent:0\0/fragment@57/__overlay__:deb-gpios:0\0/fragment@58/__overlay__:interrupt-parent:0\0/fragment@59/__overlay__:interrupt-parent:0\0/fragment@60/__overlay__:interrupt-parent:0\0/fragment@61/__overlay__:interrupt-parent:0\0/fragment@62/__overlay__:interrupt-parent:0\0/fragment@63/__overlay__:interrupt-parent:0\0/fragment@64/__overlay__:interrupt-parent:0\0/fragment@65/__overlay__:interrupt-parent:0\0/fragment@66/__overlay__:interrupt-parent:0\0/fragment@66/__overlay__:deb-gpios:0\0/fragment@67/__overlay__:interrupt-parent:0";
		i2c2 = "/fragment@3:target:0\0/fragment@47:target:0";
		odm = "/fragment@4:target:0\0/fragment@9:target:0\0/fragment@32:target:0";
		camera_af_hw_node = "/fragment@6:target:0";
		mt_pmic_vcamio_ldo_reg = "/fragment@6/__overlay__:vcamaf-supply:0\0/fragment@41/__overlay__:cam0_vcamio-supply:0\0/fragment@41/__overlay__:cam1_vcamio-supply:0\0/fragment@41/__overlay__:cam2_vcamio-supply:0\0/fragment@41/__overlay__:cam3_vcamio-supply:0\0/fragment@41/__overlay__:cam4_vcamio-supply:0\0/fragment@70:target:0\0/fragment@71/__overlay__:vcamio-supply:0\0/fragment@71/__overlay__:vcamio_sub-supply:0\0/fragment@71/__overlay__:vcamio_main2-supply:0\0/fragment@71/__overlay__:vcamaf-supply:0\0/fragment@71/__overlay__:vcamaf_main2-supply:0";
		mt6360_ldo = "/fragment@7:target:0\0/fragment@8:target:0";
		mtkfb = "/fragment@10:target:0";
		dispsys_config = "/fragment@11:target:0";
		dsi0 = "/fragment@12:target:0";
		accdet = "/fragment@13:target:0";
		snd_audio_dsp = "/fragment@14:target:0";
		i2c6 = "/fragment@15:target:0\0/fragment@51:target:0";
		i2c3 = "/fragment@16:target:0\0/fragment@48:target:0";
		mt6360_pmu = "/fragment@17:target:0";
		mt6360_pmic = "/fragment@18:target:0";
		mt6360_typec = "/fragment@19:target:0";
		keypad = "/fragment@21:target:0\0/fragment@73:target:0";
		consys = "/fragment@24:target:0";
		fpc_interrupt = "/fragment@26:target:0";
		goodix_fp = "/fragment@28:target:0\0/fragment@65:target:0";
		spi0 = "/fragment@29:target:0";
		mt_pmic_vfp_ldo_reg = "/fragment@29/__overlay__/fingerprint@0:vfp-supply:0";
		oplus_fp_common = "/fragment@31:target:0";
		apuart0 = "/fragment@36:target:0";
		charger = "/fragment@38:target:0";
		auxadc = "/fragment@38/__overlay__:io-channels:0\0/fragment@38/__overlay__:io-channels:8\0/fragment@38/__overlay__:io-channels:16\0/fragment@38/__overlay__:io-channels:24\0/fragment@42:target:0\0/fragment@43/__overlay__:io-channels:0";
		i2c7 = "/fragment@39:target:0\0/fragment@52:target:0";
		kd_camera_hw1 = "/fragment@41:target:0\0/fragment@71:target:0";
		md_auxadc = "/fragment@43:target:0";
		pmic_clock_buffer_ctrl = "/fragment@44:target:0";
		i2c0 = "/fragment@45:target:0";
		i2c1 = "/fragment@46:target:0";
		i2c4 = "/fragment@49:target:0";
		i2c5 = "/fragment@50:target:0";
		i2c8 = "/fragment@53:target:0";
		i2c9 = "/fragment@54:target:0";
		gpio_usage_mapping = "/fragment@55:target:0";
		gpio = "/fragment@56:target:0";
		mrdump_ext_rst = "/fragment@57:target:0";
		touch = "/fragment@58:target:0\0/fragment@72:target:0";
		irq_nfc = "/fragment@59:target:0";
		tcpc_pd = "/fragment@60:target:0";
		msdc1_ins = "/fragment@61:target:0";
		subpmic_pmu_eint = "/fragment@62:target:0";
		dsi_te = "/fragment@63:target:0";
		smart_pa = "/fragment@64:target:0";
		swtp = "/fragment@66:target:0";
		main_pmic = "/fragment@67:target:0";
		md1_sim1_hot_plug_eint = "/fragment@68:target:0";
		md1_sim2_hot_plug_eint = "/fragment@69:target:0";
	};

	__local_fixups__ {

		fragment@4 {

			__overlay__ {

				usb_c_pinctrl {
					pinctrl-0 = <0x00>;
					pinctrl-1 = <0x00>;
					pinctrl-2 = <0x00>;
					pinctrl-3 = <0x00>;
					pinctrl-4 = <0x00>;
					pinctrl-5 = <0x00>;
					pinctrl-6 = <0x00>;
					pinctrl-7 = <0x00>;
					pinctrl-8 = <0x00>;
					pinctrl-9 = <0x00>;
					pinctrl-10 = <0x00>;
					pinctrl-11 = <0x00>;
					pinctrl-12 = <0x00>;
				};
			};
		};

		fragment@10 {

			__overlay__ {
				pinctrl-0 = <0x00>;
				pinctrl-1 = <0x00>;
				pinctrl-2 = <0x00>;
				pinctrl-3 = <0x00>;
				pinctrl-4 = <0x00>;
				pinctrl-5 = <0x00>;
				pinctrl-6 = <0x00>;
			};
		};

		fragment@11 {

			__overlay__ {
				pinctrl-0 = <0x00>;
				pinctrl-1 = <0x00>;
				pinctrl-2 = <0x00>;
			};
		};

		fragment@12 {

			__overlay__ {

				panel@0 {

					port {

						endpoint {
							remote-endpoint = <0x00>;
						};
					};
				};

				ports {

					port {

						endpoint {
							remote-endpoint = <0x00>;
						};
					};
				};
			};
		};

		fragment@21 {

			__overlay__ {
				pinctrl-0 = <0x00>;
				pinctrl-1 = <0x00>;
			};
		};

		fragment@24 {

			__overlay__ {
				pinctrl-0 = <0x00>;
				pinctrl-1 = <0x00>;
				pinctrl-2 = <0x00>;
				pinctrl-3 = <0x00>;
			};
		};

		fragment@26 {

			__overlay__ {
				pinctrl-0 = <0x00 0x04 0x08>;
				pinctrl-1 = <0x00>;
			};
		};

		fragment@28 {

			__overlay__ {
				pinctrl-0 = <0x00>;
				pinctrl-1 = <0x00>;
				pinctrl-2 = <0x00>;
			};
		};

		fragment@31 {

			__overlay__ {
				pinctrl-0 = <0x00>;
				pinctrl-1 = <0x00>;
				pinctrl-2 = <0x00>;
			};
		};

		fragment@36 {

			__overlay__ {
				pinctrl-0 = <0x00>;
				pinctrl-1 = <0x00>;
			};
		};

		fragment@38 {

			__overlay__ {
				pinctrl-0 = <0x00>;
				pinctrl-1 = <0x00>;
				pinctrl-2 = <0x00>;
				pinctrl-3 = <0x00>;
				pinctrl-4 = <0x00>;
				pinctrl-5 = <0x00>;
				pinctrl-6 = <0x00>;
				pinctrl-7 = <0x00>;
			};
		};

		fragment@39 {

			__overlay__ {

				mp2650-charger@5c {
					pinctrl-0 = <0x00>;
					pinctrl-1 = <0x00>;
					pinctrl-2 = <0x00>;
				};

				rk826_fastcg@0a {
					pinctrl-0 = <0x00>;
					pinctrl-1 = <0x00>;
					pinctrl-2 = <0x00>;
					pinctrl-3 = <0x00>;
					pinctrl-4 = <0x00>;
					pinctrl-5 = <0x00>;
					pinctrl-6 = <0x00>;
					pinctrl-7 = <0x00>;
					pinctrl-8 = <0x00>;
					pinctrl-9 = <0x00>;
					pinctrl-10 = <0x00>;
					pinctrl-11 = <0x00>;
				};
			};
		};

		fragment@41 {

			__overlay__ {
				pinctrl-0 = <0x00>;
				pinctrl-1 = <0x00>;
				pinctrl-2 = <0x00>;
				pinctrl-3 = <0x00>;
				pinctrl-4 = <0x00>;
				pinctrl-5 = <0x00>;
				pinctrl-6 = <0x00>;
				pinctrl-7 = <0x00>;
				pinctrl-8 = <0x00>;
				pinctrl-9 = <0x00>;
				pinctrl-10 = <0x00>;
				pinctrl-11 = <0x00>;
				pinctrl-12 = <0x00>;
				pinctrl-13 = <0x00>;
				pinctrl-14 = <0x00>;
				pinctrl-15 = <0x00>;
				pinctrl-16 = <0x00>;
				pinctrl-17 = <0x00>;
				pinctrl-18 = <0x00>;
				pinctrl-19 = <0x00>;
				pinctrl-20 = <0x00>;
				pinctrl-21 = <0x00>;
				pinctrl-22 = <0x00>;
				pinctrl-23 = <0x00>;
				pinctrl-24 = <0x00>;
				pinctrl-25 = <0x00>;
				pinctrl-26 = <0x00>;
				pinctrl-27 = <0x00>;
				pinctrl-28 = <0x00>;
				pinctrl-29 = <0x00>;
				pinctrl-30 = <0x00>;
				pinctrl-31 = <0x00>;
				pinctrl-32 = <0x00>;
				pinctrl-33 = <0x00>;
				pinctrl-34 = <0x00>;
				pinctrl-35 = <0x00>;
				pinctrl-36 = <0x00>;
				pinctrl-37 = <0x00>;
				pinctrl-38 = <0x00>;
				pinctrl-39 = <0x00>;
			};
		};

		fragment@72 {

			__overlay__ {
				vtouch-supply = <0x00>;
			};
		};
	};
};
