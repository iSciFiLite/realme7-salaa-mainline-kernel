/dts-v1/;

/ {

	fragment@0 {
		target = <0xffffffff>;

		__overlay__ {
		};
	};

	fragment@1 {
		target = <0xffffffff>;

		__overlay__ {
			atag,videolfb-fb_base_l = "~`P";
			atag,videolfb-fb_base_h = <0x00>;
			atag,videolfb-islcmfound = <0x01>;
			atag,videolfb-islcm_inited = <0x00>;
			atag,videolfb-fps = <0x1770>;
			atag,videolfb-vramSize = <0x1be0000>;
			atag,videolfb-lcmname = "oplus20730_samsung_ams643xy04_lcm_drv";
		};
	};

	fragment@2 {
		target = <0xffffffff>;

		__overlay__ {

			novatek@0 {
				compatible = "novatek,nf_nt36672c";
				reg = <0x00>;
				chip-name = "NT36672C_NF";
				status = "ok";
				spi-max-frequency = <0xe4e1c0>;
				reset-gpio = <0xffffffff 0x02 0x00>;
				interrupt-parent = <0xffffffff>;
				interrupts = <0x00 0x02 0x00 0x00>;
				irq-gpio = <0xffffffff 0x01 0x00>;
				touchpanel,tx-rx-num = <0x10 0x24>;
				touchpanel,max-num-support = <0x0a>;
				touchpanel,panel-coords = <0x438 0x960>;
				touchpanel,display-coords = <0x438 0x960>;
				touchpanel,touchmajor-limit = <0x00 0x36>;
				platform_support_project = <0x50ca>;
				platform_support_project_dir = <0x50ca>;
				platform_support_project_commandline = "nt36672c";
				incell_screen;
				fw_edge_limit_support;
				black_gesture_support;
				charger_pump_support;
				headset_pump_support;
				esd_handle_support;
				black_gesture_test_support;
				noflash_support;
				smart_gesture_support;
				pressure_report_support;
				fw_update_app_support;
				game_switch_support;
				drlimit_remove_support;
				lcd_trigger_load_tp_fw_support;
				fw_update_in_probe_with_headfile;
				touchpanel,button-type = <0x04>;
				spi_fast_read_support;
			};
		};
	};

	fragment@3 {
		target = <0xffffffff>;

		__overlay__ {
			clock-frequency = <0x61a80>;

			mtk-usb@60 {
				compatible = "mediatek,mtk-usb";
				reg = <0x60>;
				status = "okay";
			};
		};
	};

	fragment@4 {
		target = <0xffffffff>;

		__overlay__ {
			status = "okay";

			focaltech@38 {
				status = "okay";
				compatible = "focaltech,fts";
				reg = <0x38>;
				chip-name = "FT3518";
				vdd_2v8-supply = <0x01>;
				vdd_2v8_volt = <0x2dc6c0>;
				irq-gpio = <0xffffffff 0x01 0x2002>;
				reset-gpio = <0xffffffff 0x02 0x01>;
				pinctrl-names = "default";
				pinctrl-0 = <0x02 0x03>;
				touchpanel,max-num-support = <0x0a>;
				touchpanel,tx-rx-num = <0x10 0x22>;
				touchpanel,panel-coords = <0x438 0x960>;
				touchpanel,display-coords = <0x438 0x960>;
				touchpanel,touchmajor-limit = <0x00 0x36>;
				tp_type = <0x08>;
				panel_type = <0x08>;
				firmware_name = "focalt_";
				platform_support_project = <0x50fa 0x50fb 0x50fc 0x50fd>;
				platform_support_project_dir = <0x50fa 0x50fb 0x50fc 0x50fd>;
				platform_support_project_commandline = "default_commandline\0default_commandline\0default_commandline\0default_commandline";
				project_id = <0x50fa>;
				irq_need_dev_resume_ok;
				black_gesture_support;
				fw_edge_limit_support;
				pressure_report_support;
				charger_pump_support;
				game_switch_support;
				smart_gesture_support;
				headset_pump_support;
				fw_update_app_support;
				fingerprint_underscreen_support;
				esd_handle_support;
				touchpanel,button-type = <0x04>;
				touchpanel.button-TRx = <0x00 0x00>;
			};

			goodix@5d {
				status = "okay";
				compatible = "Goodix-gt9886";
				reg = <0x5d>;
				chip-name = "GT9886";
				vdd_2v8-supply = <0x01>;
				vdd_2v8_volt = <0x2dc6c0>;
				irq-gpio = <0xffffffff 0x01 0x2002>;
				reset-gpio = <0xffffffff 0x02 0x01>;
				pinctrl-names = "default";
				pinctrl-0 = <0x02 0x03>;
				touchpanel,max-num-support = <0x0a>;
				touchpanel,tx-rx-num = <0x0f 0x22>;
				touchpanel,panel-coords = <0x438 0x960>;
				touchpanel,display-coords = <0x438 0x960>;
				touchpanel,touchmajor-limit = <0x00 0x36>;
				tp_type = <0x08>;
				panel_type = <0x08>;
				firmware_name = "goodix_";
				platform_support_project = <0x50fa 0x50fb 0x50fc 0x50fd>;
				platform_support_project_dir = <0x50fa 0x50fb 0x50fc 0x50fd>;
				platform_support_project_commandline = "default_commandline\0default_commandline\0default_commandline\0default_commandline";
				project_id = <0x50fa>;
				irq_need_dev_resume_ok;
				black_gesture_support;
				fw_edge_limit_support;
				pressure_report_support;
				charger_pump_support;
				game_switch_support;
				smart_gesture_support;
				headset_pump_support;
				fw_update_app_support;
				fingerprint_underscreen_support;
				register-is-16bit;
				esd_handle_support;
				new_set_irq_wake_support;
				touchpanel,button-type = <0x04>;
				touchpanel.button-TRx = <0x00 0x00>;
			};
		};
	};

	fragment@5 {
		target = <0xffffffff>;

		__overlay__ {

			eintdefault {
				phandle = <0x73>;
			};

			int_active {
				phandle = <0x02>;

				pins_cmd_dat {
					pinmux = <0x100>;
					slew-rate = <0x00>;
					bias-pull-up;
				};
			};

			reset_active {
				phandle = <0x74>;

				pins_cmd_dat {
					pinmux = <0x200>;
					slew-rate = <0x01>;
					output-high;
				};
			};

			int_suspend {
				phandle = <0x75>;

				pins_cmd_dat {
					pinmux = <0x100>;
					slew-rate = <0x01>;
					output-low;
				};
			};

			reset_suspend {
				phandle = <0x03>;

				pins_cmd_dat {
					pinmux = <0x200>;
					slew-rate = <0x01>;
					output-low;
				};
			};
		};
	};

	fragment@6 {
		target = <0xffffffff>;

		__overlay__ {

			led@0 {
				compatible = "mediatek,red";
				led_mode = <0x00>;
				data = <0x01>;
				pwm_config = <0x00 0x00 0x00 0x00 0x00>;
				phandle = <0x76>;
			};

			led@1 {
				compatible = "mediatek,green";
				led_mode = <0x00>;
				data = <0x01>;
				pwm_config = <0x00 0x00 0x00 0x00 0x00>;
				phandle = <0x77>;
			};

			led@2 {
				compatible = "mediatek,blue";
				led_mode = <0x00>;
				data = <0x01>;
				pwm_config = <0x00 0x00 0x00 0x00 0x00>;
				phandle = <0x78>;
			};

			led@3 {
				compatible = "mediatek,jogball-backlight";
				led_mode = <0x00>;
				data = <0x01>;
				pwm_config = <0x00 0x00 0x00 0x00 0x00>;
				phandle = <0x79>;
			};

			led@4 {
				compatible = "mediatek,keyboard-backlight";
				led_mode = <0x00>;
				data = <0x01>;
				pwm_config = <0x00 0x00 0x00 0x00 0x00>;
				phandle = <0x7a>;
			};

			led@5 {
				compatible = "mediatek,button-backlight";
				led_mode = <0x00>;
				data = <0x01>;
				pwm_config = <0x00 0x00 0x00 0x00 0x00>;
				phandle = <0x7b>;
			};

			led@6 {
				compatible = "mediatek,lcd-backlight";
				led_mode = <0x04>;
				data = <0x01>;
				pwm_config = <0x00 0x01 0x00 0x00 0x00>;
				phandle = <0x7c>;
			};

			vibrator@0 {
				compatible = "mediatek,vibrator";
				vib_timer = <0x1e>;
				vib_limit = <0x00>;
				vib_vol = <0x0b>;
				phandle = <0x7d>;
			};

			usb_c_pinctrl {
				compatible = "mediatek,usb_c_pinctrl";
				pinctrl-names = "usb_default\0redrv_c1_init\0redrv_c1_low\0redrv_c1_hiz\0redrv_c1_high\0redrv_c2_init\0redrv_c2_low\0redrv_c2_hiz\0redrv_c2_high\0switch_sel1\0switch_sel2\0switch_enable\0switch_disable";
				pinctrl-0 = <0x04>;
				pinctrl-1 = <0x05>;
				pinctrl-2 = <0x06>;
				pinctrl-3 = <0x07>;
				pinctrl-4 = <0x08>;
				pinctrl-5 = <0x09>;
				pinctrl-6 = <0x0a>;
				pinctrl-7 = <0x0b>;
				pinctrl-8 = <0x0c>;
				pinctrl-9 = <0x0d>;
				pinctrl-10 = <0x0e>;
				pinctrl-11 = <0x0f>;
				pinctrl-12 = <0x10>;
				status = "disabled";
				phandle = <0x7e>;

				usb_switch-data {
					en_pin_num = <0x00>;
					en_pin_val = <0x00>;
					sel_pin_num = <0x20>;
					sel_pin_val = <0x01>;
					c1_pin_num = <0x1f>;
					c1_pin_val = <0x02>;
					c2_pin_num = <0x1e>;
					c2_pin_val = <0x01>;
				};
			};

			kpd_volume_down {
				compatible = "mediatek, VOLUME_DOWN-eint";
				interrupt-parent = <0xffffffff>;
				interrupts = <0x3c 0x02 0x3c 0x00>;
				debounce = <0x7d00>;
				status = "okay";
				phandle = <0x7f>;
			};

			oplus_sim_detect {
				compatible = "oplus, sim_detect";
				Hw,sim_det = <0xffffffff 0x8c 0x00>;
			};

			gsensor_1 {
				status = "okay";
				sensor_name = <0x07>;
				i2c_num = <0x02>;
				i2c_addr = <0x00>;
				direction = <0x07>;
				eint_num = <0x0a>;
				step_count_7_en = <0x01>;
				config_miso = <0x01>;
				correct_y_bias = <0x01>;
				phandle = <0x80>;
			};

			gsensor_2 {
				status = "okay";
				sensor_name = <0x04>;
				i2c_num = <0x02>;
				i2c_addr = <0x00>;
				direction = <0x07>;
				eint_num = <0x0a>;
				step_count_7_en = <0x01>;
				config_miso = <0x01>;
				correct_y_bias = <0x01>;
				phandle = <0x81>;
			};

			msensor_1 {
				status = "okay";
				sensor_name = <0x00>;
				i2c_num = <0x00>;
				i2c_addr = <0x0c>;
				direction = <0x04>;
				eint_num = <0x00>;
				libname = "akm";
				para_num = <0x02>;
				phandle = <0x82>;

				mag_para_1 {
					match_projects = "20730 20731";
					soft-mag-parameter = <0xae 0x53 0xbb 0x26 0x27 0x2c 0x01 0xde 0xd8 0x35 0x27 0x9a 0x02 0xaf 0x00 0x00 0xfd 0xb9 0x45 0x95 0xc5 0xfe 0x1d 0x9e 0x0c 0x23 0x65>;
				};

				mag_para_2 {
					match_projects = "20732";
					soft-mag-parameter = <0xdf 0x50 0xa9 0x6f 0x1e 0x6d 0x01 0x8b 0xd8 0x37 0xba 0xb0 0x9f 0xb3 0x02 0xb3 0xfe 0x64 0x26 0xa2 0xc5 0xf9 0x05 0xa9 0x0b 0x05 0xfe>;
				};
			};

			msensor_2 {
				status = "okay";
				sensor_name = <0x02>;
				i2c_num = <0x00>;
				i2c_addr = <0x30>;
				direction = <0x02>;
				eint_num = <0x00>;
				libname = "mmc";
				soft-mag-parameter = <0x24ab 0x00 0x1f8 0x00 0x97 0x00 0x1f8 0x00 0x2725 0x01 0x3a 0x00 0x97 0x00 0x3a 0x00 0x29a9 0x01>;
				phandle = <0x83>;
			};

			proximity_1 {
				status = "okay";
				sensor_name = <0x06>;
				i2c_num = <0x00>;
				i2c_addr = <0x48>;
				direction = <0x04>;
				eint_num = <0x0c>;
				low_step = <0x12c>;
				high_step = <0x190>;
				low_limit = <0x28a>;
				high_limit = <0x41a>;
				dirty_low_step = <0x12c>;
				dirty_high_step = <0x190>;
				ps_dirty_limit = <0x708>;
				ps_ir_limit = <0x7d0>;
				ps_adjust_min = <0x00>;
				ps_adjust_max = <0x73a>;
				sampling_count = <0x05>;
				step_max = <0x190>;
				step_min = <0x64>;
				step_div = <0x7d0>;
				anti_shake_delta = <0x46>;
				dynamic_cali_max = <0x7d0>;
				raw2offset_radio = <0x3e8>;
				offset_max = <0xea60>;
				offset_range_min = <0x00>;
				offset_range_max = <0xfffe>;
				force_cali_limit = <0x7d0>;
				cali_jitter_limit = <0x14>;
				cal_offset_margin = <0xbb8>;
				phandle = <0x84>;
			};

			proximity_2 {
				status = "okay";
				sensor_name = <0x05>;
				i2c_num = <0x00>;
				i2c_addr = <0x39>;
				direction = <0x04>;
				eint_num = <0x0c>;
				low_step = <0x12c>;
				high_step = <0x190>;
				low_limit = <0x190>;
				high_limit = <0x258>;
				dirty_low_step = <0xb4>;
				dirty_high_step = <0xfa>;
				ps_dirty_limit = <0x3ff>;
				ps_ir_limit = <0x1f4>;
				ps_adjust_min = <0x00>;
				ps_adjust_max = <0x258>;
				sampling_count = <0x05>;
				step_max = <0x190>;
				step_min = <0x6e>;
				step_div = <0x5dc>;
				anti_shake_delta = <0x50>;
				dynamic_cali_max = <0x400>;
				raw2offset_radio = <0x5140>;
				offset_max = <0xfa>;
				offset_range_min = <0xff>;
				offset_range_max = <0xff>;
				force_cali_limit = <0x7d0>;
				cali_jitter_limit = <0x1e>;
				cal_offset_margin = <0x78>;
				phandle = <0x85>;
			};

			light_1 {
				status = "okay";
				sensor_name = <0x06>;
				i2c_num = <0x00>;
				i2c_addr = <0x48>;
				direction = <0x04>;
				eint_num = <0x0c>;
				als_buffer_length = <0x08>;
				als_ratio = <0x6e>;
				als_type = <0x02>;
				device_name = "stk32600";
				phandle = <0x86>;
			};

			light_2 {
				status = "okay";
				sensor_name = <0x05>;
				i2c_num = <0x00>;
				i2c_addr = <0x39>;
				direction = <0x04>;
				eint_num = <0x0c>;
				als_buffer_length = <0x0a>;
				als_ratio = <0x6e>;
				als_type = <0x02>;
				device_name = "tcs3701";
				phandle = <0x87>;
			};

			alsps_arch {
				status = "okay";
				new-arch-supported = <0x01>;
				phandle = <0x88>;
			};

			cali_arch {
				status = "okay";
				new-arch-supported = <0x01>;
				phandle = <0x89>;
			};

			oplus_project {
				compatible = "oplus,oplus_project";
				phandle = <0x8a>;
			};

			oplus_devinfo {
				compatible = "oplus-devinfo";
				aboard-gpio0 = <0xffffffff 0x09 0x00>;
				pinctrl-names = "default\0aboard_gpio0_sleep\0aboard_gpio0_active";
				pinctrl-0 = <0x11>;
				pinctrl-1 = <0x12>;
				pinctrl-2 = <0x13>;
				phandle = <0x8b>;

				main-sub {
					compatible = "hw-match, main-sub";
					aboard-patterns = <0x00 0x00 0x00>;
					match-projects = <0x50fa 0x50fb 0x50fc>;
				};
			};

			nfc_chipset {
				compatible = "oplus-nfc-chipset";
				chipset-20732 = "PN557";
				phandle = <0x8c>;
			};
		};
	};

	fragment@7 {
		target = <0xffffffff>;

		__overlay__ {

			default@hw_sub_id {
				phandle = <0x11>;
			};

			sleep@id0 {
				phandle = <0x12>;

				pins_cmd_dat {
					pinmux = <0x900>;
					slew-rate = <0x00>;
					bias-pull-down = <0x00>;
					input-enable;
				};
			};

			active@id0 {
				phandle = <0x13>;

				pins_cmd_dat {
					pinmux = <0x900>;
					slew-rate = <0x00>;
					bias-pull-up = <0x00>;
					input-enable;
				};
			};
		};
	};

	fragment@8 {
		target = <0xffffffff>;

		__overlay__ {

			lcd_bias_enp1_gpio {
				phandle = <0x14>;

				pins_cmd_dat {
					pinmux = <0x1700>;
					slew-rate = <0x01>;
					output-high;
				};
			};

			lcd_bias_enp0_gpio {
				phandle = <0x15>;

				pins_cmd_dat {
					pinmux = <0x1700>;
					slew-rate = <0x01>;
					output-low;
				};
			};

			lcd_bias_enn1_gpio {
				phandle = <0x16>;

				pins_cmd_dat {
					pinmux = <0xca00>;
					slew-rate = <0x01>;
					output-high;
				};
			};

			lcd_bias_enn0_gpio {
				phandle = <0x17>;

				pins_cmd_dat {
					pinmux = <0xca00>;
					slew-rate = <0x01>;
					output-low;
				};
			};

			lcm_rst_out1_gpio {
				phandle = <0x18>;

				pins_cmd_dat {
					pinmux = <0x2c00>;
					slew-rate = <0x01>;
					output-high;
				};
			};

			lcm_rst_out0_gpio {
				phandle = <0x19>;

				pins_cmd_dat {
					pinmux = <0x2c00>;
					slew-rate = <0x01>;
					output-low;
				};
			};

			lcm_dsi_te {
				phandle = <0x1a>;

				pins_cmd_dat {
					pinmux = <0x2b01>;
					input-enable;
				};
			};

			lcm_dsi_te_bk {
				phandle = <0x1b>;

				pins_cmd_dat {
					pinmux = <0xf00>;
					slew-rate = <0x00>;
					bias-disable;
				};
			};
		};
	};

	fragment@9 {
		target = <0xffffffff>;

		__overlay__ {
			vcamaf-supply = <0xffffffff>;
			status = "okay";
		};
	};

	fragment@10 {
		target = <0xffffffff>;

		__overlay__ {

			ldo2 {
				regulator-compatible = "LDO2";
				regulator-name = "vtp";
				regulator-min-microvolt = <0x124f80>;
				regulator-max-microvolt = <0x36ee80>;
				regulator-always-on;
				regulator-default-on = <0x01>;
				status = "okay";
				phandle = <0x01>;
			};
		};
	};

	fragment@11 {
		target = <0xffffffff>;

		__overlay__ {
			ldo5_ctrls = [00 80 01 2d a4];
			sdcard_det_en = <0x01>;
			sdcard_hlact = <0x00>;
		};
	};

	fragment@12 {
		target = <0xffffffff>;

		__overlay__ {
			interrupt-parent = <0xffffffff>;
			interrupts = <0x2b 0x01 0x2b 0x01>;
			status = "okay";
		};
	};

	fragment@13 {
		target = <0xffffffff>;

		__overlay__ {
			pinctrl-names = "lcd_bias_enp1_gpio\0lcd_bias_enp0_gpio\0lcd_bias_enn1_gpio\0lcd_bias_enn0_gpio\0lcm_rst_out1_gpio\0lcm_rst_out0_gpio\0mode_te_te\0mode_te_bk_gpio15";
			pinctrl-0 = <0x14>;
			pinctrl-1 = <0x15>;
			pinctrl-2 = <0x16>;
			pinctrl-3 = <0x17>;
			pinctrl-4 = <0x18>;
			pinctrl-5 = <0x19>;
			pinctrl-6 = <0x1a>;
			pinctrl-7 = <0x1b>;
			status = "okay";
			oplus_display_twelvebits_support;
			oplus_display_hbm_support;
			oplus_display_aod_support;
			oplus_display_fppress_support;
			oplus_display_aodlight_support;
			oplus_display_aod_ramless_support;
			oplus_display_normal_max_brightness = <0x7ff>;
		};
	};

	fragment@14 {
		target = <0xffffffff>;

		__overlay__ {
			pinctrl-names = "lcm_rst_out1_gpio\0lcm_rst_out0_gpio\0mode_te_te";
			pinctrl-0 = <0x18>;
			pinctrl-1 = <0x19>;
			pinctrl-2 = <0x1a>;
			status = "okay";
		};
	};

	fragment@15 {
		target = <0xffffffff>;

		__overlay__ {
			status = "okay";
			#address-cells = <0x01>;
			#size-cells = <0x00>;

			panel@0 {
				compatible = "truly,td4330,vdo";
				reg = <0x00>;
				pm-enable-gpios = <0xffffffff 0x29 0x00>;
				reset-gpios = <0xffffffff 0x2a 0x00>;
				bias-gpios = <0xffffffff 0x1c 0x00 0xffffffff 0x1d 0x00>;
				pinctrl-names = "default";

				port {

					endpoint {
						remote-endpoint = <0x1c>;
						phandle = <0x1d>;
					};
				};
			};

			ports {

				port {

					endpoint {
						remote-endpoint = <0x1d>;
						phandle = <0x1c>;
					};
				};
			};
		};
	};

	fragment@16 {
		target = <0xffffffff>;

		__overlay__ {
			accdet-mic-vol = <0x08>;
			headset-mode-setting = <0x500 0x500 0x01 0x1f0 0x2000 0x800 0x2000 0x44 0x00 0x07 0x05 0x09 0x09 0x0d 0x0e>;
			accdet-plugout-debounce = <0x01>;
			accdet-mic-mode = <0x02>;
			headset-three-key-threshold = <0x00 0x4a 0xa4 0x12c>;
			headset-three-key-threshold-CDD = <0x00 0x79 0xc0 0x258>;
			headset-four-key-threshold = <0x00 0x3a 0x79 0xc0 0x190>;
			moisture_detect_enable = <0x01>;
			eint_use_ext_res = <0x00>;
			eint_detect_mode = <0x05>;
			moisture_detect_mode = <0x05>;
			moisture_comp_vth = <0x02>;
			moisture_comp_vref2 = <0x00>;
			moisture_use_ext_res = <0x00>;
			moisture-external-r = <0x1e8480>;
			moisture-internal-r = <0xb798>;
			moisture-water-r = <0x2710>;
			status = "okay";
		};
	};

	fragment@17 {
		target = <0xffffffff>;

		__overlay__ {
			mtk_dsp_voip = <0x00 0x01 0xffffffff 0xffffffff 0x30000>;
			mtk_dsp_primary = <0x00 0x00 0xffffffff 0xffffffff 0x30000>;
			mtk_dsp_offload = <0x00 0x06 0xffffffff 0xffffffff 0x400000>;
			mtk_dsp_deep = <0x00 0x03 0xffffffff 0xffffffff 0x30000>;
			mtk_dsp_playback = <0x01 0x04 0x0f 0x13 0x30000>;
			mtk_dsp_music = <0x00 0xffffffff 0xffffffff 0xffffffff 0x00>;
			mtk_dsp_capture1 = <0x00 0xffffffff 0x0c 0x12 0x20000>;
			mtk_dsp_a2dp = <0x00 0xffffffff 0xffffffff 0xffffffff 0x40000>;
			mtk_dsp_dataprovider = <0x00 0xffffffff 0x0f 0xffffffff 0x30000>;
			mtk_dsp_call_final = <0x05 0x04 0x0f 0x13 0x18000>;
			mtk_dsp_fast = <0x00 0xffffffff 0xffffffff 0xffffffff 0x5000>;
			mtk_dsp_ktv = <0x00 0x08 0x11 0xffffffff 0x10000>;
			mtk_dsp_capture_raw = <0x00 0xffffffff 0xffffffff 0xffffffff 0x20000>;
			mtk_dsp_ver = <0x00>;
			swdsp_smartpa_process_enable = <0x05>;
			mtk_dsp_mem_afe = <0x01 0x40000>;
		};
	};

	fragment@18 {
		target = <0xffffffff>;

		__overlay__ {

			aw882xx_evt1@35 {
				compatible = "awinic,aw882xx_smartpa";
				reg = <0x35>;
				#sound-dai-cells = <0x00>;
				monitor-flag = <0x01>;
				monitor-timer-val = <0xbb8>;
				status = "okay";
				aw-cali-mode = "aw_misc";
				reset-gpio = <0xffffffff 0x18 0x00>;
				phandle = <0x8d>;
			};

			aw882xx@34 {
				compatible = "awinic,aw882xx_smartpa";
				reg = <0x34>;
				#sound-dai-cells = <0x00>;
				monitor-flag = <0x01>;
				monitor-timer-val = <0xbb8>;
				status = "okay";
				aw-cali-mode = "aw_misc";
				reset-gpio = <0xffffffff 0x18 0x00>;
				phandle = <0x8e>;
			};
		};
	};

	fragment@19 {
		target = <0xffffffff>;

		__overlay__ {
			status = "disabled";
		};
	};

	fragment@20 {
		target = <0xffffffff>;

		__overlay__ {
			status = "okay";

			nfc_nxp@28 {
				compatible = "nxp,pn544";
				reg = <0x28>;
				nxp,pn544-irq = <0xffffffff 0x05 0x00>;
				nxp,pn544-ven = <0xffffffff 0x7f 0x00>;
				nxp,pn544-fw-dwnld = <0xffffffff 0x06 0x00>;
				interrupt-parent = <0xffffffff>;
			};
		};
	};

	fragment@21 {
		target = <0xffffffff>;

		__overlay__ {
			mt6360,intr_gpio_num = <0x10>;
			mt6360,intr_gpio = <0xffffffff 0x10 0x00>;
		};
	};

	fragment@22 {
		target = <0xffffffff>;

		__overlay__ {
			pwr_off_seq = <0x6000204>;
		};
	};

	fragment@23 {
		target = <0xffffffff>;

		__overlay__ {
			mt6360pd,intr_gpio_num = <0x07>;
			mt6360pd,intr_gpio = <0xffffffff 0x07 0x00>;
		};
	};

	fragment@24 {
		target = <0xffffffff>;

		__overlay__ {

			usb_default {
				phandle = <0x04>;
			};

			c1_init {
				phandle = <0x05>;

				pins_cmd_dat {
					pinmux = <0x2800>;
					slew-rate = <0x01>;
					output-low;
				};
			};

			c1_low {
				phandle = <0x06>;

				pins_cmd_dat {
					pinmux = <0x2800>;
					slew-rate = <0x01>;
					output-low;
				};
			};

			c1_highz {
				phandle = <0x07>;

				pins_cmd_dat {
					pinmux = <0x2800>;
					slew-rate = <0x00>;
					bias-disable;
				};
			};

			c1_high {
				phandle = <0x08>;

				pins_cmd_dat {
					pinmux = <0x2800>;
					slew-rate = <0x01>;
					output-high;
				};
			};

			c2_init {
				phandle = <0x09>;

				pins_cmd_dat {
					pinmux = <0x1e00>;
					slew-rate = <0x01>;
					output-low;
				};
			};

			c2_low {
				phandle = <0x0a>;

				pins_cmd_dat {
					pinmux = <0x1e00>;
					slew-rate = <0x01>;
					output-low;
				};
			};

			c2_highz {
				phandle = <0x0b>;

				pins_cmd_dat {
					pinmux = <0x1e00>;
					slew-rate = <0x00>;
					bias-disable;
				};
			};

			c2_high {
				phandle = <0x0c>;

				pins_cmd_dat {
					pinmux = <0x1e00>;
					slew-rate = <0x01>;
					output-high;
				};
			};

			u3_sw_sel1 {
				phandle = <0x0d>;

				pins_cmd_dat {
					pinmux = <0x2000>;
					slew-rate = <0x01>;
					output-low;
				};
			};

			u3_sw_sel2 {
				phandle = <0x0e>;

				pins_cmd_dat {
					pinmux = <0x2000>;
					slew-rate = <0x01>;
					output-high;
				};
			};

			u3_sw_en {
				phandle = <0x0f>;
			};

			u3_sw_dis {
				phandle = <0x10>;
			};
		};
	};

	fragment@25 {
		target = <0xffffffff>;

		__overlay__ {
			keypad,volume-up = <0xffffffff 0x3b 0x00>;
			keypad,volume-down = <0xffffffff 0x3c 0x00>;
			pinctrl-names = "volume_up_as_int\0volume_down_as_int";
			pinctrl-0 = <0x1e>;
			pinctrl-1 = <0x1f>;
			status = "okay";
		};
	};

	fragment@26 {
		target = <0xffffffff>;

		__overlay__ {

			volume_up@0 {
				phandle = <0x1e>;

				pins_cmd_dat {
					pinmux = <0x3b00>;
					slew-rate = <0x00>;
					bias-pull-up = <0x00>;
					input-enable;
				};
			};

			volume_down@0 {
				phandle = <0x1f>;

				pins_cmd_dat {
					pinmux = <0x3c00>;
					slew-rate = <0x00>;
					bias-pull-up = <0x01>;
					input-enable;
				};
			};
		};
	};

	fragment@27 {
		target = <0xffffffff>;

		__overlay__ {

			consys_default {
				phandle = <0x20>;
			};

			gpslna@0 {
				phandle = <0x21>;

				pins_cmd_dat {
					pinmux = <0x9b00>;
					slew-rate = <0x01>;
					bias-disable;
					output-low;
				};
			};

			gpslna@1 {
				phandle = <0x22>;

				pins_cmd_dat {
					pinmux = <0x9b00>;
					slew-rate = <0x01>;
					output-high;
				};
			};

			gpslna@2 {
				phandle = <0x23>;

				pins_cmd_dat {
					pinmux = <0x9b00>;
					slew-rate = <0x01>;
					output-low;
				};
			};
		};
	};

	fragment@28 {
		target = <0xffffffff>;

		__overlay__ {
			pinctrl-names = "default\0gps_lna_state_init\0gps_lna_state_oh\0gps_lna_state_ol";
			pinctrl-0 = <0x20>;
			pinctrl-1 = <0x21>;
			pinctrl-2 = <0x22>;
			pinctrl-3 = <0x23>;
			status = "okay";
		};
	};

	fragment@29 {
		target = <0xffffffff>;

		__overlay__ {
			oplus,fp_gpio_num = <0x01>;
			oplus,fp_gpio_0 = <0xffffffff 0x6a 0x00>;
			pinctrl-names = "default";
			pinctrl-0 = <0x24>;

			goodix_optical {
				oplus,fp-id = <0x01>;
				vendor-chip = <0x0b>;
				eng-menu = "-1,-1";
				chip-name = "G_OPTICAL_G3S";
			};

			jiiov_0302 {
				oplus,fp-id = <0x00>;
				vendor-chip = <0x17>;
				eng-menu = "-1,-1";
				chip-name = "JIIOV_0302";
			};
		};
	};

	fragment@30 {
		target = <0xffffffff>;

		__overlay__ {

			gpio_id0_default {
				phandle = <0x24>;

				pins_cmd_dat {
					pinmux = <0x6a00>;
					slew-rate = <0x00>;
					bias-pull-up;
					input-enable;
				};
			};
		};
	};

	fragment@31 {
		target = <0xffffffff>;

		__overlay__ {
			anc,gpio_irq = <0xffffffff 0x4b 0x00>;
			anc,gpio_rst = <0xffffffff 0x69 0x00>;
			pinctrl-names = "anc_reset_reset\0anc_reset_active\0anc_irq_active";
			pinctrl-0 = <0x25>;
			pinctrl-1 = <0x26 0x27 0x28 0x29 0x2a>;
			pinctrl-2 = <0x2a>;
			status = "okay";
		};
	};

	fragment@32 {
		target = <0xffffffff>;

		__overlay__ {

			jiiov_fp_reset_output_low {
				phandle = <0x25>;

				pins_cmd_dat {
					pinmux = <0x6900>;
					slew-rate = <0x01>;
					output-low;
				};
			};

			jiiov_fp_gpio_clk {
				phandle = <0x26>;

				pins_cmd_dat {
					pinmux = <0x1401>;
					drive-strength = <0x02>;
				};
			};

			jiiov_fp_gpio_mosi {
				phandle = <0x27>;

				pins_cmd_dat {
					pinmux = <0x1201>;
					drive-strength = <0x02>;
				};
			};

			jiiov_fp_gpio_miso {
				phandle = <0x28>;

				pins_cmd_dat {
					pinmux = <0x1101>;
					drive-strength = <0x03>;
				};
			};

			jiiov_fp_gpio_cs {
				phandle = <0x29>;

				pins_cmd_dat {
					pinmux = <0x1301>;
					drive-strength = <0x02>;
				};
			};

			jiiov_fp_irq_active {
				phandle = <0x2a>;

				pins_cmd_dat {
					pinmux = <0x4b00>;
					slew-rate = <0x00>;
					input-enable;
					bias-pull-up;
				};
			};
		};
	};

	fragment@33 {
		target = <0xffffffff>;

		__overlay__ {
			goodix,gpio_irq = <0xffffffff 0x4b 0x00>;
			goodix,gpio_reset = <0xffffffff 0x69 0x00>;
			goodix,gpio_cs = <0xffffffff 0x13 0x00>;
			pinctrl-names = "default\0gf_spi_drive_6mA\0gf_cs_func";
			pinctrl-0 = <0x2b 0x2c>;
			pinctrl-1 = <0x2d 0x2e 0x2f 0x30>;
			pinctrl-2 = <0x31>;
			status = "okay";
		};
	};

	fragment@34 {
		target = <0xffffffff>;

		__overlay__ {
			#address-cells = <0x01>;
			#size-cells = <0x00>;
			status = "okay";

			fingerprint@0 {
				compatible = "oplus,oplus_fp";
				reg = <0x00>;
				spi-max-frequency = <0x7a1200>;
				spi-id = <0x00>;
				spi-irq = <0x4b>;
				spi-reg = <0xa7ffd0>;
				status = "okay";
				phandle = <0x8f>;
			};
		};
	};

	fragment@35 {
		target = <0xffffffff>;

		__overlay__ {

			gpio_goodix_reset_default {
				phandle = <0x2c>;

				pins_cmd_dat {
					pinmux = <0x6900>;
					slew-rate = <0x01>;
					output-low;
				};
			};

			gpio_goodix_irq_default {
				phandle = <0x2b>;

				pins_cmd_dat {
					pinmux = <0x4b00>;
					slew-rate = <0x00>;
					bias-pull-down;
				};
			};

			gpio_goodix_clk_6mA {
				phandle = <0x2d>;

				pins_cmd_dat {
					pinmux = <0x1401>;
					drive-strength = <0x02>;
				};
			};

			gpio_goodix_mosi_6mA {
				phandle = <0x2e>;

				pins_cmd_dat {
					pinmux = <0x1201>;
					drive-strength = <0x02>;
				};
			};

			gpio_goodix_miso_6mA {
				phandle = <0x2f>;

				pins_cmd_dat {
					pinmux = <0x1101>;
					drive-strength = <0x03>;
				};
			};

			gpio_goodix_cs_6mA {
				phandle = <0x30>;

				pins_cmd_dat {
					pinmux = <0x1301>;
					drive-strength = <0x02>;
				};
			};

			gpio_goodix_cs_func {
				phandle = <0x31>;

				pins_cmd_dat {
					pinmux = <0x1301>;
					drive-strength = <0x02>;
				};
			};
		};
	};

	fragment@36 {
		target = <0xffffffff>;

		__overlay__ {

			vooc_ap_data {
				compatible = "mediatek, VOOC_AP_DATA-eint";
				interrupts = <0x43 0x02 0x43 0x00>;
				phandle = <0x90>;
			};

			vooc_ap_data_new_function {
				compatible = "mediatek, VOOC_EINT_NEW_FUNCTION";
				phandle = <0x91>;
			};
		};
	};

	fragment@37 {
		target = <0xffffffff>;

		__overlay__ {

			fan53870@20 {
				compatible = "fan53870";
				reg = <0x20>;
				ldo1_min_vol = "\0\f5";
				ldo1_max_vol = <0x16f300>;
				ldo1_step_vol = <0x1f40>;
				fan53870,gpio_rst = <0xffffffff 0x7a 0x00>;
				fan53870,ldo5-always-on = <0x01>;
			};
		};
	};

	fragment@38 {
		target = <0xffffffff>;

		__overlay__ {
			support_tuv_authentication;
			max_charger_voltage = <0x588040>;
		};
	};

	fragment@39 {
		target = <0xffffffff>;

		__overlay__ {

			phy_tuning {
				compatible = "mediatek,phy_tuning";
				u2_vrt_ref = <0x06>;
				u2_term_ref = <0x06>;
				u2_enhance = <0x02>;
			};
		};
	};

	fragment@40 {
		target = <0xffffffff>;

		__overlay__ {
			pinctrl-names = "uart0_rx_gpio\0uart0_tx_gpio";
			pinctrl-0 = <0x32>;
			pinctrl-1 = <0x33>;
			status = "okay";
		};
	};

	fragment@41 {
		target = <0xffffffff>;

		__overlay__ {

			uart0_rx_gpio@gpio53 {
				phandle = <0x32>;

				pins_cmd_dat {
					pinmux = <0x3500>;
					input-enable;
					slew-rate = <0x00>;
					bias-disable;
				};
			};

			uart0_tx_gpio@gpio54 {
				phandle = <0x33>;

				pins_cmd_dat {
					pinmux = <0x3600>;
					input-enable;
					slew-rate = <0x00>;
					bias-disable;
				};
			};
		};
	};

	fragment@42 {
		target = <0xffffffff>;

		__overlay__ {
			io-channels = <0xffffffff 0x02 0xffffffff 0x03 0xffffffff 0x04>;
			io-channel-names = "auxadc4-usb_temp_v_l\0auxadc5-usb_temp_v_r\0auxadc3-chargeric_temp";
			pinctrl-names = "default\0charger_gpio_as_output_low\0charger_gpio_as_output_high\0ship_sleep\0ship_active\0dischg_enable\0dischg_disable";
			pinctrl-0 = <0x34>;
			pinctrl-1 = <0x35>;
			pinctrl-2 = <0x36>;
			pinctrl-3 = <0x37>;
			pinctrl-4 = <0x38>;
			pinctrl-5 = <0x39>;
			pinctrl-6 = <0x3a>;
			qcom,pd_input_current_charger_ma = <0xce4>;
			qcom,qc_input_current_charger_ma = <0x7d0>;
			qcom,input_current_charger_ma = <0x898>;
			qcom,input_current_usb_ma = <0x1f4>;
			qcom,input_current_cdp_ma = <0x5dc>;
			qcom,input_current_camera_ma = <0x4b0>;
			qcom,input_current_calling_ma = <0x5dc>;
			qcom,led_warm_bat_decidegc = <0x15e>;
			qcom,led_high_bat_decidegc = <0x172>;
			qcom,input_current_led_ma = <0x4b0>;
			qcom,input_current_led_ma_high = <0x4b0>;
			qcom,input_current_led_ma_warm = <0x5dc>;
			qcom,input_current_led_ma_normal = <0x8fc>;
			qcom,input_current_led_ma_forcmcc = <0x1f4>;
			qcom,input_current_led_ma_limit_high = <0x4b0>;
			qcom,vooc_temp_bat_normal_decidegc = <0x15e>;
			qcom,vooc_temp_bat_warm_decidegc = <0x172>;
			qcom,vooc_temp_bat_hot_decidegc = <0x1b8>;
			qcom,input_current_vooc_led_ma_high = <0x4b0>;
			qcom,input_current_vooc_led_ma_warm = <0x708>;
			qcom,input_current_vooc_led_ma_normal = <0xe10>;
			qcom,input_current_vooc_ma_normal = <0xe10>;
			qcom,input_current_vooc_ma_warm = <0xc80>;
			qcom,input_current_vooc_ma_high = <0x898>;
			qcom,overtemp_bat_decidegc = <0x15e>;
			qcom,iterm_disabled = <0x00>;
			qcom,iterm_ma = <0x109>;
			qcom,recharge-mv = <0x64>;
			qcom,batt_capacity_mah = <0x1388>;
			qcom,usb_high_than_bat_decidegc = <0xa8>;
			qcom,removed_bat_decidegc = <0xbe>;
			qcom,cold_bat_decidegc = <0x14>;
			qcom,temp_cold_vfloat_mv = <0xf8c>;
			qcom,temp_cold_fastchg_current_ma = <0x168>;
			qcom,little_cold_bat_decidegc = <0x00>;
			qcom,temp_little_cold_vfloat_mv = <0x1153>;
			qcom,temp_little_cold_fastchg_current_ma = <0x4b0>;
			qcom,temp_little_cold_fastchg_current_ma_high = <0x8fc>;
			qcom,temp_little_cold_fastchg_current_ma_low = <0x578>;
			qcom,pd_temp_little_cold_fastchg_current_ma_high = <0x8fc>;
			qcom,pd_temp_little_cold_fastchg_current_ma_low = <0x578>;
			qcom,qc_temp_little_cold_fastchg_current_ma_high = <0x7d0>;
			qcom,qc_temp_little_cold_fastchg_current_ma_low = <0x578>;
			qcom,cool_bat_decidegc = <0x32>;
			qcom,temp_cool_vfloat_mv = <0x1153>;
			qcom,temp_cool_fastchg_current_ma_high = <0x8fc>;
			qcom,temp_cool_fastchg_current_ma_low = <0x8fc>;
			qcom,pd_temp_cool_fastchg_current_ma_high = <0x8fc>;
			qcom,pd_temp_cool_fastchg_current_ma_low = <0x8fc>;
			qcom,qc_temp_cool_fastchg_current_ma_high = <0x7d0>;
			qcom,qc_temp_cool_fastchg_current_ma_low = <0x7d0>;
			qcom,little_cool_bat_decidegc = <0x78>;
			qcom,temp_little_cool_vfloat_mv = <0x1153>;
			qcom,temp_little_cool_fastchg_current_ma = <0x8fc>;
			qcom,pd_temp_little_cool_fastchg_current_ma = <0xc80>;
			qcom,qc_temp_little_cool_fastchg_current_ma = <0x7d0>;
			qcom,normal_bat_decidegc = <0xa0>;
			qcom,temp_normal_fastchg_current_ma = <0x898>;
			qcom,temp_normal_vfloat_mv = <0x1153>;
			qcom,pd_temp_normal_fastchg_current_ma = <0xc80>;
			qcom,qc_temp_normal_fastchg_current_ma = <0x7d0>;
			qcom,warm_bat_decidegc = <0x1c2>;
			qcom,temp_warm_vfloat_mv = <0x1036>;
			qcom,temp_warm_fastchg_current_ma = <0x578>;
			qcom,pd_temp_warm_fastchg_current_ma = <0x578>;
			qcom,qc_temp_warm_fastchg_current_ma = <0x578>;
			qcom,temp_warm_fastchg_current_ma_led_on = <0x1f4>;
			qcom,hot_bat_decidegc = <0x212>;
			qcom,non_standard_vfloat_mv = <0xf8c>;
			qcom,non_standard_fastchg_current_ma = <0x200>;
			qcom,short_c_bat_cv_mv = <0x10ea>;
			qcom,short_c_bat_vfloat_mv = <0xed8>;
			qcom,short_c_bat_fastchg_current_ma = <0x200>;
			qcom,short_c_bat_vfloat_sw_limit = <0xea6>;
			qcom,cold_vfloat_sw_limit = <0xf5a>;
			qcom,little_cold_vfloat_sw_limit = <0x1121>;
			qcom,cool_vfloat_sw_limit = <0x1121>;
			qcom,little_cool_vfloat_sw_limit = <0x1121>;
			qcom,normal_vfloat_sw_limit = <0x1121>;
			qcom,warm_vfloat_sw_limit = <0xff0>;
			qcom,non_standard_vfloat_sw_limit = <0xf5a>;
			qcom,max_chg_time_sec = <0x11280>;
			qcom,charger_hv_thr = <0x16a8>;
			qcom,charger_lv_thr = <0xd48>;
			qcom,vbatt_full_thr = <0x1130>;
			qcom,vbatt_hv_thr = <0x11c6>;
			qcom,vfloat_step_mv = <0x10>;
			qcom,non_standard_vfloat_over_sw_limit = <0xf8c>;
			qcom,cold_vfloat_over_sw_limit = <0xf8c>;
			qcom,little_cold_vfloat_over_sw_limit = <0x1158>;
			qcom,cool_vfloat_over_sw_limit = <0x1158>;
			qcom,little_cool_vfloat_over_sw_limit = <0x1158>;
			qcom,normal_vfloat_over_sw_limit = <0x1158>;
			qcom,warm_vfloat_over_sw_limit = <0x1022>;
			qcom,vbatt_power_off = <0xce4>;
			qcom,vbatt_soc_1 = <0xd52>;
			qcom,vooc_project = <0x01>;
			qcom,vbatt_num = <0x01>;
			qcom,new_ui_warning_support;
			qcom,dual_ffc;
			qcom,smart_charging_screenoff;
			qcom,smart_charge_version = <0x01>;
			qcom,normal_vterm_hw_inc = <0x12>;
			qcom,non_normal_vterm_hw_inc = <0x12>;
			qcom,usbtemp_batttemp_gap = <0x12>;
			qcom,ff1_normal_fastchg_ma = <0x5dc>;
			qcom,ff1_warm_fastchg_ma = <0x5dc>;
			qcom,ff1_exit_step_ma = <0x190>;
			qcom,ff1_warm_exit_step_ma = <0x12c>;
			qcom,ffc_normal_vfloat_sw_limit = <0x117b>;
			qcom,ffc_temp_normal_vfloat_mv = <0x11c6>;
			qcom,ffc_normal_vfloat_over_sw_limit = <0x11c6>;
			qcom,ffc_warm_vfloat_sw_limit = <0x117b>;
			qcom,ffc_temp_warm_vfloat_mv = <0x11c6>;
			qcom,ffc_warm_vfloat_over_sw_limit = <0x11c6>;
			qcom,ffc2_normal_fastchg_ma = <0x4b0>;
			qcom,ffc2_warm_fastchg_ma = <0x578>;
			qcom,ffc2_temp_warm_decidegc = <0x15e>;
			qcom,ffc2_temp_high_decidegc = <0x190>;
			qcom,ffc2_temp_low_decidegc = <0xa0>;
			qcom,ffc2_normal_vfloat_sw_limit = <0x117b>;
			qcom,ffc2_temp_normal_vfloat_mv = <0x11c6>;
			qcom,ffc2_normal_vfloat_over_sw_limit = <0x11c6>;
			qcom,ffc2_warm_vfloat_sw_limit = <0x117b>;
			qcom,ffc2_temp_warm_vfloat_mv = <0x11c6>;
			qcom,ffc2_warm_vfloat_over_sw_limit = <0x11c6>;
			qcom,ffc2_exit_step_ma = <0x64>;
			qcom,ffc2_warm_exit_step_ma = <0xc8>;
			qcom,default_iterm_ma = <0x109>;
			qcom,default_temp_normal_fastchg_current_ma = <0x898>;
			qcom,default_normal_vfloat_sw_limit = <0x1121>;
			qcom,default_temp_normal_vfloat_mv = <0x1153>;
			qcom,default_normal_vfloat_over_sw_limit = <0x1158>;
			qcom,default_temp_little_cool_fastchg_current_ma = <0x44c>;
			qcom,default_little_cool_vfloat_sw_limit = <0x1121>;
			qcom,default_temp_little_cool_vfloat_mv = <0x1153>;
			qcom,default_little_cool_vfloat_over_sw_limit = <0x115d>;
			qcom,check_batt_full_by_sw;
			qcom,external_gauge;
			qcom,chg_ctrl_by_lcd;
			qcom,chg_ctrl_by_camera;
			qcom,chg_ctrl_by_calling;
			qcom,sw_vfloat_over_protect_enable;
			qcom,ffc_support;
			qcom,chargerid_vol_disable;
			qcom,support_ntc_01c_precision;
			qcom,chargerid_support;
			qcom,usb_ntc_support;
			qcom,vooc_show_ui_soc_decimal;
			qcom,ui_soc_decimal_speedmin = <0x14>;
			qcom,chargerid_switch-gpio = <0xffffffff 0xc3 0x00>;
			qcom,ship-gpio = <0xffffffff 0x0b 0x00>;
			qcom,dischg-gpio = <0xffffffff 0x0d 0x00>;
		};
	};

	fragment@43 {
		target = <0xffffffff>;

		__overlay__ {
			status = "okay";
			clock-frequency = <0x186a0>;

			bq27541-battery@55 {
				status = "okay";
				compatible = "oplus,bq27541-battery";
				reg = <0x55 0x00>;
			};

			rt5125-fastcg@0e {
				status = "okay";
				compatible = "oplus,rt5125-fastcg";
				reg = <0x0e>;
				qcom,vooc_reply_mcu_bits = <0x07>;
				qcom,vooc-low-temp = <0x00>;
				qcom,oplus_batt_4400mv;
				qcom,vooc-fw-type = <0x05>;
				qcom,parse_fw_from_dt;
				vooc,firmware_data = <0x8060020 0x31010000 0x39010000 0x3b010000 0x00 0x00 0x00 0x00 0x00 0x00 0x00 0x3d010000 0x00 0x00 0x3f010000 0x41010000 0x55050000 0xcd090000 0xa1060000 0x43010000 0xad090000 0x41030000 0xb5070000 0x61080000 0x99090000 0xb5060000 0xc9060000 0x2d030000 0x75050000 0x89050000 0x9d050000 0x43010000 0xbd050000 0x43010000 0xdd060000 0xf002f8 0xf03ef8 0xca030c8 0x8382418 0x2d18a246 0x671eab46 0x54465d46 0xac4201d1 0xf030f8 0x7e460f3e 0xfccb646 0x1263342 0xd0fb1a 0xa246ab46 0x33431847 0x34280000 0x54280000 0x103a02d3 0x78c878c1 0xfad85207 0x1d330c8 0x30c101d5 0x4680c60 0x70470000 0x230024 0x250026 0x103a01d3 0x78c1fbd8 0x520700d3 0x30c100d5 0xb607047 0x1fb51fbd 0x10b510bd 0xf0d8f8 0x1146fff7 0xf7ff01f0 0xb3fd00f0 0xf0f803b4 0xfff7f2ff 0x3bc00f0 0xf7f80000 0x7488047 0x7480047 0xfee7fee7 0xfee7fee7 0xfee7fee7 0x4480549 0x34a054b 0x70470000 0xb1070000 0x8d000000 0x8020020 0x8060020 0x8020020 0x220309 0x8b422cd3 0x30a8b42 0x11d30023 0x9c464ee0 0x3460b43 0x3cd40022 0x43088b42 0x31d30309 0x8b421cd3 0x30a8b42 0x1d39446 0x3fe0c309 0x8b4201d3 0xcb01c01a 0x52418309 0x8b4201d3 0x8b01c01a 0x52414309 0x8b4201d3 0x4b01c01a 0x52410309 0x8b4201d3 0xb01c01a 0x5241c308 0x8b4201d3 0xcb00c01a 0x52418308 0x8b4201d3 0x8b00c01a 0x52414308 0x8b4201d3 0x4b00c01a 0x5241411a 0xd20146 0x52411046 0x70475de0 0xca0f00d0 0x49420310 0xd34042 0x53400022 0x9c460309 0x8b422dd3 0x30a8b42 0x12d3fc22 0x890112ba 0x30a8b42 0xcd38901 0x92118b42 0x8d38901 0x92118b42 0x4d38901 0x3ad09211 0xe08909 0xc3098b42 0x1d3cb01 0xc01a5241 0x83098b42 0x1d38b01 0xc01a5241 0x43098b42 0x1d34b01 0xc01a5241 0x3098b42 0x1d30b01 0xc01a5241 0xc3088b42 0x1d3cb00 0xc01a5241 0x83088b42 0x1d38b00 0xc01a5241 0xd9d24308 0x8b4201d3 0x4b00c01a 0x5241411a 0xd20146 0x63465241 0x5b101046 0x1d34042 0x2b00d5 0x49427047 0x63465b10 0xd34042 0x1b50020 0xc046c046 0x2bd7047 0x70477047 0x754600f0 0x25f8ae46 0x5006946 0x5346c008 0xc0008546 0x18b020b5 0xfff732ff 0x60bc0027 0x4908b646 0x26c0c5 0xc0c5c0c5 0xc0c5c0c5 0xc0c5c0c5 0xc0c5403d 0x49008d46 0x704710b5 0x446c046 0xc0462046 0xfff709ff 0x10bd0000 0x487047 0xa8010020 0x1491820 0xabbefee7 0x26000200 0x70470000 0x3480068 0x1210903 0x88430149 0x8607047 0x700040 0x648c069 0xc1b20648 0xc1700648 0x680121 0x89048843 0x3490860 0x70470000 0x300040 0x91010020 0x700040 0x10b50024 0x764bdc70 0x764b1b68 0x1024a343 0x1033744c 0x2360744b 0x1b698024 0xa3438033 0x714c2361 0xbf6e4b 0xdb78002b 0xfbd06c4b 0xdb78012b 0xad10024 0x694bdc70 0x6a4b9b68 0x1b0a1b02 0xaa33684c 0xa36000e0 0xb2e000bf 0x634bdb78 0x2bfbd0 0x614bdb78 0x22b0bd1 0x245f4b 0xdc70604b 0x9b681b0a 0x1b02c4b2 0x23435d4c 0xa36000e0 0x9ce000bf 0x584bdb78 0x2bfbd0 0x564bdb78 0x22b0ad1 0x24544b 0xdc70554b 0x1b698024 0xa3438033 0x524c2361 0xe087e0 0xbf4e4b 0xdb78002b 0xfbd04c4b 0xdb78012b 0xad10024 0x494bdc70 0x4a4b9b68 0x1b0a1b02 0xab33484c 0xa36000e0 0x72e000bf 0x434bdb78 0x2bfbd0 0x22942d1 0x404bdb78 0x22b0ad1 0x243e4b 0xdc703f4b 0x1b692024 0xa3432033 0x3c4c2361 0xe05be0 0xbf384b 0xdb78002b 0xfbd0364b 0xdb78082b 0x6d1364b 0xdb681370 0x521c4b1e 0xd9b200e0 0x4ae00024 0x2f4bdc70 0x304b1b69 0x1024a343 0x10332e4c 0x236100bf 0x2a4bdb78 0x2bfbd0 0x284bdb78 0x82b0dd1 0x284bdb68 0x13700024 0x244bdc70 0x254b1b69 0x4024a343 0x4033234c 0x236128e0 0x28e01f4b 0xdb78022b 0xad10024 0x1c4bdc70 0x1d4b1b69 0x1024a343 0x10331b4c 0x236100e0 0x18e000bf 0x164bdb78 0x2bfbd0 0x144bdb78 0x82b0dd1 0x144bdb68 0x13700024 0x104bdc70 0x114b1b69 0x4024a343 0x40330f4c 0x236100e0 0xe000bf 0xa4bdb78 0x42b03d0 0x84bdb78 0x202b06d1 0x84b1b69 0x4024a343 0x4033064c 0x2361044b 0x1b681024 0xa343024c 0x236010bd 0x91010020 0x7c000020 0x300040 0x5490968 0x122d205 0x9143034a 0x11600349 0x8969c8b2 0x70470000 0x700040 0x300040 0x3480068 0x121c902 0x88430149 0x8607047 0x700040 0x3480068 0x1218902 0x88430149 0x8607047 0x700040 0x5480068 0x1214902 0x88430349 0x8600120 0x2490870 0x70470000 0x700040 0x11000020 0x10b50c48 0x688021 0x88430a49 0x8600a48 0x780028 0xdd10948 0x780028 0x7d101f0 0x7ff0020 0x6490870 0x1200449 0x87000f0 0x7fa10bd 0x700040 0x36000020 0x76000020 0x37000020 0xc206d20e 0x1219140 0x14a1160 0x70470000 0xe100e0 0xc206d20e 0x1219140 0x14a1160 0x70470000 0xe100e0 0x10b50028 0x19da1a4a 0x3071b0f 0x83b9b08 0x9b00d258 0x8307dc0e 0xff23a340 0x9a438b07 0x1b0e8407 0xe40ea340 0x1a43114b 0x407240f 0x83ca408 0xa4001a51 0x18e00e4a 0x3231b02 0xd2188308 0x9b00d258 0x8307dc0e 0xff23a340 0x9a438b07 0x1b0e8407 0xe40ea340 0x1a43054b 0x3242402 0x1b198408 0xa4001a51 0x10bd0000 0x1ced00e0 0xe100e0 0x3480068 0x1214905 0x88430149 0x8607047 0x700040 0x3480068 0x1218903 0x88430149 0x8607047 0x700040 0x3480068 0x1214903 0x88430149 0x8607047 0x700040 0x3480068 0x20218843 0x1490860 0x70470000 0x700040 0x22807d1 0x2d490968 0x82039143 0x89182b4a 0x116006e0 0x29490968 0x122d203 0x9143274a 0x11600328 0x8d12549 0x9680122 0x92039143 0x8918224a 0x116006e0 0x20490968 0x1229203 0x91431e4a 0x11600428 0x7d11c49 0x968c202 0x91438918 0x194a1160 0x6e01849 0x9680122 0x52039143 0x154a1160 0x52808d1 0x13490968 0x1221203 0x91438918 0x104a1160 0x6e00f49 0x9680122 0x12039143 0xc4a1160 0xb490968 0xf0229143 0x201f023 0x1a401143 0x74a1160 0x11460968 0x2229143 0x891c044a 0x11601146 0x9684908 0x4900491c 0x11607047 0x400040 0x70470000 0x10b50120 0x8007c068 0xc007c00f 0x2816d0 0x23488068 0x401c2249 0x88602248 0x78c007 0xc00f0028 0x2d00020 0xfff788ff 0x1208007 0xc0684008 0x40000121 0x8907c860 0x28e00120 0x8007c068 0x8007c00f 0x280ed0 0x1208007 0x40691349 0x8600020 0x48600120 0x8007c068 0x2218843 0x4907c860 0x12e00120 0x8007c068 0x4007c00f 0x280bd0 0x9484068 0x401c0849 0x48600120 0x8007c068 0x4218843 0x907c860 0x5480068 0x1214904 0x88430349 0x86010bd 0x98010020 0x78000020 0x700040 0x10b53f48 0x680121 0x9048843 0x3c490860 0x3c480088 0x2805d0 0x3a480088 0x401e3949 0x88015e0 0x7d20c000 0x36490880 0x36480088 0x2804d0 0x34480088 0x401e3349 0x8803348 0x880028 0x4d03148 0x88401e 0x2f490880 0x2f480068 0x2804d0 0x2d480068 0x401e2c49 0x8602c48 0x680028 0x4d02a48 0x68401e 0x28490860 0x28480068 0x2804d0 0x26480068 0x401e2549 0x8602548 0x680028 0x4d02348 0x68401e 0x21490860 0x21480068 0x2804d0 0x1f480068 0x401e1e49 0x8601e48 0x680028 0x4d01c48 0x68401e 0x1a490860 0x1a480068 0x2804d0 0x18480068 0x401e1749 0x8601748 0x78401c 0x15490870 0x8460078 0xc8280edd 0x200870 0x12480078 0x2805d0 0x2001f0 0xbf90120 0xf490870 0x1200d49 0x87010bd 0x700040 0x38000020 0x3a000020 0x3c000020 0x40000020 0x44000020 0x48000020 0x4c000020 0x50000020 0x54000020 0x58000020 0x37000020 0x1f000020 0x10000020 0x3480068 0x121c903 0x88430149 0x8607047 0x700040 0xf200549 0xc8600548 0x680121 0xc9048843 0x2490860 0x70470000 0x600040 0x700040 0x3480068 0x1218905 0x88430149 0x8607047 0x700040 0x30b47446 0x641e2578 0x641cab42 0x4d3635d 0x5b00e318 0x30bc1847 0x1d46f8e7 0x10b5f948 0x780828 0xbda01f0 0xc5f8f749 0xf54a1278 0x8854f448 0x78401c 0xf2490870 0x10bdf148 0x780828 0x29d101f0 0xd1fbef48 0x780128 0x24d1ed48 0x40780028 0x20d1eb48 0x80780128 0x1cd1e948 0xc078c000 0xe7490979 0x89000843 0xe5494979 0x49000843 0xe3498979 0x843e349 0x8700920 0xdf490870 0xe1480078 0x2870d0 0xdf480078 0x401ede49 0x8706ae0 0xda480078 0x281bd1 0xd8484078 0x12817d1 0xd6488078 0x12813d1 0xd448c078 0xc000d349 0x9798900 0x843d149 0x49794900 0x843cf49 0x89790843 0xce490870 0x920cb49 0x8704ae0 0xca484078 0x12824d1 0xc8488078 0x2820d1 0xc648c078 0x1281cd1 0xc4480079 0xc000c349 0x49798900 0x843c149 0x89794900 0x843bf49 0xc9790843 0xbe490870 0x920bb49 0x870bd48 0x780028 0x4d0bb48 0x78401e 0xb9490870 0x86e7b648 0x40780028 0x1bd1b448 0x80780128 0x17d1b248 0xc0780128 0x13d1b048 0x79c000 0xae494979 0x89000843 0xac498979 0x49000843 0xaa49c979 0x843aa49 0x8700920 0xa6490870 0x66e701f0 0xf1fba848 0x780028 0x14d1a749 0xc8700871 0x48718871 0xc8710872 0x4872a448 0x780228 0x9d19e48 0x780007 0xea149 0x8700120 0x9d494871 0xeae29d48 0x780128 0xad19c48 0x789649 0x9780843 0x99490870 0x1209649 0x4871dbe2 0x97480078 0x52816d1 0x9248807a 0x9149c870 0x846c07a 0x8710846 0x7b4871 0x846407b 0x88710846 0x807bc871 0x846c07b 0x8720846 0x7c4872 0xc0e28a48 0x780428 0x9d18248 0x780007 0xc8749 0x8800120 0x81494871 0xb2e28348 0x780328 0xbd17b48 0x780002 0x80490988 0x8437f49 0x8800120 0x79494871 0xa2e27b48 0x780228 0xbd17348 0x780001 0x78490988 0x8437749 0x8800120 0x71494871 0x92e27348 0x780128 0x15d17248 0x886a49 0x9780843 0x6f490880 0xf0c4fb 0x1206949 0x48716d48 0x886b49 0x9888842 0x90d10120 0x6a490870 0x78e26a48 0x780028 0x4cd06848 0x78401e 0xc100081a 0x66490968 0x85c5d49 0xc8706348 0x78401e 0xc100081a 0x61490968 0x40184078 0x57490871 0x5d480078 0x401ec100 0x81a5c49 0x9684018 0x80785249 0x48715848 0x78401e 0xc100081a 0x56490968 0x4018c078 0x4c498871 0x52480078 0x401ec100 0x81a5149 0x9684018 0x794749 0xc8714d48 0x78401e 0xc100081a 0x4b490968 0x40184079 0x41490872 0x47480078 0x401ec100 0x81a4649 0x9684018 0x80793c49 0x487227e2 0x37480078 0x9280cd1 0x203949 0x8703a49 0x8703d49 0x87000f0 0x21ff0120 0x3c490870 0x76e60020 0x32490870 0x33490870 0x36490870 0x2b480078 0x300fff7 0x4dfe0e08 0xbf1f0ef 0xeed3d3d3 0xd3d3d3ed 0xecd301f0 0xedfa5fe6 0x24480078 0x286dd1 0x2e480078 0x12801d0 0x1f0e2fa 0x2c480078 0x2049c870 0x2b480078 0x2811d0 0x2a480078 0x280dd1 0x1200871 0x48718871 0x20c871 0x1200872 0x204872 0x1202349 0x870a3e0 0x22480068 0x22498842 0x7edd2049 0x9683522 0x9201881a 0xc117090f 0x9180c11 0x3d2c00dd 0x3d241c48 0x780028 0x39d01b48 0x780028 0x35d13a2c 0x33da3a24 0x1201749 0x8703ce0 0x1c000020 0x14000020 0x1e000020 0x63000020 0x1d000020 0x80000020 0x26000020 0x27000020 0x29000020 0x2c000020 0x2e000020 0x30000020 0x2a000020 0x20 0x13000020 0x71000020 0x12000020 0x67000020 0x73000020 0xc000020 0x3f0d0000 0x66000020 0x74000020 0x55e0fc48 0x780028 0x9d0fb48 0x780028 0x5d1392c 0x3da3924 0x120f749 0x870a006 0xc00ff649 0x871e006 0xc00f4871 0x2007c00f 0x88716007 0xc00fc871 0xa007c00f 0x872e007 0xc00f4872 0xee480078 0x282fd0 0x2000f0 0x6bfe0120 0xea490870 0xea480078 0x280ed1 0x120e649 0x8714871 0x887100e0 0x16e0c871 0x8720020 0x48720120 0xe2490870 0x16e00020 0xde490871 0x48718871 0x120c871 0x200872 0x1204872 0x20db49 0x87007e0 0xda480068 0xda498842 0x2da0020 0xd449c870 0x35e1d448 0x780028 0x19d0d348 0x780028 0x8d10120 0xce49c870 0x8710872 0x4872ce49 0x87005e0 0x120ca49 0x88710020 0xca490870 0x1de104e1 0xebe0e2e0 0xb2e060e0 0x38e0c948 0x780028 0xed00120 0xc149c870 0x8714871 0x8871c871 0x8724872 0xc2480078 0x401ec149 0x87004e1 0xbd480068 0xbf498842 0x1da0024 0x7e0ba49 0x968bc4a 0x881a0a21 0xfff706f9 0x4466006 0xc00fb249 0xc870a006 0xc00f0871 0xe006c00f 0x48712007 0xc00f8871 0x6007c00f 0xc871a007 0xc00f0872 0xe007c00f 0x4872dee0 0xae480078 0x2808d1 0xad480078 0x22801d0 0x1f0c2f9 0x120a249 0xc8700921 0x82001f0 0xf3fba849 0x8700846 0x780228 0x3d10120 0x9b490871 0xae0a348 0x780128 0x3d19849 0x8714871 0x2e00120 0x95494871 0xb7e09b48 0x780028 0x29d19a48 0x780328 0x1d001f0 0x9bf99948 0x780028 0x6d00020 0x8c498871 0xc8710872 0x487217e0 0x94480078 0x22813d0 0x92480078 0x12808d1 0x208549 0x8871c871 0x1200872 0x204872 0x6e00020 0x80498871 0xc8710120 0x8724872 0x89e08948 0x788006 0xc00f7b49 0x8718648 0x78c006 0xc00f4871 0x83480078 0x7c00f 0x88718148 0x784007 0xc00fc871 0x7e480078 0x8007c00f 0x8727c48 0x78c007 0xc00f4872 0x207249 0x87066e0 0x78480078 0x2808d0 0x206949 0xc8707548 0x78401e 0x73490870 0x1ce06c48 0x780028 0x4d07148 0x786249 0xc87013e0 0x68480078 0x42801d0 0x1f038f9 0x1205d49 0x8700020 0x48700120 0x88706848 0x78c870 0x1204871 0x8723ce0 0x1205649 0x48710872 0x37e00320 0x62490870 0x1205249 0x8718871 0x2fe06048 0x780028 0x3d05f48 0x780028 0xd126e0 0x5b480078 0x401e5a49 0x8700620 0x5a490870 0xf05efd 0x59490870 0xf0fef8 0x17e05848 0x78401c 0x57490870 0x55480078 0x801c5649 0x8705648 0x783e49 0xc8705548 0x780871 0x54480078 0x48715448 0x788871 0xbf00bf 0x3749524a 0x1278885c 0x1f048f8 0x4f480078 0x401c4e49 0x8700846 0x780928 0x16dd0420 0xf09cfa 0x1f00ef8 0x204849 0x8704849 0x8704849 0x8704849 0x8703848 0x780028 0x5d03648 0x78401e 0x34490870 0xb1e03648 0x780028 0x5d03448 0x78401e 0x32490870 0xa7e03448 0x780028 0xad03248 0x78401e 0x30490870 0x30480078 0x401e2f49 0x87098e0 0x36480078 0x1287bd0 0x22804d0 0x3287fd0 0x42869d1 0x14e01b48 0x780128 0xfd13048 0x780128 0x1d100f0 0xb1fc0020 0x15490870 0x12480078 0x2802d1 0x3201149 0x87077e0 0xe480078 0x2853d1 0x548c078 0x284cd0 0x2200b49 0x8704be0 0x65000020 0x75000020 0x80000020 0x35000020 0x62000020 0xc000020 0xb80b0000 0x5c000020 0x4c0d0000 0x63000020 0x71000020 0x72000020 0x67000020 0x68000020 0x5f000020 0x64000020 0x12000020 0x26000020 0x28000020 0x32000020 0x29000020 0x34000020 0x4000020 0x2a000020 0x2b000020 0x6000020 0x7000020 0x8000020 0x9000020 0x1d000020 0x1c000020 0x1f000020 0x10000020 0x1e000020 0x31000020 0xce013e0 0x1ae00420 0x12490870 0x1201249 0x87000f0 0x83fc1149 0x87017e0 0x10480078 0x2802d1 0x1200b49 0x8700fe0 0xc480078 0x2802d1 0x1200749 0x87007e0 0x8480078 0x2802d1 0x4200349 0x87000bf 0xbf00bf 0x1ce40000 0x71000020 0x32000020 0x33000020 0x63000020 0x28480078 0x40022849 0x9784900 0x8432749 0x8802448 0x784006 0xc00f2549 0x48712148 0x788006 0xc00fc872 0x1e480078 0xc006c00f 0x8721c48 0x780007 0xc00f0874 0x19480078 0x4007c00f 0x88731748 0x788007 0xc00f4873 0x14480078 0xc007c00f 0xc8711348 0x784006 0xc00fc870 0x10480078 0x8006c00f 0x8730e48 0x78c006 0xc00f0871 0xb480078 0x7c00f 0x88720948 0x784007 0xc00f4872 0x6480078 0x8007c00f 0xc8730448 0x78c007 0xc00f8871 0x70470000 0x33000020 0x34000020 0x2e000020 0x80000020 0x3480088 0x3490840 0x1490880 0x70470000 0x2c000020 0xfefe0000 0x10b50146 0x220b20 0x1238340 0x364c2360 0xbf0229 0x7d13548 0x688b03 0x9843c018 0x324b1860 0x6e03148 0x680123 0xdb039843 0x2e4b1860 0x32908d1 0x2c480068 0x1239b03 0x9843c018 0x294b1860 0x6e02848 0x680123 0x9b039843 0x254b1860 0x42907d1 0x23480068 0xcb029843 0xc018214b 0x186006e0 0x1f480068 0x1235b03 0x98431d4b 0x18600529 0x8d11b48 0x680123 0x1b039843 0xc018184b 0x186006e0 0x16480068 0x1231b03 0x9843144b 0x18601348 0x68f023 0x98430b01 0xf0242340 0x18430f4b 0x18601846 0x680223 0x9843801c 0xb4b1860 0x18460068 0x40084000 0x401c1860 0x6e00748 0x68c007 0xc00f0028 0xd100e0 0xf7e700bf 0x2484268 0x90b210bd 0xe100e0 0x400040 0x70477047 0x38b50446 0x6a460221 0x2046fef7 0x3bff6946 0x48780002 0x9780843 0x5b20848 0x780028 0x1d1062c 0x5d00548 0x780128 0x4d1022c 0x2d10348 0x281805b2 0x284638bd 0x24000020 0x55f5ffff 0xb50220 0xfff760ff 0xf498842 0xbdb0320 0xfff75aff 0xc498842 0x5db0420 0xfff754ff 0x9498842 0x5da0948 0x78401c 0x7490870 0x2e00020 0x5490870 0x4480078 0x92801dd 0x12000bd 0x20fce7 0x41080000 0x61000020 0x10b50446 0x2c02d0 0x2000f0 0x93fd1020 0xfff73af8 0x13480068 0x80218843 0x11490860 0x11480069 0x4218843 0xf490861 0x8460069 0xff218131 0x88438030 0xb490861 0x8460069 0x49158843 0x40180849 0x8610846 0x694008 0x4000401c 0x861002c 0x2d00120 0xf06afd 0x10bd0000 0x700040 0x500040 0x10b50446 0x2c02d0 0x2000f0 0x5dfd0e20 0xfff704f8 0x13480068 0x1214902 0x88431149 0x8601148 0x680421 0x88430f49 0x8600846 0x684008 0x4000401c 0x8600846 0x68ff21 0x81318843 0x80300849 0x8600846 0x684915 0x88434018 0x4490860 0x2c02d0 0x12000f0 0x33fd10bd 0x700040 0x500040 0x8b50a20 0x9001e0 0xf006f8 0x98411e 0x910028 0xf8d108bd 0x8b50548 0x9000e0 0xbf0098 0x411e0091 0x28f9d1 0x8bd0000 0xed080000 0x8b52c20 0x9000e0 0xbf0098 0x411e0091 0x28f9d1 0x8bd0000 0x8b50548 0x9000e0 0xbf0098 0x411e0091 0x28f9d1 0x8bd0000 0x37020000 0x10b50246 0x144603e0 0xfff7ecff 0x601ec4b2 0x2cf9dc 0x10bd7047 0x8ab00020 0x9900026 0x270890 0x7900690 0x5900490 0x3900290 0x24fd48 0xfd490880 0xfd48fe49 0x88035e2 0x1f0acf8 0xfc480068 0x2846d1 0x582000f0 0x83fe0446 0xf9480078 0x2839d1 0x1f2c05d1 0xf026fa 0x120f549 0x87024e0 0x2c02d1 0xf0f6fd 0x1fe00b2c 0x5d0ec48 0x88ea49 0x891e8842 0x2dd3b20 0x19014e0 0x32c07db 0xa2c05dc 0x601c8100 0x4018c0b2 0x1900ae0 0xb2c02dd 0x3b200190 0x5e0012c 0x1d0022c 0x1d11420 0x190e248 0x780028 0x8d1e148 0x278e148 0x780199 0xf08efd 0xdc490870 0x7d200001 0xd8490860 0xa3e1dc48 0x680028 0x49d1db48 0x78fff7 0xa1fe0546 0xd3480078 0x283bd1 0xd7488542 0x7da781c 0xc7b2032f 0x4dd5420 0xf09cfd 0xe00027 0xd2488542 0xadd0698 0x401cc0b2 0x6900698 0x72805dd 0x592000f0 0x8dfd01e0 0x200690 0x19204001 0x854204da 0xc9480068 0xc9498842 0x9dc7d20 0xc0008542 0x10dac548 0x68c549 0xa318842 0xadd0598 0x401cc0b2 0x5900598 0x52805dd 0x5a2000f0 0x6dfd01e0 0x200590 0x7d20c000 0xb6490860 0x55e1bb48 0x680028 0x21d1ba48 0x780028 0x1dd1b948 0x78fff7 0x4ffe0990 0x9985f28 0xedda948 0x780028 0xad10898 0x401cc0b2 0x8900898 0x32805dd 0x5a2000f0 0x47fd01e0 0x200890 0x7d200001 0xa9490860 0x2fe1ab48 0x680028 0x7ed1aa48 0x78fff7 0x2dfea249 0x8609948 0x780028 0x75d19548 0x880028 0x7d19848 0x783b28 0x1add3b20 0x95490870 0x16e08f48 0x880a28 0x7da9248 0x783b28 0xedd3b20 0x8f490870 0xae08948 0x881428 0x6da8c48 0x783228 0x2dd3220 0x89490870 0x8d480068 0x8d499b39 0x884207dd 0x85480078 0x3b281edd 0x3b208349 0x8701ae0 0x86480068 0x2121c901 0x884207dd 0x7e480078 0x3b2810dd 0x3b207c49 0x8700ce0 0x7f480068 0x7f49ff39 0x884206dd 0x77480078 0x3b2802dd 0x3b207549 0x8707248 0x780028 0x9d17148 0x2787d48 0x1787048 0x7800f0 0xadfc6c49 0x8707a48 0x780228 0x8d17048 0x687049 0x19398842 0x2dd5a20 0xf0cafc 0x6b480068 0x6b492331 0x884202dd 0x5a2000f0 0xc1fc6748 0x682321 0xc90101e0 0x10e008e0 0x884207dd 0x701cc6b2 0x52e04dd 0x5a2000f0 0xb1fc00e0 0x26ff20 0xf5306249 0x8609ae0 0x64480068 0x2847d1 0x63480078 0xfff798fd 0x5464f48 0x780028 0x39d1ff20 0xb3308542 0xcdd0298 0x401cc0b2 0x2900298 0x2281bdd 0x3200290 0x1205949 0x87015e0 0xff20a530 0x85420edd 0x200290 0x398401c 0xc0b20390 0x3980228 0x8dd0320 0x3900120 0x50490870 0x2e00020 0x3900290 0x2d03dd 0xff20f530 0x85420add 0x798401c 0xc0b20790 0x7980228 0x5dd5c20 0xf066fc 0x1e00020 0x790ff20 0xf5304049 0x8604ee0 0x42480068 0x281ed1 0x2b480078 0x280ed1 0xfff76cfd 0x2805d0 0x2000f0 0x87f80120 0x25490870 0x19204001 0x38490860 0x37e00498 0x2804d1 0x5d2000f0 0xcdfc0120 0x4903448 0x32490860 0x2be03348 0x680028 0x27d11648 0x880028 0x6d11848 0x780028 0x2d15a20 0xf02cfc 0x2c480078 0x2803d1 0x2b480078 0x1280add 0x2a480078 0x2803d0 0x592000f0 0x1dfc02e0 0x542000f0 0x19fc2548 0x780028 0x2d05920 0xf012fc 0x14201e49 0x8602f20 0x40e00000 0x28230000 0x3a000020 0xc4040000 0x3c000020 0x4c000020 0x35000020 0x5c000020 0x5e000020 0x60000020 0x48000020 0x21000020 0x30f8ffff 0x581b0000 0xc000020 0x67110000 0x44000020 0x63000020 0x22000020 0x40000020 0x20000020 0x5d000020 0x68000020 0x54000020 0x23000020 0x66000020 0x65000020 0x58000020 0x10270000 0x50000020 0x10000020 0x70000020 0x13000020 0xfff7aafd 0xc8e50000 0x2807d0 0x749096b 0x80229143 0x8031054a 0x116305e0 0x349096b 0x80229143 0x14a1163 0x70470000 0x400040 0x70470000 0x2494969 0x4906c80f 0x70470000 0x500040 0x2494968 0x4906c80f 0x70470000 0x500040 0x348006b 0x6c00f 0x1214840 0x70470000 0x400040 0xb50920 0xfff710fc 0x1490860 0xbd0000 0x6c000020 0x2498968 0xc8b24006 0x400e7047 0x100040 0x10b52348 0x40698021 0x88432149 0x48610846 0x80698861 0x1f480068 0x121c905 0x88431d49 0x8600020 0xfef700fd 0x19480068 0xfe218843 0x1c301749 0x8600846 0x40692021 0x88432030 0x13494861 0x8464069 0x10218843 0x10494861 0x8464069 0x80218843 0x80300d49 0x48610520 0xfef7e2fc 0xb480068 0x1218904 0x88430949 0x8600748 0x40694021 0x88434030 0x4494861 0x8464068 0xc0218843 0x80300149 0x486010bd 0x300040 0x700040 0xf026fa 0xf0c4fc 0xf023fa 0xfff7acff 0x20fff7 0xa5fc0120 0xf006fa 0x532000f0 0x3dfc0546 0x2d072d0f 0x2d01d1 0xa2411e0 0x12d01d1 0x3c240de0 0x22d01d1 0x822409e0 0x32d01d1 0xaa2405e0 0x42d02d1 0xff240534 0xe00a24 0x322c0adb 0x782c08da 0xcd48ce49 0x8600220 0xcd490870 0xcd490870 0x2ae0782c 0x8dba02c 0x6dacb48 0xc7490860 0x420c749 0x8701fe0 0xa02c08db 0xfa2c06da 0xc648c249 0x8600620 0xc1490870 0x14e0fa2c 0xadbff20 0xaf308442 0x6dac148 0xbb490860 0x620bb49 0x87007e0 0xbe48b849 0x8600220 0xb7490870 0xb7490870 0xb5490878 0xc10f0918 0x4910b94a 0x11701046 0x780821 0x840c010 0xb6490870 0x10460078 0x4210840 0x8010b449 0x8701046 0x780221 0x8404010 0xb1490870 0x10460078 0xc007c00f 0xaf490870 0xf0e4fa 0xf006fb 0xf004fa 0xf0acf9 0x210e20 0xfef742fc 0x211020 0xfef73efc 0x20fff7 0xe3fb00bf 0xfff78bfc 0xf022fb 0x28f9d0 0xf040fd 0x17e000f0 0x45fda048 0x780028 0x1d000f0 0xa1fa9e48 0x780128 0x4d19d48 0x780128 0xd107e0 0x9b480078 0x2800d1 0x2e0fff7 0x2dfce6e7 0xbf0120 0x97490870 0xfff76efb 0x522000f0 0x3fb0546 0x1209449 0x870002d 0x1d100f0 0x7ffa00f0 0x1bfd5e20 0xf0f6fa 0x546022d 0x1d000f0 0x75fa00f0 0x11fdfff7 0xdfc00f0 0xdfd8a48 0x7800f0 0xe7fa0546 0x22d01d0 0xf066fa 0xf002fd 0x85480078 0x280cd1 0x8208449 0x8701420 0x83490870 0x2c208349 0x8700620 0x82490870 0xfe07d48 0x780128 0xbd10420 0x7b490870 0x10207b49 0x8701c20 0x7a490870 0x2207a49 0x8700120 0x79490870 0xf0dcfc 0x73480078 0xfff720fb 0x76490860 0xfff7d2fb 0x71480078 0xfff718fb 0xc6b2552e 0x25ddfa2c 0x5db1420 0x70490870 0x70490870 0x8ae0a02c 0x5db1420 0x6c490870 0x6c490870 0x82e0782c 0x5db1420 0x68490870 0x68490870 0x7ae0322c 0x5db1420 0x64490870 0x64490870 0x72e01420 0x61490870 0x61490870 0x6ce04b2e 0x25ddfa2c 0x5db1420 0x5c490870 0x5c490870 0x62e0a02c 0x5db1e20 0x58490870 0x58490870 0x5ae0782c 0x5db1420 0x54490870 0x54490870 0x52e0322c 0x5db1420 0x50490870 0x50490870 0x4ae01420 0x4d490870 0x4d490870 0x44e0322e 0x25ddfa2c 0x5db3c20 0x48490870 0x48490870 0x3ae0a02c 0x5db2820 0x44490870 0x44490870 0x32e0782c 0x5db1e20 0x40490870 0x40490870 0x2ae0322c 0x5db1e20 0x3c490870 0x3c490870 0x22e01420 0x39490870 0x39490870 0x1ce0a02c 0x5db3b20 0x35490870 0x35490870 0x14e0782c 0x5db2820 0x31490870 0x31490870 0xce0322c 0x5db1e20 0x2d490870 0x2d490870 0x4e01420 0x2a490870 0x2a490870 0xfff736fb 0xfff7f0fd 0x1202849 0x8700ce0 0xf030fc 0x15480078 0x2803d1 0x18480078 0x12802dd 0x542000f0 0x77f9fff7 0xd3fd0128 0xeed0fff7 0x5dfb0000 0x7e280000 0x20 0x4000020 0x68000020 0x8c280000 0xa8280000 0xd2280000 0x70280000 0x5000020 0x6000020 0x7000020 0x8000020 0x9000020 0x10000020 0x30000020 0x2b000020 0x63000020 0x31000020 0x70000020 0x27000020 0x24000020 0x20000020 0x21000020 0x22000020 0x23000020 0x25000020 0xc000020 0x5f000020 0x60000020 0x12000020 0x10b500f0 0xdbf8fff7 0xf5fa0020 0xf0ecf8 0xfff7d6fa 0x12000f0 0xe7f810bd 0x2806d0 0x7490978 0x2902d1 0x5490870 0x7e00028 0x5d10349 0x9780029 0x1d00149 0x8707047 0x77000020 0x704700b5 0xfff75afd 0xf0a0f8 0xf048f8 0xf05cf8 0xf004f8 0xfff7f9f9 0xbd0000 0x9480069 0x4218843 0x7490861 0x8460069 0x30218843 0x4490861 0x8460069 0x40084000 0x401c0861 0x70470000 0x500040 0x9480069 0x2218843 0x7490861 0x8460069 0x40084000 0x8610846 0x690421 0x8843001d 0x1490861 0x70470000 0x500040 0x2807d0 0x7490969 0x2229143 0x891c054a 0x116105e0 0x3490969 0x2229143 0x14a1161 0x70470000 0x500040 0x9480068 0x4218843 0x7490860 0x8460068 0x30218843 0x10300449 0x8600846 0x684008 0x4000401c 0x8607047 0x500040 0x9484069 0x4218843 0x7494861 0x8464069 0x30218843 0x4494861 0x8464069 0x40084000 0x401c4861 0x70470000 0x500040 0x9484069 0x2218843 0x7494861 0x8464069 0x40084000 0x48610846 0x40690421 0x8843001d 0x1494861 0x70470000 0x500040 0x2807d0 0x7494969 0x2229143 0x891c054a 0x516105e0 0x3494969 0x2229143 0x14a5161 0x70470000 0x500040 0x9484068 0x4218843 0x7494860 0x8464068 0x30218843 0x20300449 0x48600846 0x40684008 0x4000401c 0x48607047 0x500040 0x9484068 0x2218843 0x7494860 0x8464068 0x40084000 0x48600846 0x40680421 0x8843001d 0x1494860 0x70470000 0x500040 0x2807d0 0x7494968 0x2229143 0x891c054a 0x516005e0 0x3494968 0x2229143 0x14a5160 0x70470000 0x500040 0x30b50346 0x10480478 0x10480078 0x984201dd 0xe480370 0xe480170 0xe480270 0x914200da 0xa460a48 0x789042 0x2dd0748 0x27003e0 0x6480078 0x44d2870 0x3480078 0x844201d0 0x52030bd 0x20fce7 0x5f000020 0x60000020 0x5d000020 0x5e000020 0x10b50446 0xf0aafa 0x20fff7 0x31fcfff7 0x4bff2046 0xf080f8 0xf002f8 0x10bd0000 0xbf0448 0x449c860 0xbff34f8f 0xbf00bf 0xfee70000 0x400fa05 0xed00e0 0x10b50748 0x780228 0x9d00548 0x780128 0x3d10220 0x2490870 0x1e0fff7 0xe3ff10bd 0x70000020 0x10b50024 0xfff7e0fe 0xbf19e0 0x20fff7 0xf1fe0120 0xfff7a4f9 0x120fff7 0xebfe0120 0xfff79ef9 0x20fff7 0xe5fe0220 0xfff798f9 0x120fff7 0xdffe0320 0xfff792f9 0x601cc4b2 0xf2ce3db 0x10bd0000 0x7200121 0x81400f4a 0x116000bf 0xe484068 0x7d21c901 0x8460c49 0x48600846 0x684021 0x88434030 0x8490860 0x8460068 0x20218843 0x20300549 0x8600846 0x684008 0x40000860 0x70470000 0xe100e0 0x100040 0x3480068 0x40084000 0x401c0149 0x8607047 0x100040 0x2490968 0xc807c00f 0x70470000 0x100040 0xfeb50546 0x2700f0 0x1dfa0195 0x203c49 0x870fff7 0x35fe0024 0x1fe03a48 0x780028 0x3d0582d 0x1d1fff7 0xb3fe00f0 0xbfa00bf 0x33480078 0x28fbd0 0xf004fa 0x620011b 0x1980841 0xc007c00f 0x900098 0xfff70cff 0x202b49 0x870601c 0xc4b2072c 0xdddb00f0 0xf1f90024 0x2fe02748 0x780028 0x3d0582d 0x1d1fff7 0x8dfe00f0 0xe5f900bf 0x20480078 0x28fbd0 0xf0def9 0x2c03d1 0xfff7c0fe 0xfff7f0f8 0x201a49 0x870fff7 0x7bfb0646 0x62c06d1 0x18480078 0x280ad1 0x17480670 0x7e0002c 0x5d00520 0x11b3046 0x88403843 0xc7b2601c 0xc4b2072c 0xcddb00f0 0xbbf900bf 0xb480078 0x28fbd0 0xf0b4f9 0xfff7aefe 0xfff7c8f8 0x20fff7 0xbffe0020 0x4490870 0xfff7a6f8 0xfff7a4f8 0xf0a4f9 0x3846febd 0x11000020 0x10000020 0x25000020 0x24000020 0xfeb50546 0x2700f0 0x95f90195 0x203749 0x870fff7 0xadfd0024 0x1fe03548 0x780028 0x3d0582d 0x1d1fff7 0x2bfe00f0 0x83f900bf 0x2e480078 0x28fbd0 0xf07cf9 0x620011b 0x1980841 0xc007c00f 0x900098 0xfff784fe 0x202649 0x870601c 0xc4b2072c 0xdddb00f0 0x69f90024 0x24e02248 0x780028 0x3d0582d 0x1d1fff7 0x5fe00f0 0x5df900bf 0x1b480078 0x28fbd0 0xf056f9 0x2c03d1 0xfff738fe 0xfff768f8 0x201549 0x870fff7 0xf3fa0646 0x620011b 0x30468840 0x3843c7b2 0x601cc4b2 0x72cd8db 0xf03ef9 0xbf0c48 0x780028 0xfbd000f0 0x37f9fff7 0x31fefff7 0x4bf80020 0xfff742fe 0x200549 0x870fff7 0x29f8fff7 0x27f800f0 0x27f93846 0xfebd0000 0x11000020 0x10000020 0x203549 0x8603549 0x8703549 0x8703549 0x8703549 0x8703549 0x8703549 0x8700120 0x48708870 0x203349 0x8703349 0x8703349 0x8703349 0x8703349 0x8703349 0x8703349 0x8703349 0x8703349 0x8703349 0x8703349 0x8703349 0x8703349 0x8700320 0x32490870 0x203249 0x8703249 0x8703249 0x8703249 0x880401e 0x31490880 0x203149 0x8703149 0x8703149 0x8703149 0x8703149 0x8703149 0x8703149 0x8703149 0x8703149 0x8703b20 0x30490870 0x30490870 0x30490870 0x30490870 0x203049 0x8703049 0x8700320 0x2f490870 0x2f490870 0x202f49 0x8700420 0x2e490870 0x202e49 0x8707047 0xc000020 0x10000020 0x11000020 0x12000020 0x13000020 0x1c000020 0x80000020 0x1d000020 0x1e000020 0x1f000020 0x20000020 0x21000020 0x22000020 0x23000020 0x24000020 0x25000020 0x65000020 0x66000020 0x26000020 0x27000020 0x28000020 0x29000020 0x2a000020 0x2b000020 0x2c000020 0x2e000020 0x30000020 0x31000020 0x32000020 0x33000020 0x34000020 0x35000020 0x36000020 0x37000020 0x5c000020 0x5d000020 0x5e000020 0x5f000020 0x60000020 0x61000020 0x62000020 0x63000020 0x64000020 0x70000020 0x71000020 0x68000020 0xf0b50546 0x240026 0x272846 0xfef71efe 0x4461f48 0x68241a 0x1e480068 0xe1210901 0x884202da 0x7d26f600 0x77001a48 0x681a49 0x884203da 0x7d26f600 0x77001ee0 0x15480068 0x15496431 0x884203da 0x7d26f600 0x770014e0 0x10480068 0x7d214901 0x884202da 0x8e104f10 0xbe00c48 0x680d49 0x884203da 0x7d26f600 0x770002e0 0x7d26f600 0x7700b442 0x1da0020 0xf0bdbc42 0x1dd0220 0xfae70120 0xf8e70000 0x6c000020 0xc000020 0x740e0000 0x4100000 0x5a200249 0x8618020 0x8617047 0x700040 0x5a200549 0x8610846 0x694021 0x88434030 0x1490861 0x70470000 0x700040 0x100 0x1000001 0x1000001 0x1010000 0x1000100 0x10100 0x10100 0x101 0x1010001 0x1000100 0x10000 0x1000100 0x10100 0x1000101 0x10100 0x10001 0x10000 0x00 0x1010101 0x10100 0x1000001 0x100 0x1000001 0x1000100 0x1010001 0x1000001 0x10001 0x00 0x101 0x1010001 0x1000100 0x10000 0x1000100 0x10100 0x1000101 0x1c290000 0x20 0x80000000 0xd0000000 0x9c290000 0x80000020 0x88050000 0xec000000 0x00 0x00 0x00 0x00 0x00 0x00 0x00 0x00 0x00 0x00 0x3000000 0xffff 0x00 0x00 0x2823 0xc4040000 0x00 0x00 0x00 0x00 0x00 0x00 0x00 0x00 0x03 0x3000000 0x00 0x00 0x40000 0x00 0x00 0x00 0x20007 0x3000500 0x6345534>;
				qcom,vooc-dis-temp-soc = <0x01>;
				qcom,vooc-dis-id-verify = <0x01>;
				qcom,vooc-high-temp = <0x1ae>;
				qcom,vooc-low-soc = <0x01>;
				qcom,vooc-high-soc = <0x5a>;
				qcom,vooc_cool_bat_volt = <0xe42>;
				qcom,vooc_little_cool_bat_volt = <0xdde>;
				qcom,vooc_normal_bat_volt = <0xd7a>;
				qcom,vooc_warm_bat_volt = <0xd16>;
				qcom,vooc_cool_bat_suspend_volt = <0xe42>;
				qcom,vooc_little_cool_bat_suspend_volt = <0xdde>;
				qcom,vooc_normal_bat_suspend_volt = <0xd7a>;
				qcom,vooc_warm_bat_suspend_volt = <0xd16>;
				qcom,vooc_multistep_adjust_current_support;
				qcom,vooc_multistep_initial_batt_temp = <0x3e8>;
				qcom,vooc_strategy_normal_current = <0x0b>;
				qcom,vooc_batt_over_high_temp = <0x1b8>;
				qcom,vooc_batt_over_low_temp = <0x00>;
				qcom,vooc_over_high_or_low_current = <0x03>;
				qcom,vooc_strategy1_batt_high_temp0 = <0x1ae>;
				qcom,vooc_strategy1_batt_high_temp1 = <0x1b3>;
				qcom,vooc_strategy1_batt_high_temp2 = <0x1b8>;
				qcom,vooc_strategy1_batt_low_temp2 = <0x1ae>;
				qcom,vooc_strategy1_batt_low_temp1 = <0x19a>;
				qcom,vooc_strategy1_batt_low_temp0 = <0x186>;
				qcom,vooc_strategy1_high_current0 = <0x07>;
				qcom,vooc_strategy1_high_current1 = <0x05>;
				qcom,vooc_strategy1_high_current2 = <0x04>;
				qcom,vooc_strategy1_low_current2 = <0x05>;
				qcom,vooc_strategy1_low_current1 = <0x09>;
				qcom,vooc_strategy1_low_current0 = <0x0b>;
				qcom,vooc_current_lvl = <0x3e8 0x5dc 0x7d0 0x9c4 0xbb8 0xdac 0xfa0 0x1194 0x1388 0x157c 0x1770 0x1964 0x1b58 0x1d4c 0x1f40 0x2134 0x2328 0x251c 0x2710 0x2904 0x2af8 0x2cec 0x2ee0 0x30d4>;
				pinctrl-names = "switch1_act_switch2_act\0switch1_sleep_switch2_sleep\0switch1_act_switch3_act\0switch1_sleep_switch3_sleep\0switch1_act_switch2_sleep\0switch1_sleep_switch2_act\0clock_active\0clock_sleep\0data_active\0data_sleep\0reset_active\0reset_sleep\0vooc_asic_id_active\0vooc_asic_id_sleep";
				pinctrl-0 = <0x3b>;
				pinctrl-1 = <0x3c>;
				pinctrl-2 = <0x3b>;
				pinctrl-3 = <0x3c>;
				pinctrl-4 = <0x3b>;
				pinctrl-5 = <0x3c>;
				pinctrl-6 = <0x3d>;
				pinctrl-7 = <0x3e>;
				pinctrl-8 = <0x3f>;
				pinctrl-9 = <0x40>;
				pinctrl-10 = <0x41>;
				pinctrl-11 = <0x42>;
				pinctrl-12 = <0x43>;
				pinctrl-13 = <0x44>;
				qcom,charging_switch1-gpio = <0xffffffff 0x54 0x00>;
				qcom,charging_reset-gpio = <0xffffffff 0x0e 0x00>;
				qcom,charging_clock-gpio = <0xffffffff 0xc8 0x00>;
				qcom,charging_data-gpio = <0xffffffff 0xc9 0x00>;
				qcom,vooc_asic_id-gpio = <0xffffffff 0x15 0x00>;
			};
		};
	};

	fragment@44 {
		target = <0xffffffff>;

		__overlay__ {

			eint0default {
				phandle = <0x34>;
			};

			charger_gpio_as_output_low {
				phandle = <0x35>;

				pins_cmd_dat {
					pinmux = <0xc300>;
					slew-rate = <0x01>;
					output-low;
				};
			};

			charger_gpio_as_output_high {
				phandle = <0x36>;

				pins_cmd_dat {
					pinmux = <0xc300>;
					slew-rate = <0x01>;
					output-high;
				};
			};

			ship_sleep {
				phandle = <0x37>;

				pins_cmd_dat {
					pinmux = <0xb00>;
					slew-rate = <0x01>;
					output-low;
				};
			};

			ship_active {
				phandle = <0x38>;

				pins_cmd_dat {
					pinmux = <0xb00>;
					slew-rate = <0x01>;
					output-high;
				};
			};

			dischg_enable {
				phandle = <0x39>;

				pins_cmd_dat {
					pinmux = <0xd00>;
					slew-rate = <0x01>;
					bias-pull-up = <0x00>;
					output-high;
				};
			};

			dischg_disable {
				phandle = <0x3a>;

				pins_cmd_dat {
					pinmux = <0xd00>;
					slew-rate = <0x01>;
					bias-pull-down = <0x00>;
					output-low;
				};
			};
		};
	};

	fragment@45 {
		target = <0xffffffff>;

		__overlay__ {

			charging_switch1_ctr1_active {
				phandle = <0x92>;

				pins_cmd_dat {
					pinmux = <0x9400>;
					slew-rate = <0x01>;
					output-high;
				};
			};

			charging_switch1_ctr1_sleep {
				phandle = <0x93>;

				pins_cmd_dat {
					pinmux = <0x9400>;
					slew-rate = <0x01>;
					output-low;
				};
			};

			charging_switch1_active {
				phandle = <0x3b>;

				pins_cmd_dat {
					pinmux = <0x5400>;
					slew-rate = <0x01>;
					output-high;
				};
			};

			charging_switch1_sleep {
				phandle = <0x3c>;

				pins_cmd_dat {
					pinmux = <0x5400>;
					slew-rate = <0x01>;
					output-low;
				};
			};

			charging_clock_active {
				phandle = <0x3d>;

				pins_cmd_dat {
					pinmux = <0xc800>;
					slew-rate = <0x00>;
					bias-pull-up;
				};
			};

			charging_clock_sleep {
				phandle = <0x3e>;

				pins_cmd_dat {
					pinmux = <0xc800>;
					slew-rate = <0x00>;
					bias-pull-down;
				};
			};

			charging_data_active {
				phandle = <0x3f>;

				pins_cmd_dat {
					pinmux = <0xc900>;
					slew-rate = <0x00>;
					bias-pull-down;
				};
			};

			charging_data_sleep {
				phandle = <0x40>;

				pins_cmd_dat {
					pinmux = <0xc900>;
					slew-rate = <0x00>;
					bias-pull-down;
				};
			};

			charging_reset_active {
				phandle = <0x41>;

				pins_cmd_dat {
					pinmux = <0xe00>;
					slew-rate = <0x01>;
					output-high;
				};
			};

			charging_reset_sleep {
				phandle = <0x42>;

				pins_cmd_dat {
					pinmux = <0xe00>;
					slew-rate = <0x01>;
					output-low;
				};
			};

			vooc_asic_id_active {
				phandle = <0x43>;

				pins_cmd_dat {
					pinmux = <0x1500>;
					input-enable;
					slew-rate = <0x00>;
					bias-pull-up;
				};
			};

			vooc_asic_id_sleep {
				phandle = <0x44>;

				pins_cmd_dat {
					pinmux = <0x1500>;
					input-enable;
					slew-rate = <0x00>;
					bias-pull-down;
				};
			};
		};
	};

	fragment@46 {
		target = <0xffffffff>;

		__overlay__ {
			pinctrl-names = "i2c-state\0output-low-state";
			pinctrl-0 = <0x45 0x46>;
			pinctrl-1 = <0x47 0x48>;
		};
	};

	fragment@47 {
		target = <0xffffffff>;

		__overlay__ {

			i2c7_sda_i2c_state {
				phandle = <0x45>;

				pins_cmd_dat {
					pinmux = <0xc701>;
					slew-rate = <0x00>;
					bias-pull-up;
				};
			};

			i2c7_sda_output_low_state {
				phandle = <0x47>;

				pins_cmd_dat {
					pinmux = <0xc700>;
					slew-rate = <0x01>;
					output-low;
				};
			};

			i2c7_scl_i2c_state {
				phandle = <0x46>;

				pins_cmd_dat {
					pinmux = <0xc601>;
					slew-rate = <0x00>;
					bias-pull-up;
				};
			};

			i2c7_scl_output_low_state {
				phandle = <0x48>;

				pins_cmd_dat {
					pinmux = <0xc600>;
					slew-rate = <0x01>;
					output-low;
				};
			};
		};
	};

	fragment@48 {
		target = <0xffffffff>;

		__overlay__ {

			fan53870@35 {
				compatible = "fan53870";
				reg = <0x35>;
				ldo1_min_vol = "\0\f5";
				ldo1_max_vol = <0x16f300>;
				ldo1_step_vol = <0x1f40>;
				fan53870,gpio_rst = <0xffffffff 0x7a 0x00>;
				fan53870,ldo5-always-on = <0x01>;
			};
		};
	};

	fragment@49 {
		target = <0xffffffff>;

		__overlay__ {

			camera0_rst_output_low@gpio124 {
				phandle = <0x4a>;

				pins_cmd_dat {
					pinmux = <0x7c00>;
					output-low;
				};
			};

			camera0_rst_output_high@gpio124 {
				phandle = <0x4b>;

				pins_cmd_dat {
					pinmux = <0x7c00>;
					output-high;
				};
			};

			camera0_vcamd_output_low@gpio123 {
				phandle = <0x4c>;

				pins_cmd_dat0 {
					pinmux = <0x7300>;
					output-low;
				};

				pins_cmd_dat1 {
					pinmux = <0x7b00>;
					output-low;
				};
			};

			camera0_vcamd_output_high@gpio123 {
				phandle = <0x4d>;

				pins_cmd_dat0 {
					pinmux = <0x7300>;
					output-high;
				};

				pins_cmd_dat1 {
					pinmux = <0x7b00>;
					output-high;
				};
			};

			camera1_rst_output_low@gpio197 {
				phandle = <0x4e>;

				pins_cmd_dat {
					pinmux = <0xc500>;
					output-low;
				};
			};

			camera1_rst_output_high@gpio197 {
				phandle = <0x4f>;

				pins_cmd_dat {
					pinmux = <0xc500>;
					output-high;
				};
			};

			camera2_rst_output_low@gpio119 {
				phandle = <0x50>;

				pins_cmd_dat {
					pinmux = <0x7700>;
					output-low;
				};
			};

			camera2_rst_output_high@gpio119 {
				phandle = <0x51>;

				pins_cmd_dat {
					pinmux = <0x7700>;
					output-high;
				};
			};

			camera3_pnd_output_low@gpio125 {
				phandle = <0x52>;

				pins_cmd_dat {
					pinmux = <0x7d00>;
					output-low;
				};
			};

			camera3_pnd_output_high@gpio125 {
				phandle = <0x53>;

				pins_cmd_dat {
					pinmux = <0x7d00>;
					output-high;
				};
			};

			camera4_pnd_output_low@gpio118 {
				phandle = <0x54>;

				pins_cmd_dat {
					pinmux = <0x7600>;
					output-low;
				};
			};

			camera4_pnd_output_high@gpio118 {
				phandle = <0x55>;

				pins_cmd_dat {
					pinmux = <0x7600>;
					output-high;
				};
			};

			camera0_mclk_gpio_mode@gpio120 {
				phandle = <0x56>;

				pins_cmd_dat {
					pinmux = <0x7800>;
					drive-strength = <0x01>;
				};
			};

			camera0_mclk_2ma@gpio120 {
				phandle = <0x57>;

				pins_cmd_dat {
					pinmux = <0x7801>;
					drive-strength = <0x00>;
				};
			};

			camera0_mclk_4ma@gpio120 {
				phandle = <0x58>;

				pins_cmd_dat {
					pinmux = <0x7801>;
					drive-strength = <0x01>;
				};
			};

			camera0_mclk_6ma@gpio120 {
				phandle = <0x59>;

				pins_cmd_dat {
					pinmux = <0x7801>;
					drive-strength = <0x02>;
				};
			};

			camera0_mclk_8ma@gpio120 {
				phandle = <0x5a>;

				pins_cmd_dat {
					pinmux = <0x7801>;
					drive-strength = <0x03>;
				};
			};

			camera1_mclk_gpio_mode@gpio196 {
				phandle = <0x5b>;

				pins_cmd_dat {
					pinmux = <0xc400>;
					drive-strength = <0x01>;
				};
			};

			camera1_mclk_2ma@gpio196 {
				phandle = <0x5c>;

				pins_cmd_dat {
					pinmux = <0xc401>;
					drive-strength = <0x00>;
				};
			};

			camera1_mclk_4ma@gpio196 {
				phandle = <0x5d>;

				pins_cmd_dat {
					pinmux = <0xc401>;
					drive-strength = <0x01>;
				};
			};

			camera1_mclk_6ma@gpio196 {
				phandle = <0x5e>;

				pins_cmd_dat {
					pinmux = <0xc401>;
					drive-strength = <0x02>;
				};
			};

			camera1_mclk_8ma@gpio196 {
				phandle = <0x5f>;

				pins_cmd_dat {
					pinmux = <0xc401>;
					drive-strength = <0x03>;
				};
			};

			camera2_mclk_gpio_mode@gpio117 {
				phandle = <0x60>;

				pins_cmd_dat {
					pinmux = <0x7500>;
					drive-strength = <0x01>;
				};
			};

			camera2_mclk_2ma@gpio117 {
				phandle = <0x61>;

				pins_cmd_dat {
					pinmux = <0x7501>;
					drive-strength = <0x00>;
				};
			};

			camera2_mclk_4ma@gpio117 {
				phandle = <0x62>;

				pins_cmd_dat {
					pinmux = <0x7501>;
					drive-strength = <0x01>;
				};
			};

			camera2_mclk_6ma@gpio117 {
				phandle = <0x63>;

				pins_cmd_dat {
					pinmux = <0x7501>;
					drive-strength = <0x02>;
				};
			};

			camera2_mclk_8ma@gpio117 {
				phandle = <0x64>;

				pins_cmd_dat {
					pinmux = <0x7501>;
					drive-strength = <0x03>;
				};
			};

			camera3_mclk_gpio_mode@gpio121 {
				phandle = <0x65>;

				pins_cmd_dat {
					pinmux = <0x7900>;
					drive-strength = <0x01>;
				};
			};

			camera3_mclk_2ma@gpio121 {
				phandle = <0x66>;

				pins_cmd_dat {
					pinmux = <0x7901>;
					drive-strength = <0x00>;
				};
			};

			camera3_mclk_4ma@gpio121 {
				phandle = <0x67>;

				pins_cmd_dat {
					pinmux = <0x7901>;
					drive-strength = <0x01>;
				};
			};

			camera3_mclk_6ma@gpio121 {
				phandle = <0x68>;

				pins_cmd_dat {
					pinmux = <0x7901>;
					drive-strength = <0x02>;
				};
			};

			camera3_mclk_8ma@gpio121 {
				phandle = <0x69>;

				pins_cmd_dat {
					pinmux = <0x7901>;
					drive-strength = <0x03>;
				};
			};

			camera4_mclk_gpio_mode@gpio116 {
				phandle = <0x6a>;

				pins_cmd_dat {
					pinmux = <0x7400>;
					drive-strength = <0x01>;
				};
			};

			camera4_mclk_2ma@gpio116 {
				phandle = <0x6b>;

				pins_cmd_dat {
					pinmux = <0x7401>;
					drive-strength = <0x00>;
				};
			};

			camera4_mclk_4ma@gpio116 {
				phandle = <0x6c>;

				pins_cmd_dat {
					pinmux = <0x7401>;
					drive-strength = <0x01>;
				};
			};

			camera4_mclk_6ma@gpio116 {
				phandle = <0x6d>;

				pins_cmd_dat {
					pinmux = <0x7401>;
					drive-strength = <0x02>;
				};
			};

			camera4_mclk_8ma@gpio116 {
				phandle = <0x6e>;

				pins_cmd_dat {
					pinmux = <0x7401>;
					drive-strength = <0x03>;
				};
			};

			camera_mipi_switch_low@gpio72 {
				phandle = <0x6f>;

				pins_cmd_dat {
					pinmux = <0x4800>;
					output-low;
				};
			};

			camera_mipi_switch_high@gpio72 {
				phandle = <0x70>;

				pins_cmd_dat {
					pinmux = <0x4800>;
					output-high;
				};
			};

			fan53870_gpio_enable@gpio122 {
				phandle = <0x71>;

				pins_cmd_dat {
					pinmux = <0x7a00>;
					output-high;
				};
			};

			fan53870_gpio_disable@gpi122 {
				phandle = <0x72>;

				pins_cmd_dat {
					pinmux = <0x7a00>;
					output-low;
				};
			};

			camdefault {
				phandle = <0x49>;
			};
		};
	};

	fragment@50 {
		target = <0xffffffff>;

		__overlay__ {
			pinctrl-names = "default\0cam0_rst0\0cam0_rst1\0cam0_ldo_vcamd_0\0cam0_ldo_vcamd_1\0cam1_rst0\0cam1_rst1\0cam2_rst0\0cam2_rst1\0cam3_pnd0\0cam3_pnd1\0cam4_pnd0\0cam4_pnd1\0cam0_mclk_off\0cam0_mclk_2mA\0cam0_mclk_4mA\0cam0_mclk_6mA\0cam0_mclk_8mA\0cam1_mclk_off\0cam1_mclk_2mA\0cam1_mclk_4mA\0cam1_mclk_6mA\0cam1_mclk_8mA\0cam2_mclk_off\0cam2_mclk_2mA\0cam2_mclk_4mA\0cam2_mclk_6mA\0cam2_mclk_8mA\0cam3_mclk_off\0cam3_mclk_2mA\0cam3_mclk_4mA\0cam3_mclk_6mA\0cam3_mclk_8mA\0cam4_mclk_off\0cam4_mclk_2mA\0cam4_mclk_4mA\0cam4_mclk_6mA\0cam4_mclk_8mA\0cam_mipi_switch_sel_0\0cam_mipi_switch_sel_1\0fan53870_chip_enable\0fan53870_chip_disable";
			pinctrl-0 = <0x49>;
			pinctrl-1 = <0x4a>;
			pinctrl-2 = <0x4b>;
			pinctrl-3 = <0x4c>;
			pinctrl-4 = <0x4d>;
			pinctrl-5 = <0x4e>;
			pinctrl-6 = <0x4f>;
			pinctrl-7 = <0x50>;
			pinctrl-8 = <0x51>;
			pinctrl-9 = <0x52>;
			pinctrl-10 = <0x53>;
			pinctrl-11 = <0x54>;
			pinctrl-12 = <0x55>;
			pinctrl-13 = <0x56>;
			pinctrl-14 = <0x57>;
			pinctrl-15 = <0x58>;
			pinctrl-16 = <0x59>;
			pinctrl-17 = <0x5a>;
			pinctrl-18 = <0x5b>;
			pinctrl-19 = <0x5c>;
			pinctrl-20 = <0x5d>;
			pinctrl-21 = <0x5e>;
			pinctrl-22 = <0x5f>;
			pinctrl-23 = <0x60>;
			pinctrl-24 = <0x61>;
			pinctrl-25 = <0x62>;
			pinctrl-26 = <0x63>;
			pinctrl-27 = <0x64>;
			pinctrl-28 = <0x65>;
			pinctrl-29 = <0x66>;
			pinctrl-30 = <0x67>;
			pinctrl-31 = <0x68>;
			pinctrl-32 = <0x69>;
			pinctrl-33 = <0x6a>;
			pinctrl-34 = <0x6b>;
			pinctrl-35 = <0x6c>;
			pinctrl-36 = <0x6d>;
			pinctrl-37 = <0x6e>;
			pinctrl-38 = <0x6f>;
			pinctrl-39 = <0x70>;
			pinctrl-40 = <0x71>;
			pinctrl-41 = <0x72>;
			cam0_vcamio-supply = <0xffffffff>;
			cam1_vcamio-supply = <0xffffffff>;
			cam2_vcamio-supply = <0xffffffff>;
			cam3_vcamio-supply = <0xffffffff>;
			cam4_vcamio-supply = <0xffffffff>;
			cam0_enable_sensor = "ov64b_mipi_raw_20730";
			cam1_enable_sensor = "imx471_mipi_raw2_20730";
			cam2_enable_sensor = "ov8856_mipi_raw2_20730";
			cam3_enable_sensor = "gc02m1_mipi_raw_20730";
			cam4_enable_sensor = "gc02m1b_mipi_mono_20730";
			status = "okay";
		};
	};

	fragment@51 {
		target = <0xffffffff>;

		__overlay__ {
			oplus,speaker-vendor = "awinic_digital";
			oplus,speaker-i2s-id = <0x03>;
			oplus,speaker-codec-name = "aw882xx_smartpa";
			oplus,speaker-codec-dai-name = "aw882xx-aif";
		};
	};

	fragment@52 {
		target = <0xffffffff>;

		__overlay__ {
			audio_extern_config = <0x03>;
		};
	};

	fragment@53 {
		target = <0xffffffff>;

		__overlay__ {

			pins_cmd_dat {
				pinmux = <0x2100>;
			};
		};
	};

	fragment@54 {
		target = <0xffffffff>;

		__overlay__ {

			pins_cmd_dat {
				pinmux = <0x2102>;
			};
		};
	};

	fragment@55 {
		target = <0xffffffff>;

		__overlay__ {

			pins_cmd_dat {
				pinmux = <0x1f00 0x2000 0x2200>;
			};
		};
	};

	fragment@56 {
		target = <0xffffffff>;

		__overlay__ {

			pins_cmd_dat {
				pinmux = <0x1f02 0x2002 0x2202>;
			};
		};
	};

	fragment@57 {
		target = <0xffffffff>;

		__overlay__ {

			adc_channel@ {
				compatible = "mediatek,adc_channel";
				mediatek,temperature0 = <0x00>;
				mediatek,temperature1 = <0x01>;
				mediatek,adc_fdd_rf_params_dynamic_custom_ch = <0x02>;
				status = "okay";
			};
		};
	};

	fragment@58 {
		target = <0xffffffff>;

		__overlay__ {
			io-channels = <0xffffffff 0x02>;
		};
	};

	fragment@59 {
		target = <0xffffffff>;

		__overlay__ {
			mediatek,clkbuf-quantity = <0x07>;
			mediatek,clkbuf-config = <0x02 0x01 0x01 0x02 0x00 0x00 0x01>;
			mediatek,clkbuf-output-impedance = <0x04 0x04 0x04 0x04 0x00 0x00 0x04>;
			mediatek,clkbuf-controls-for-desense = <0x00 0x04 0x00 0x03 0x00 0x00 0x00>;
			status = "okay";
		};
	};

	fragment@60 {
		target = <0xffffffff>;

		__overlay__ {
			#address-cells = <0x01>;
			#size-cells = <0x00>;
			clock-frequency = <0x61a80>;
			mediatek,use-open-drain;
		};
	};

	fragment@61 {
		target = <0xffffffff>;

		__overlay__ {
			#address-cells = <0x01>;
			#size-cells = <0x00>;
			clock-frequency = <0x61a80>;
			mediatek,use-open-drain;
		};
	};

	fragment@62 {
		target = <0xffffffff>;

		__overlay__ {
			#address-cells = <0x01>;
			#size-cells = <0x00>;
			clock-frequency = <0x61a80>;
			mediatek,use-open-drain;

			camera_main@1a {
				compatible = "mediatek,camera_main";
				reg = <0x1a>;
				status = "okay";
				phandle = <0x94>;
			};

			camera_main_af@0c {
				compatible = "mediatek,camera_main_af";
				reg = <0x0c>;
				status = "okay";
				phandle = <0x95>;
			};

			camera_main_eeprom@50 {
				compatible = "mediatek,camera_main_eeprom";
				reg = <0x50>;
				status = "okay";
				phandle = <0x96>;
			};

			ccu_sensor_i2c_2_hw@33 {
				compatible = "mediatek,ccu_sensor_i2c_2_hw";
				reg = <0x33>;
				status = "okay";
				phandle = <0x97>;
			};
		};
	};

	fragment@63 {
		target = <0xffffffff>;

		__overlay__ {
			#address-cells = <0x01>;
			#size-cells = <0x00>;
			clock-frequency = <0x61a80>;
			mediatek,use-open-drain;

			nfc@08 {
				compatible = "mediatek,nfc";
				reg = <0x08>;
				status = "okay";
				phandle = <0x98>;
			};
		};
	};

	fragment@64 {
		target = <0xffffffff>;

		__overlay__ {
			#address-cells = <0x01>;
			#size-cells = <0x00>;
			clock-frequency = <0x61a80>;
			mediatek,use-open-drain;

			camera_sub@2d {
				compatible = "mediatek,camera_sub";
				reg = <0x2d>;
				status = "okay";
				phandle = <0x99>;
			};

			camera_sub_eeprom@52 {
				compatible = "mediatek,camera_sub_eeprom";
				reg = <0x52>;
				status = "okay";
				phandle = <0x9a>;
			};

			camera_main_two@10 {
				compatible = "mediatek,camera_main_two";
				reg = <0x10>;
				status = "okay";
				phandle = <0x9b>;
			};

			camera_main_two_af@0c {
				compatible = "mediatek,camera_main_two_af";
				reg = <0x0c>;
				status = "okay";
				phandle = <0x9c>;
			};

			camera_main_two_eeprom@50 {
				compatible = "mediatek,camera_main_two_eeprom";
				reg = <0x50>;
				status = "okay";
				phandle = <0x9d>;
			};

			ccu_sensor_i2c_4_hw@36 {
				compatible = "mediatek,ccu_sensor_i2c_4_hw";
				reg = <0x36>;
				status = "okay";
				phandle = <0x9e>;
			};
		};
	};

	fragment@65 {
		target = <0xffffffff>;

		__overlay__ {
			#address-cells = <0x01>;
			#size-cells = <0x00>;
			clock-frequency = <0x33e140>;
			mediatek,use-push-pull;

			subpmic@34 {
				compatible = "mediatek,subpmic";
				reg = <0x34>;
				status = "okay";
				phandle = <0x9f>;
			};

			usb_type_c@4e {
				compatible = "mediatek,usb_type_c";
				reg = <0x4e>;
				status = "okay";
				phandle = <0xa0>;
			};

			subpmic_pmic@1a {
				compatible = "mediatek,subpmic_pmic";
				reg = <0x1a>;
				status = "okay";
				phandle = <0xa1>;
			};

			subpmic_ldo@64 {
				compatible = "mediatek,subpmic_ldo";
				reg = <0x64>;
				status = "okay";
				phandle = <0xa2>;
			};
		};
	};

	fragment@66 {
		target = <0xffffffff>;

		__overlay__ {
			#address-cells = <0x01>;
			#size-cells = <0x00>;
			clock-frequency = <0x61a80>;
			mediatek,use-open-drain;

			i2c_lcd_bias@73 {
				compatible = "mediatek,i2c_lcd_bias";
				reg = <0x73>;
				status = "okay";
				phandle = <0xa3>;
			};

			fan53870@35 {
				compatible = "mediatek,fan53870";
				reg = <0x35>;
				status = "okay";
				phandle = <0xa4>;
			};
		};
	};

	fragment@67 {
		target = <0xffffffff>;

		__overlay__ {
			#address-cells = <0x01>;
			#size-cells = <0x00>;
			clock-frequency = <0x186a0>;
			mediatek,use-open-drain;

			ccu_sensor_i2c_7_hw@43 {
				compatible = "mediatek,ccu_sensor_i2c_7_hw";
				reg = <0x43>;
				status = "okay";
				phandle = <0xa5>;
			};
		};
	};

	fragment@68 {
		target = <0xffffffff>;

		__overlay__ {
			#address-cells = <0x01>;
			#size-cells = <0x00>;
			clock-frequency = <0x61a80>;
			mediatek,use-open-drain;
		};
	};

	fragment@69 {
		target = <0xffffffff>;

		__overlay__ {
			#address-cells = <0x01>;
			#size-cells = <0x00>;
			clock-frequency = <0x33e140>;
			mediatek,use-open-drain;

			vproc_buck@6b {
				compatible = "mediatek,vproc_buck";
				reg = <0x6b>;
				status = "okay";
				phandle = <0xa6>;
			};
		};
	};

	fragment@70 {
		target = <0xffffffff>;

		__overlay__ {
			GPIO_FDD_BAND_SUPPORT_DETECT_4TH_PIN = <0xffffffff 0x49 0x00>;
			GPIO_FDD_BAND_SUPPORT_DETECT_3RD_PIN = <0xffffffff 0x4a 0x00>;
			GPIO_FDD_BAND_SUPPORT_DETECT_1ST_PIN = <0xffffffff 0x57 0x00>;
			GPIO_FDD_BAND_SUPPORT_DETECT_2ND_PIN = <0xffffffff 0x58 0x00>;
			GPIO_SIM1_SIO = <0xffffffff 0x80 0x00>;
			GPIO_SIM1_SRST = <0xffffffff 0x81 0x00>;
			GPIO_SIM1_SCLK = <0xffffffff 0x82 0x00>;
			GPIO_SIM2_SCLK = <0xffffffff 0x83 0x00>;
			GPIO_SIM2_SRST = <0xffffffff 0x84 0x00>;
			GPIO_SIM2_SIO = <0xffffffff 0x85 0x00>;
			GPIO_SIM1_HOT_PLUG = <0xffffffff 0x8c 0x00>;
			GPIO_SIM2_HOT_PLUG = <0xffffffff 0x8d 0x00>;
		};
	};

	fragment@71 {
		target = <0xffffffff>;

		__overlay__ {
			gpio_init_default = <0x00 0x00 0x00 0x00 0x01 0x01 0x01 0x01 0x00 0x00 0x00 0x01 0x01 0x01 0x02 0x00 0x01 0x00 0x00 0x00 0x01 0x03 0x00 0x00 0x00 0x01 0x00 0x01 0x04 0x00 0x00 0x00 0x01 0x00 0x01 0x05 0x00 0x00 0x00 0x00 0x00 0x01 0x06 0x00 0x01 0x00 0x00 0x00 0x01 0x07 0x00 0x00 0x00 0x01 0x01 0x01 0x08 0x00 0x00 0x00 0x01 0x01 0x01 0x09 0x00 0x00 0x00 0x01 0x00 0x01 0x0a 0x00 0x00 0x00 0x01 0x00 0x01 0x0b 0x00 0x01 0x00 0x01 0x00 0x00 0x0c 0x00 0x00 0x00 0x01 0x01 0x01 0x0d 0x00 0x01 0x00 0x01 0x00 0x01 0x0e 0x00 0x01 0x00 0x01 0x00 0x01 0x0f 0x00 0x01 0x00 0x00 0x00 0x00 0x10 0x00 0x00 0x00 0x01 0x01 0x01 0x11 0x01 0x00 0x00 0x00 0x00 0x00 0x12 0x01 0x01 0x00 0x00 0x00 0x00 0x13 0x01 0x01 0x00 0x00 0x00 0x00 0x14 0x01 0x01 0x00 0x00 0x00 0x00 0x15 0x00 0x00 0x00 0x01 0x00 0x01 0x16 0x00 0x01 0x01 0x00 0x00 0x00 0x17 0x00 0x01 0x00 0x00 0x00 0x00 0x18 0x00 0x01 0x00 0x01 0x00 0x01 0x19 0x01 0x00 0x00 0x01 0x00 0x00 0x1a 0x00 0x00 0x00 0x01 0x00 0x00 0x1c 0x01 0x00 0x00 0x01 0x01 0x01 0x1d 0x01 0x00 0x00 0x01 0x01 0x01 0x1e 0x00 0x01 0x00 0x00 0x00 0x00 0x1f 0x02 0x01 0x00 0x00 0x00 0x01 0x20 0x02 0x01 0x00 0x00 0x00 0x01 0x21 0x02 0x00 0x00 0x00 0x00 0x01 0x22 0x02 0x01 0x00 0x00 0x00 0x01 0x23 0x06 0x00 0x00 0x01 0x00 0x00 0x24 0x06 0x00 0x00 0x00 0x00 0x00 0x25 0x06 0x00 0x00 0x01 0x00 0x00 0x26 0x06 0x01 0x00 0x00 0x00 0x00 0x27 0x06 0x00 0x00 0x01 0x00 0x00 0x28 0x00 0x00 0x00 0x01 0x00 0x00 0x29 0x00 0x00 0x00 0x01 0x00 0x00 0x2a 0x00 0x00 0x00 0x01 0x00 0x00 0x2b 0x01 0x00 0x00 0x01 0x00 0x00 0x2c 0x00 0x01 0x00 0x00 0x00 0x00 0x2d 0x01 0x00 0x00 0x01 0x01 0x01 0x2e 0x01 0x00 0x00 0x01 0x01 0x01 0x2f 0x00 0x00 0x00 0x01 0x00 0x00 0x30 0x00 0x00 0x00 0x01 0x00 0x00 0x31 0x00 0x00 0x00 0x01 0x00 0x00 0x32 0x00 0x00 0x00 0x01 0x00 0x00 0x33 0x01 0x00 0x00 0x01 0x01 0x01 0x34 0x01 0x00 0x00 0x01 0x01 0x01 0x35 0x01 0x00 0x00 0x01 0x01 0x00 0x36 0x01 0x00 0x00 0x00 0x00 0x00 0x37 0x01 0x00 0x00 0x01 0x01 0x01 0x38 0x01 0x00 0x00 0x01 0x01 0x01 0x39 0x00 0x00 0x00 0x01 0x00 0x00 0x3a 0x00 0x00 0x00 0x01 0x00 0x00 0x3b 0x01 0x00 0x00 0x01 0x01 0x00 0x3c 0x01 0x00 0x00 0x01 0x01 0x00 0x3d 0x02 0x00 0x00 0x01 0x01 0x01 0x3e 0x02 0x00 0x00 0x01 0x01 0x01 0x3f 0x02 0x00 0x00 0x01 0x00 0x00 0x40 0x02 0x01 0x00 0x00 0x00 0x00 0x41 0x02 0x01 0x00 0x00 0x00 0x00 0x42 0x02 0x01 0x00 0x00 0x00 0x00 0x43 0x00 0x00 0x00 0x01 0x00 0x01 0x44 0x00 0x00 0x00 0x01 0x00 0x01 0x45 0x00 0x00 0x00 0x01 0x00 0x01 0x46 0x01 0x00 0x00 0x01 0x00 0x00 0x47 0x01 0x01 0x00 0x00 0x00 0x01 0x48 0x00 0x01 0x00 0x01 0x00 0x00 0x49 0x00 0x00 0x00 0x01 0x00 0x00 0x4a 0x00 0x00 0x00 0x01 0x00 0x00 0x4b 0x01 0x00 0x00 0x01 0x00 0x00 0x4c 0x01 0x00 0x00 0x01 0x00 0x00 0x4d 0x01 0x00 0x00 0x01 0x00 0x00 0x4e 0x00 0x00 0x00 0x01 0x00 0x00 0x4f 0x00 0x00 0x00 0x01 0x00 0x00 0x50 0x01 0x00 0x00 0x01 0x00 0x00 0x51 0x01 0x00 0x00 0x01 0x00 0x00 0x52 0x00 0x00 0x00 0x01 0x00 0x00 0x53 0x00 0x00 0x00 0x01 0x00 0x00 0x54 0x00 0x01 0x00 0x01 0x00 0x01 0x55 0x00 0x00 0x00 0x01 0x00 0x00 0x56 0x00 0x00 0x00 0x01 0x00 0x00 0x57 0x00 0x00 0x00 0x01 0x00 0x00 0x58 0x00 0x00 0x00 0x01 0x00 0x00 0x59 0x00 0x00 0x00 0x01 0x00 0x00 0x5a 0x01 0x00 0x00 0x01 0x00 0x00 0x5b 0x01 0x00 0x00 0x01 0x00 0x00 0x5c 0x01 0x00 0x00 0x01 0x00 0x00 0x5d 0x00 0x00 0x00 0x01 0x00 0x00 0x5e 0x01 0x00 0x00 0x01 0x00 0x00 0x5f 0x01 0x00 0x00 0x01 0x00 0x00 0x60 0x01 0x00 0x00 0x01 0x00 0x00 0x61 0x01 0x00 0x00 0x01 0x00 0x00 0x62 0x01 0x00 0x00 0x01 0x00 0x00 0x63 0x01 0x00 0x00 0x01 0x00 0x00 0x64 0x01 0x00 0x00 0x01 0x00 0x00 0x65 0x01 0x00 0x00 0x01 0x00 0x00 0x66 0x01 0x00 0x00 0x01 0x00 0x00 0x67 0x01 0x00 0x00 0x01 0x00 0x00 0x68 0x01 0x00 0x00 0x01 0x00 0x00 0x69 0x01 0x00 0x00 0x01 0x00 0x00 0x6a 0x01 0x00 0x00 0x01 0x00 0x00 0x6b 0x00 0x00 0x00 0x01 0x01 0x00 0x6c 0x00 0x00 0x00 0x01 0x00 0x00 0x6d 0x00 0x00 0x00 0x01 0x00 0x00 0x6e 0x01 0x00 0x00 0x01 0x01 0x01 0x6f 0x01 0x00 0x00 0x01 0x01 0x01 0x70 0x01 0x00 0x00 0x01 0x01 0x01 0x71 0x01 0x00 0x00 0x01 0x01 0x01 0x72 0x00 0x01 0x00 0x00 0x00 0x00 0x73 0x00 0x01 0x00 0x00 0x00 0x00 0x74 0x01 0x01 0x00 0x00 0x00 0x00 0x75 0x01 0x01 0x00 0x00 0x00 0x00 0x76 0x00 0x01 0x00 0x00 0x00 0x00 0x77 0x00 0x01 0x00 0x00 0x00 0x00 0x78 0x01 0x01 0x00 0x00 0x00 0x00 0x79 0x01 0x01 0x00 0x00 0x00 0x00 0x7a 0x00 0x01 0x01 0x00 0x00 0x00 0x7b 0x00 0x01 0x00 0x00 0x00 0x00 0x7c 0x00 0x01 0x00 0x00 0x00 0x00 0x7d 0x00 0x01 0x00 0x00 0x00 0x00 0x7e 0x00 0x01 0x00 0x01 0x00 0x01 0x7f 0x00 0x01 0x00 0x00 0x00 0x00 0x80 0x01 0x00 0x00 0x01 0x01 0x01 0x81 0x01 0x01 0x00 0x00 0x00 0x01 0x82 0x01 0x01 0x00 0x00 0x00 0x01 0x83 0x01 0x01 0x00 0x00 0x00 0x01 0x84 0x01 0x01 0x00 0x00 0x00 0x01 0x85 0x01 0x00 0x00 0x01 0x01 0x01 0x86 0x01 0x01 0x00 0x00 0x00 0x01 0x87 0x01 0x00 0x00 0x01 0x01 0x01 0x88 0x01 0x00 0x00 0x01 0x01 0x01 0x89 0x01 0x00 0x00 0x01 0x01 0x01 0x8a 0x01 0x00 0x00 0x01 0x01 0x01 0x8b 0x01 0x00 0x00 0x01 0x01 0x01 0x8c 0x01 0x00 0x00 0x01 0x01 0x01 0x8d 0x01 0x00 0x00 0x01 0x01 0x01 0x8e 0x01 0x01 0x00 0x00 0x00 0x00 0x8f 0x01 0x01 0x00 0x00 0x00 0x01 0x90 0x01 0x01 0x00 0x00 0x00 0x01 0x91 0x01 0x01 0x00 0x00 0x00 0x01 0x92 0x01 0x00 0x00 0x01 0x00 0x01 0x93 0x00 0x00 0x00 0x01 0x00 0x01 0x94 0x00 0x00 0x00 0x01 0x00 0x01 0x95 0x00 0x00 0x00 0x01 0x00 0x01 0x96 0x00 0x00 0x00 0x01 0x00 0x00 0x97 0x00 0x00 0x00 0x01 0x00 0x01 0x98 0x00 0x00 0x00 0x01 0x00 0x01 0x99 0x00 0x00 0x00 0x01 0x00 0x00 0x9a 0x00 0x00 0x00 0x01 0x00 0x00 0x9b 0x00 0x01 0x00 0x00 0x00 0x00 0x9c 0x00 0x01 0x00 0x00 0x00 0x00 0x9d 0x00 0x01 0x00 0x00 0x00 0x00 0x9e 0x00 0x01 0x00 0x00 0x00 0x00 0x9f 0x00 0x01 0x00 0x00 0x00 0x00 0xa0 0x00 0x01 0x00 0x00 0x00 0x00 0xa1 0x00 0x01 0x00 0x00 0x00 0x00 0xa2 0x00 0x01 0x00 0x00 0x00 0x00 0xa3 0x00 0x01 0x00 0x00 0x00 0x00 0xa4 0x00 0x01 0x00 0x00 0x00 0x00 0xa5 0x00 0x00 0x00 0x01 0x00 0x00 0xa6 0x00 0x00 0x00 0x01 0x00 0x00 0xb3 0x01 0x00 0x00 0x01 0x00 0x00 0xb4 0x01 0x00 0x00 0x01 0x00 0x00 0xb5 0x01 0x01 0x00 0x00 0x00 0x00 0xb6 0x01 0x01 0x00 0x00 0x00 0x00 0xb7 0x01 0x01 0x00 0x00 0x00 0x00 0xb8 0x01 0x00 0x00 0x01 0x00 0x00 0xb9 0x01 0x01 0x00 0x00 0x00 0x00 0xba 0x01 0x00 0x00 0x01 0x00 0x00 0xbb 0x01 0x01 0x00 0x00 0x00 0x00 0xbc 0x01 0x00 0x00 0x01 0x00 0x01 0xbd 0x01 0x01 0x00 0x00 0x00 0x01 0xbe 0x01 0x01 0x00 0x00 0x00 0x01 0xbf 0x01 0x01 0x00 0x00 0x00 0x01 0xc0 0x01 0x01 0x00 0x00 0x00 0x01 0xc1 0x01 0x00 0x00 0x01 0x00 0x01 0xc2 0x01 0x00 0x00 0x01 0x00 0x01 0xc3 0x00 0x01 0x00 0x01 0x00 0x01 0xc4 0x01 0x01 0x00 0x00 0x00 0x00 0xc5 0x00 0x01 0x00 0x00 0x00 0x00 0xc6 0x01 0x00 0x00 0x01 0x01 0x01 0xc7 0x01 0x00 0x00 0x01 0x01 0x01 0xc8 0x00 0x01 0x00 0x01 0x00 0x00 0xc9 0x00 0x01 0x00 0x01 0x00 0x00 0xca 0x00 0x00 0x00 0x01 0x00 0x00 0xcb 0x00 0x00 0x00 0x01 0x00 0x00 0xcc 0x00 0x00 0x00 0x01 0x00 0x00 0xcd 0x00 0x00 0x00 0x01 0x00 0x00 0xce 0x00 0x00 0x00 0x01 0x00 0x00 0xcf 0x00 0x00 0x00 0x01 0x00 0x00 0xd0 0x00 0x00 0x00 0x01 0x00 0x00 0xd1 0x00 0x00 0x00 0x01 0x00 0x00 0xd2 0x00 0x00 0x00 0x01 0x00 0x00>;
		};
	};

	fragment@72 {
		target = <0xffffffff>;

		__overlay__ {
			interrupt-parent = <0xffffffff>;
			interrupts = <0x00 0x08 0x00 0x00>;
			deb-gpios = <0xffffffff 0x00 0x00>;
			debounce = <0x7d000>;
			status = "okay";
		};
	};

	fragment@73 {
		target = <0xffffffff>;

		__overlay__ {
			interrupt-parent = <0xffffffff>;
			interrupts = <0x01 0x02 0x01 0x00>;
			status = "okay";
		};
	};

	fragment@74 {
		target = <0xffffffff>;

		__overlay__ {
			interrupt-parent = <0xffffffff>;
			interrupts = <0x05 0x04 0x05 0x00>;
			status = "okay";
		};
	};

	fragment@75 {
		target = <0xffffffff>;

		__overlay__ {
			interrupt-parent = <0xffffffff>;
			interrupts = <0x07 0x02 0x07 0x00>;
			status = "okay";
		};
	};

	fragment@76 {
		target = <0xffffffff>;

		__overlay__ {
			interrupt-parent = <0xffffffff>;
			interrupts = <0x08 0x08 0x08 0x00>;
			status = "okay";
		};
	};

	fragment@77 {
		target = <0xffffffff>;

		__overlay__ {
			interrupt-parent = <0xffffffff>;
			interrupts = <0x10 0x02 0x10 0x00>;
			status = "okay";
		};
	};

	fragment@78 {
		target = <0xffffffff>;

		__overlay__ {
			interrupt-parent = <0xffffffff>;
			interrupts = <0x2b 0x01 0x2b 0x01>;
			status = "okay";
		};
	};

	fragment@79 {
		target = <0xffffffff>;

		__overlay__ {
			interrupt-parent = <0xffffffff>;
			interrupts = <0x45 0x08 0x45 0x00>;
			status = "okay";
		};
	};

	fragment@80 {
		target = <0xffffffff>;

		__overlay__ {
			interrupt-parent = <0xffffffff>;
			interrupts = <0x4b 0x02 0x4b 0x01>;
			status = "okay";
		};
	};

	fragment@81 {
		target = <0xffffffff>;

		__overlay__ {
			interrupt-parent = <0xffffffff>;
			interrupts = <0x6b 0x04 0x6b 0x00>;
			deb-gpios = <0xffffffff 0x6b 0x00>;
			debounce = <0x7d000>;
			status = "okay";
		};
	};

	fragment@82 {
		target = <0xffffffff>;

		__overlay__ {
			interrupt-parent = <0xffffffff>;
			interrupts = <0xc1 0x04 0xd1 0x00>;
			status = "okay";
		};
	};

	fragment@83 {
		target = <0xffffffff>;

		__overlay__ {
			compatible = "mediatek,md1_sim1_hot_plug_eint-eint";
			interrupts = <0x00 0x08>;
			debounce = <0x00 0xc350>;
			dedicated = <0x00 0x00>;
			src_pin = <0x00 0x01>;
			sockettype = <0x00 0x00>;
			status = "okay";
		};
	};

	fragment@84 {
		target = <0xffffffff>;

		__overlay__ {
			compatible = "mediatek,md1_sim2_hot_plug_eint-eint";
			interrupts = <0x01 0x08>;
			debounce = <0x01 0xc350>;
			dedicated = <0x01 0x00>;
			src_pin = <0x01 0x02>;
			sockettype = <0x01 0x00>;
			status = "okay";
		};
	};

	fragment@85 {
		target = <0xffffffff>;

		__overlay__ {
			regulator-name = "vcamio";
			regulator-default-on = <0x01>;
			status = "okay";
		};
	};

	fragment@86 {
		target = <0xffffffff>;

		__overlay__ {
			vcamio-supply = <0xffffffff>;
			vcamio_sub-supply = <0xffffffff>;
			vcamio_main2-supply = <0xffffffff>;
			vcamaf-supply = <0xffffffff>;
			vcamaf_main2-supply = <0xffffffff>;
			status = "okay";
		};
	};

	fragment@87 {
		target = <0xffffffff>;

		__overlay__ {
			vtouch-supply = <0x01>;
			status = "okay";
		};
	};

	fragment@88 {
		target = <0xffffffff>;

		__overlay__ {
			mediatek,kpd-key-debounce = <0x400>;
			mediatek,kpd-sw-pwrkey = <0x74>;
			mediatek,kpd-hw-pwrkey = <0x08>;
			mediatek,kpd-sw-rstkey = <0x73>;
			mediatek,kpd-hw-rstkey = <0x11>;
			mediatek,kpd-use-extend-type = <0x00>;
			mediatek,kpd-hw-map-num = <0x48>;
			mediatek,kpd-hw-init-map = <0x00 0x72 0x00 0x00 0x00 0x00 0x00 0x00 0x00 0x00 0x00 0x00 0x00 0x00 0x00 0x00 0x00 0x00 0x00 0x00 0x00 0x00 0x00 0x00 0x00 0x00 0x00 0x00 0x00 0x00 0x00 0x00 0x00 0x00 0x00 0x00 0x00 0x00 0x00 0x00 0x00 0x00 0x00 0x00 0x00 0x00 0x00 0x00 0x00 0x00 0x00 0x00 0x00 0x00 0x00 0x00 0x00 0x00 0x00 0x00 0x00 0x00 0x00 0x00 0x00 0x00 0x00 0x00 0x00 0x00 0x00 0x00>;
			mediatek,kpd-pwrkey-eint-gpio = <0x00>;
			mediatek,kpd-pwkey-gpio-din = <0x00>;
			mediatek,kpd-hw-dl-key0 = <0x11>;
			mediatek,kpd-hw-dl-key1 = <0x01>;
			mediatek,kpd-hw-recovery-key = <0x01>;
			mediatek,kpd-hw-factory-key = <0x11>;
			status = "okay";
		};
	};

	__symbols__ {
		ctp_pins_default = "/fragment@5/__overlay__/eintdefault";
		ctp_ts_int_active = "/fragment@5/__overlay__/int_active";
		ctp_ts_reset_active = "/fragment@5/__overlay__/reset_active";
		ctp_ts_int_suspend = "/fragment@5/__overlay__/int_suspend";
		ctp_ts_reset_suspend = "/fragment@5/__overlay__/reset_suspend";
		led0 = "/fragment@6/__overlay__/led@0";
		led1 = "/fragment@6/__overlay__/led@1";
		led2 = "/fragment@6/__overlay__/led@2";
		led3 = "/fragment@6/__overlay__/led@3";
		led4 = "/fragment@6/__overlay__/led@4";
		led5 = "/fragment@6/__overlay__/led@5";
		led6 = "/fragment@6/__overlay__/led@6";
		vibrator0 = "/fragment@6/__overlay__/vibrator@0";
		usb_c_pinctrl = "/fragment@6/__overlay__/usb_c_pinctrl";
		kpd_volume_down = "/fragment@6/__overlay__/kpd_volume_down";
		gsensor_1 = "/fragment@6/__overlay__/gsensor_1";
		gsensor_2 = "/fragment@6/__overlay__/gsensor_2";
		msensor_1 = "/fragment@6/__overlay__/msensor_1";
		msensor_2 = "/fragment@6/__overlay__/msensor_2";
		proximity_1 = "/fragment@6/__overlay__/proximity_1";
		proximity_2 = "/fragment@6/__overlay__/proximity_2";
		light_1 = "/fragment@6/__overlay__/light_1";
		light_2 = "/fragment@6/__overlay__/light_2";
		alsps_arch = "/fragment@6/__overlay__/alsps_arch";
		cali_arch = "/fragment@6/__overlay__/cali_arch";
		oplus_project = "/fragment@6/__overlay__/oplus_project";
		oplus_devinfo = "/fragment@6/__overlay__/oplus_devinfo";
		nfc_chipset = "/fragment@6/__overlay__/nfc_chipset";
		hw_pins_default = "/fragment@7/__overlay__/default@hw_sub_id";
		aboard_pin_gpio0_sleep = "/fragment@7/__overlay__/sleep@id0";
		aboard_pin_gpio0_active = "/fragment@7/__overlay__/active@id0";
		mtkfb_pins_lcd_bias_enp1 = "/fragment@8/__overlay__/lcd_bias_enp1_gpio";
		mtkfb_pins_lcd_bias_enp0 = "/fragment@8/__overlay__/lcd_bias_enp0_gpio";
		mtkfb_pins_lcd_bias_enn1 = "/fragment@8/__overlay__/lcd_bias_enn1_gpio";
		mtkfb_pins_lcd_bias_enn0 = "/fragment@8/__overlay__/lcd_bias_enn0_gpio";
		mtkfb_pins_lcm_rst_out1_gpio = "/fragment@8/__overlay__/lcm_rst_out1_gpio";
		mtkfb_pins_lcm_rst_out0_gpio = "/fragment@8/__overlay__/lcm_rst_out0_gpio";
		mtkfb_pins_lcm_dsi_te = "/fragment@8/__overlay__/lcm_dsi_te";
		mtkfb_pins_lcm_dsi_te_bk = "/fragment@8/__overlay__/lcm_dsi_te_bk";
		mt_pmic_vtp_ldo_reg = "/fragment@10/__overlay__/ldo2";
		panel_in = "/fragment@15/__overlay__/panel@0/port/endpoint";
		dsi_out = "/fragment@15/__overlay__/ports/port/endpoint";
		aw882xx_evt1 = "/fragment@18/__overlay__/aw882xx_evt1@35";
		aw882xx = "/fragment@18/__overlay__/aw882xx@34";
		usb_default = "/fragment@24/__overlay__/usb_default";
		gpio_redriver_c1_init = "/fragment@24/__overlay__/c1_init";
		gpio_redriver_c1_low = "/fragment@24/__overlay__/c1_low";
		gpio_redriver_c1_hiz = "/fragment@24/__overlay__/c1_highz";
		gpio_redriver_c1_high = "/fragment@24/__overlay__/c1_high";
		gpio_redriver_c2_init = "/fragment@24/__overlay__/c2_init";
		gpio_redriver_c2_low = "/fragment@24/__overlay__/c2_low";
		gpio_redriver_c2_hiz = "/fragment@24/__overlay__/c2_highz";
		gpio_redriver_c2_high = "/fragment@24/__overlay__/c2_high";
		gpio_u3_switch_sel1 = "/fragment@24/__overlay__/u3_sw_sel1";
		gpio_u3_switch_sel2 = "/fragment@24/__overlay__/u3_sw_sel2";
		gpio_u3_switch_enable = "/fragment@24/__overlay__/u3_sw_en";
		gpio_u3_switch_disable = "/fragment@24/__overlay__/u3_sw_dis";
		volume_up_gpio_eint = "/fragment@26/__overlay__/volume_up@0";
		volume_down_gpio_eint = "/fragment@26/__overlay__/volume_down@0";
		consys_pins_default = "/fragment@27/__overlay__/consys_default";
		gpslna_pins_init = "/fragment@27/__overlay__/gpslna@0";
		gpslna_pins_oh = "/fragment@27/__overlay__/gpslna@1";
		gpslna_pins_ol = "/fragment@27/__overlay__/gpslna@2";
		gpio_id0_default = "/fragment@30/__overlay__/gpio_id0_default";
		jiiov_fp_reset_output_low = "/fragment@32/__overlay__/jiiov_fp_reset_output_low";
		jiiov_fp_gpio_clk = "/fragment@32/__overlay__/jiiov_fp_gpio_clk";
		jiiov_fp_gpio_mosi = "/fragment@32/__overlay__/jiiov_fp_gpio_mosi";
		jiiov_fp_gpio_miso = "/fragment@32/__overlay__/jiiov_fp_gpio_miso";
		jiiov_fp_gpio_cs = "/fragment@32/__overlay__/jiiov_fp_gpio_cs";
		jiiov_fp_irq_active = "/fragment@32/__overlay__/jiiov_fp_irq_active";
		oplus_fp = "/fragment@34/__overlay__/fingerprint@0";
		gpio_goodix_reset_default = "/fragment@35/__overlay__/gpio_goodix_reset_default";
		gpio_goodix_irq_default = "/fragment@35/__overlay__/gpio_goodix_irq_default";
		gpio_goodix_clk_6mA = "/fragment@35/__overlay__/gpio_goodix_clk_6mA";
		gpio_goodix_mosi_6mA = "/fragment@35/__overlay__/gpio_goodix_mosi_6mA";
		gpio_goodix_miso_6mA = "/fragment@35/__overlay__/gpio_goodix_miso_6mA";
		gpio_goodix_cs_6mA = "/fragment@35/__overlay__/gpio_goodix_cs_6mA";
		gpio_goodix_cs_func = "/fragment@35/__overlay__/gpio_goodix_cs_func";
		vooc_ap_data = "/fragment@36/__overlay__/vooc_ap_data";
		vooc_ap_data_new_function = "/fragment@36/__overlay__/vooc_ap_data_new_function";
		uart0_rx_gpio_input = "/fragment@41/__overlay__/uart0_rx_gpio@gpio53";
		uart0_tx_gpio_input = "/fragment@41/__overlay__/uart0_tx_gpio@gpio54";
		charger_pins_default = "/fragment@44/__overlay__/eint0default";
		charger_pins_eint_output0 = "/fragment@44/__overlay__/charger_gpio_as_output_low";
		charger_pins_eint_output1 = "/fragment@44/__overlay__/charger_gpio_as_output_high";
		ship_sleep_gpio = "/fragment@44/__overlay__/ship_sleep";
		ship_active_gpio = "/fragment@44/__overlay__/ship_active";
		dischg_enable = "/fragment@44/__overlay__/dischg_enable";
		dischg_disable = "/fragment@44/__overlay__/dischg_disable";
		charging_switch1_ctr1_active = "/fragment@45/__overlay__/charging_switch1_ctr1_active";
		charging_switch1_ctr1_sleep = "/fragment@45/__overlay__/charging_switch1_ctr1_sleep";
		charging_switch1_active = "/fragment@45/__overlay__/charging_switch1_active";
		charging_switch1_sleep = "/fragment@45/__overlay__/charging_switch1_sleep";
		charging_clock_active = "/fragment@45/__overlay__/charging_clock_active";
		charging_clock_sleep = "/fragment@45/__overlay__/charging_clock_sleep";
		charging_data_active = "/fragment@45/__overlay__/charging_data_active";
		charging_data_sleep = "/fragment@45/__overlay__/charging_data_sleep";
		charging_reset_active = "/fragment@45/__overlay__/charging_reset_active";
		charging_reset_sleep = "/fragment@45/__overlay__/charging_reset_sleep";
		vooc_asic_id_active = "/fragment@45/__overlay__/vooc_asic_id_active";
		vooc_asic_id_sleep = "/fragment@45/__overlay__/vooc_asic_id_sleep";
		i2c7_sda_state = "/fragment@47/__overlay__/i2c7_sda_i2c_state";
		i2c7_sda_output_low_state = "/fragment@47/__overlay__/i2c7_sda_output_low_state";
		i2c7_scl_state = "/fragment@47/__overlay__/i2c7_scl_i2c_state";
		i2c7_scl_output_low_state = "/fragment@47/__overlay__/i2c7_scl_output_low_state";
		camera0_rst_low = "/fragment@49/__overlay__/camera0_rst_output_low@gpio124";
		camera0_rst_high = "/fragment@49/__overlay__/camera0_rst_output_high@gpio124";
		camera0_vcamd_off = "/fragment@49/__overlay__/camera0_vcamd_output_low@gpio123";
		camera0_vcamd_on = "/fragment@49/__overlay__/camera0_vcamd_output_high@gpio123";
		camera1_rst_low = "/fragment@49/__overlay__/camera1_rst_output_low@gpio197";
		camera1_rst_high = "/fragment@49/__overlay__/camera1_rst_output_high@gpio197";
		camera2_rst_low = "/fragment@49/__overlay__/camera2_rst_output_low@gpio119";
		camera2_rst_high = "/fragment@49/__overlay__/camera2_rst_output_high@gpio119";
		camera3_pnd_low = "/fragment@49/__overlay__/camera3_pnd_output_low@gpio125";
		camera3_pnd_high = "/fragment@49/__overlay__/camera3_pnd_output_high@gpio125";
		camera4_pnd_low = "/fragment@49/__overlay__/camera4_pnd_output_low@gpio118";
		camera4_pnd_high = "/fragment@49/__overlay__/camera4_pnd_output_high@gpio118";
		camera0_mclk_off = "/fragment@49/__overlay__/camera0_mclk_gpio_mode@gpio120";
		camera0_mclk_2ma = "/fragment@49/__overlay__/camera0_mclk_2ma@gpio120";
		camera0_mclk_4ma = "/fragment@49/__overlay__/camera0_mclk_4ma@gpio120";
		camera0_mclk_6ma = "/fragment@49/__overlay__/camera0_mclk_6ma@gpio120";
		camera0_mclk_8ma = "/fragment@49/__overlay__/camera0_mclk_8ma@gpio120";
		camera1_mclk_off = "/fragment@49/__overlay__/camera1_mclk_gpio_mode@gpio196";
		camera1_mclk_2ma = "/fragment@49/__overlay__/camera1_mclk_2ma@gpio196";
		camera1_mclk_4ma = "/fragment@49/__overlay__/camera1_mclk_4ma@gpio196";
		camera1_mclk_6ma = "/fragment@49/__overlay__/camera1_mclk_6ma@gpio196";
		camera1_mclk_8ma = "/fragment@49/__overlay__/camera1_mclk_8ma@gpio196";
		camera2_mclk_off = "/fragment@49/__overlay__/camera2_mclk_gpio_mode@gpio117";
		camera2_mclk_2ma = "/fragment@49/__overlay__/camera2_mclk_2ma@gpio117";
		camera2_mclk_4ma = "/fragment@49/__overlay__/camera2_mclk_4ma@gpio117";
		camera2_mclk_6ma = "/fragment@49/__overlay__/camera2_mclk_6ma@gpio117";
		camera2_mclk_8ma = "/fragment@49/__overlay__/camera2_mclk_8ma@gpio117";
		camera3_mclk_off = "/fragment@49/__overlay__/camera3_mclk_gpio_mode@gpio121";
		camera3_mclk_2ma = "/fragment@49/__overlay__/camera3_mclk_2ma@gpio121";
		camera3_mclk_4ma = "/fragment@49/__overlay__/camera3_mclk_4ma@gpio121";
		camera3_mclk_6ma = "/fragment@49/__overlay__/camera3_mclk_6ma@gpio121";
		camera3_mclk_8ma = "/fragment@49/__overlay__/camera3_mclk_8ma@gpio121";
		camera4_mclk_off = "/fragment@49/__overlay__/camera4_mclk_gpio_mode@gpio116";
		camera4_mclk_2ma = "/fragment@49/__overlay__/camera4_mclk_2ma@gpio116";
		camera4_mclk_4ma = "/fragment@49/__overlay__/camera4_mclk_4ma@gpio116";
		camera4_mclk_6ma = "/fragment@49/__overlay__/camera4_mclk_6ma@gpio116";
		camera4_mclk_8ma = "/fragment@49/__overlay__/camera4_mclk_8ma@gpio116";
		camera_mipi_switch_low = "/fragment@49/__overlay__/camera_mipi_switch_low@gpio72";
		camera_mipi_switch_high = "/fragment@49/__overlay__/camera_mipi_switch_high@gpio72";
		fan53870_gpio_enable = "/fragment@49/__overlay__/fan53870_gpio_enable@gpio122";
		fan53870_gpio_disable = "/fragment@49/__overlay__/fan53870_gpio_disable@gpi122";
		camera_pins_default = "/fragment@49/__overlay__/camdefault";
		camera_main_mtk = "/fragment@62/__overlay__/camera_main@1a";
		camera_main_af_mtk = "/fragment@62/__overlay__/camera_main_af@0c";
		camera_main_eeprom_mtk = "/fragment@62/__overlay__/camera_main_eeprom@50";
		ccu_sensor_i2c_2_hw_mtk = "/fragment@62/__overlay__/ccu_sensor_i2c_2_hw@33";
		nfc_mtk = "/fragment@63/__overlay__/nfc@08";
		camera_sub_mtk = "/fragment@64/__overlay__/camera_sub@2d";
		camera_sub_eeprom_mtk = "/fragment@64/__overlay__/camera_sub_eeprom@52";
		camera_main_two_mtk = "/fragment@64/__overlay__/camera_main_two@10";
		camera_main_two_af_mtk = "/fragment@64/__overlay__/camera_main_two_af@0c";
		camera_main_two_eeprom_mtk = "/fragment@64/__overlay__/camera_main_two_eeprom@50";
		ccu_sensor_i2c_4_hw_mtk = "/fragment@64/__overlay__/ccu_sensor_i2c_4_hw@36";
		subpmic_mtk = "/fragment@65/__overlay__/subpmic@34";
		usb_type_c_mtk = "/fragment@65/__overlay__/usb_type_c@4e";
		subpmic_pmic_mtk = "/fragment@65/__overlay__/subpmic_pmic@1a";
		subpmic_ldo_mtk = "/fragment@65/__overlay__/subpmic_ldo@64";
		i2c_lcd_bias_mtk = "/fragment@66/__overlay__/i2c_lcd_bias@73";
		fan53870_mtk = "/fragment@66/__overlay__/fan53870@35";
		ccu_sensor_i2c_7_hw_mtk = "/fragment@67/__overlay__/ccu_sensor_i2c_7_hw@43";
		vproc_buck_mtk = "/fragment@69/__overlay__/vproc_buck@6b";
	};

	__fixups__ {
		reserved_memory = "/fragment@0:target:0";
		chosen = "/fragment@1:target:0";
		spi3 = "/fragment@2:target:0";
		pio = "/fragment@2/__overlay__/novatek@0:reset-gpio:0\0/fragment@2/__overlay__/novatek@0:interrupt-parent:0\0/fragment@2/__overlay__/novatek@0:irq-gpio:0\0/fragment@4/__overlay__/focaltech@38:irq-gpio:0\0/fragment@4/__overlay__/focaltech@38:reset-gpio:0\0/fragment@4/__overlay__/goodix@5d:irq-gpio:0\0/fragment@4/__overlay__/goodix@5d:reset-gpio:0\0/fragment@5:target:0\0/fragment@6/__overlay__/kpd_volume_down:interrupt-parent:0\0/fragment@6/__overlay__/oplus_sim_detect:Hw,sim_det:0\0/fragment@6/__overlay__/oplus_devinfo:aboard-gpio0:0\0/fragment@7:target:0\0/fragment@8:target:0\0/fragment@12/__overlay__:interrupt-parent:0\0/fragment@15/__overlay__/panel@0:pm-enable-gpios:0\0/fragment@15/__overlay__/panel@0:reset-gpios:0\0/fragment@15/__overlay__/panel@0:bias-gpios:0\0/fragment@15/__overlay__/panel@0:bias-gpios:12\0/fragment@18/__overlay__/aw882xx_evt1@35:reset-gpio:0\0/fragment@18/__overlay__/aw882xx@34:reset-gpio:0\0/fragment@20/__overlay__/nfc_nxp@28:nxp,pn544-irq:0\0/fragment@20/__overlay__/nfc_nxp@28:nxp,pn544-ven:0\0/fragment@20/__overlay__/nfc_nxp@28:nxp,pn544-fw-dwnld:0\0/fragment@20/__overlay__/nfc_nxp@28:interrupt-parent:0\0/fragment@21/__overlay__:mt6360,intr_gpio:0\0/fragment@23/__overlay__:mt6360pd,intr_gpio:0\0/fragment@24:target:0\0/fragment@25/__overlay__:keypad,volume-up:0\0/fragment@25/__overlay__:keypad,volume-down:0\0/fragment@26:target:0\0/fragment@27:target:0\0/fragment@29/__overlay__:oplus,fp_gpio_0:0\0/fragment@30:target:0\0/fragment@31/__overlay__:anc,gpio_irq:0\0/fragment@31/__overlay__:anc,gpio_rst:0\0/fragment@32:target:0\0/fragment@33/__overlay__:goodix,gpio_irq:0\0/fragment@33/__overlay__:goodix,gpio_reset:0\0/fragment@33/__overlay__:goodix,gpio_cs:0\0/fragment@35:target:0\0/fragment@37/__overlay__/fan53870@20:fan53870,gpio_rst:0\0/fragment@41:target:0\0/fragment@42/__overlay__:qcom,chargerid_switch-gpio:0\0/fragment@42/__overlay__:qcom,ship-gpio:0\0/fragment@42/__overlay__:qcom,dischg-gpio:0\0/fragment@43/__overlay__/rt5125-fastcg@0e:qcom,charging_switch1-gpio:0\0/fragment@43/__overlay__/rt5125-fastcg@0e:qcom,charging_reset-gpio:0\0/fragment@43/__overlay__/rt5125-fastcg@0e:qcom,charging_clock-gpio:0\0/fragment@43/__overlay__/rt5125-fastcg@0e:qcom,charging_data-gpio:0\0/fragment@43/__overlay__/rt5125-fastcg@0e:qcom,vooc_asic_id-gpio:0\0/fragment@44:target:0\0/fragment@45:target:0\0/fragment@47:target:0\0/fragment@48/__overlay__/fan53870@35:fan53870,gpio_rst:0\0/fragment@49:target:0\0/fragment@70/__overlay__:GPIO_FDD_BAND_SUPPORT_DETECT_4TH_PIN:0\0/fragment@70/__overlay__:GPIO_FDD_BAND_SUPPORT_DETECT_3RD_PIN:0\0/fragment@70/__overlay__:GPIO_FDD_BAND_SUPPORT_DETECT_1ST_PIN:0\0/fragment@70/__overlay__:GPIO_FDD_BAND_SUPPORT_DETECT_2ND_PIN:0\0/fragment@70/__overlay__:GPIO_SIM1_SIO:0\0/fragment@70/__overlay__:GPIO_SIM1_SRST:0\0/fragment@70/__overlay__:GPIO_SIM1_SCLK:0\0/fragment@70/__overlay__:GPIO_SIM2_SCLK:0\0/fragment@70/__overlay__:GPIO_SIM2_SRST:0\0/fragment@70/__overlay__:GPIO_SIM2_SIO:0\0/fragment@70/__overlay__:GPIO_SIM1_HOT_PLUG:0\0/fragment@70/__overlay__:GPIO_SIM2_HOT_PLUG:0\0/fragment@72/__overlay__:interrupt-parent:0\0/fragment@72/__overlay__:deb-gpios:0\0/fragment@73/__overlay__:interrupt-parent:0\0/fragment@74/__overlay__:interrupt-parent:0\0/fragment@75/__overlay__:interrupt-parent:0\0/fragment@76/__overlay__:interrupt-parent:0\0/fragment@77/__overlay__:interrupt-parent:0\0/fragment@78/__overlay__:interrupt-parent:0\0/fragment@79/__overlay__:interrupt-parent:0\0/fragment@80/__overlay__:interrupt-parent:0\0/fragment@81/__overlay__:interrupt-parent:0\0/fragment@81/__overlay__:deb-gpios:0\0/fragment@82/__overlay__:interrupt-parent:0";
		i2c2 = "/fragment@3:target:0\0/fragment@62:target:0";
		i2c0 = "/fragment@4:target:0\0/fragment@60:target:0";
		odm = "/fragment@6:target:0\0/fragment@36:target:0\0/fragment@39:target:0";
		camera_af_hw_node = "/fragment@9:target:0";
		mt_pmic_vcamio_ldo_reg = "/fragment@9/__overlay__:vcamaf-supply:0\0/fragment@50/__overlay__:cam0_vcamio-supply:0\0/fragment@50/__overlay__:cam1_vcamio-supply:0\0/fragment@50/__overlay__:cam2_vcamio-supply:0\0/fragment@50/__overlay__:cam3_vcamio-supply:0\0/fragment@50/__overlay__:cam4_vcamio-supply:0\0/fragment@85:target:0\0/fragment@86/__overlay__:vcamio-supply:0\0/fragment@86/__overlay__:vcamio_sub-supply:0\0/fragment@86/__overlay__:vcamio_main2-supply:0\0/fragment@86/__overlay__:vcamaf-supply:0\0/fragment@86/__overlay__:vcamaf_main2-supply:0";
		mt6360_ldo = "/fragment@10:target:0\0/fragment@11:target:0";
		dsi_te = "/fragment@12:target:0\0/fragment@78:target:0";
		mtkfb = "/fragment@13:target:0";
		dispsys_config = "/fragment@14:target:0";
		dsi0 = "/fragment@15:target:0";
		accdet = "/fragment@16:target:0";
		snd_audio_dsp = "/fragment@17:target:0";
		i2c6 = "/fragment@18:target:0\0/fragment@37:target:0\0/fragment@48:target:0\0/fragment@66:target:0";
		speaker_amp = "/fragment@19:target:0";
		i2c3 = "/fragment@20:target:0\0/fragment@63:target:0";
		mt6360_pmu = "/fragment@21:target:0";
		mt6360_pmic = "/fragment@22:target:0";
		mt6360_typec = "/fragment@23:target:0";
		keypad = "/fragment@25:target:0\0/fragment@88:target:0";
		consys = "/fragment@28:target:0";
		oplus_fp_common = "/fragment@29:target:0";
		jiiov_fp = "/fragment@31:target:0";
		goodix_fp = "/fragment@33:target:0\0/fragment@80:target:0";
		spi0 = "/fragment@34:target:0";
		lk_charger = "/fragment@38:target:0";
		apuart0 = "/fragment@40:target:0";
		charger = "/fragment@42:target:0";
		auxadc = "/fragment@42/__overlay__:io-channels:0\0/fragment@42/__overlay__:io-channels:8\0/fragment@42/__overlay__:io-channels:16\0/fragment@57:target:0\0/fragment@58/__overlay__:io-channels:0";
		i2c7 = "/fragment@43:target:0\0/fragment@46:target:0\0/fragment@67:target:0";
		kd_camera_hw1 = "/fragment@50:target:0\0/fragment@86:target:0";
		audio_extend = "/fragment@51:target:0";
		sound = "/fragment@52:target:0";
		aud_gpio_i2s0_off = "/fragment@53:target:0";
		aud_gpio_i2s0_on = "/fragment@54:target:0";
		aud_gpio_i2s3_off = "/fragment@55:target:0";
		aud_gpio_i2s3_on = "/fragment@56:target:0";
		md_auxadc = "/fragment@58:target:0";
		pmic_clock_buffer_ctrl = "/fragment@59:target:0";
		i2c1 = "/fragment@61:target:0";
		i2c4 = "/fragment@64:target:0";
		i2c5 = "/fragment@65:target:0";
		i2c8 = "/fragment@68:target:0";
		i2c9 = "/fragment@69:target:0";
		gpio_usage_mapping = "/fragment@70:target:0";
		gpio = "/fragment@71:target:0";
		mrdump_ext_rst = "/fragment@72:target:0";
		touch = "/fragment@73:target:0\0/fragment@87:target:0";
		irq_nfc = "/fragment@74:target:0";
		tcpc_pd = "/fragment@75:target:0";
		msdc1_ins = "/fragment@76:target:0";
		subpmic_pmu_eint = "/fragment@77:target:0";
		smart_pa = "/fragment@79:target:0";
		swtp = "/fragment@81:target:0";
		main_pmic = "/fragment@82:target:0";
		md1_sim1_hot_plug_eint = "/fragment@83:target:0";
		md1_sim2_hot_plug_eint = "/fragment@84:target:0";
	};

	__local_fixups__ {

		fragment@4 {

			__overlay__ {

				focaltech@38 {
					vdd_2v8-supply = <0x00>;
					pinctrl-0 = <0x00 0x04>;
				};

				goodix@5d {
					vdd_2v8-supply = <0x00>;
					pinctrl-0 = <0x00 0x04>;
				};
			};
		};

		fragment@6 {

			__overlay__ {

				usb_c_pinctrl {
					pinctrl-0 = <0x00>;
					pinctrl-1 = <0x00>;
					pinctrl-2 = <0x00>;
					pinctrl-3 = <0x00>;
					pinctrl-4 = <0x00>;
					pinctrl-5 = <0x00>;
					pinctrl-6 = <0x00>;
					pinctrl-7 = <0x00>;
					pinctrl-8 = <0x00>;
					pinctrl-9 = <0x00>;
					pinctrl-10 = <0x00>;
					pinctrl-11 = <0x00>;
					pinctrl-12 = <0x00>;
				};

				oplus_devinfo {
					pinctrl-0 = <0x00>;
					pinctrl-1 = <0x00>;
					pinctrl-2 = <0x00>;
				};
			};
		};

		fragment@13 {

			__overlay__ {
				pinctrl-0 = <0x00>;
				pinctrl-1 = <0x00>;
				pinctrl-2 = <0x00>;
				pinctrl-3 = <0x00>;
				pinctrl-4 = <0x00>;
				pinctrl-5 = <0x00>;
				pinctrl-6 = <0x00>;
				pinctrl-7 = <0x00>;
			};
		};

		fragment@14 {

			__overlay__ {
				pinctrl-0 = <0x00>;
				pinctrl-1 = <0x00>;
				pinctrl-2 = <0x00>;
			};
		};

		fragment@15 {

			__overlay__ {

				panel@0 {

					port {

						endpoint {
							remote-endpoint = <0x00>;
						};
					};
				};

				ports {

					port {

						endpoint {
							remote-endpoint = <0x00>;
						};
					};
				};
			};
		};

		fragment@25 {

			__overlay__ {
				pinctrl-0 = <0x00>;
				pinctrl-1 = <0x00>;
			};
		};

		fragment@28 {

			__overlay__ {
				pinctrl-0 = <0x00>;
				pinctrl-1 = <0x00>;
				pinctrl-2 = <0x00>;
				pinctrl-3 = <0x00>;
			};
		};

		fragment@29 {

			__overlay__ {
				pinctrl-0 = <0x00>;
			};
		};

		fragment@31 {

			__overlay__ {
				pinctrl-0 = <0x00>;
				pinctrl-1 = <0x00 0x04 0x08 0x0c 0x10>;
				pinctrl-2 = <0x00>;
			};
		};

		fragment@33 {

			__overlay__ {
				pinctrl-0 = <0x00 0x04>;
				pinctrl-1 = <0x00 0x04 0x08 0x0c>;
				pinctrl-2 = <0x00>;
			};
		};

		fragment@40 {

			__overlay__ {
				pinctrl-0 = <0x00>;
				pinctrl-1 = <0x00>;
			};
		};

		fragment@42 {

			__overlay__ {
				pinctrl-0 = <0x00>;
				pinctrl-1 = <0x00>;
				pinctrl-2 = <0x00>;
				pinctrl-3 = <0x00>;
				pinctrl-4 = <0x00>;
				pinctrl-5 = <0x00>;
				pinctrl-6 = <0x00>;
			};
		};

		fragment@43 {

			__overlay__ {

				rt5125-fastcg@0e {
					pinctrl-0 = <0x00>;
					pinctrl-1 = <0x00>;
					pinctrl-2 = <0x00>;
					pinctrl-3 = <0x00>;
					pinctrl-4 = <0x00>;
					pinctrl-5 = <0x00>;
					pinctrl-6 = <0x00>;
					pinctrl-7 = <0x00>;
					pinctrl-8 = <0x00>;
					pinctrl-9 = <0x00>;
					pinctrl-10 = <0x00>;
					pinctrl-11 = <0x00>;
					pinctrl-12 = <0x00>;
					pinctrl-13 = <0x00>;
				};
			};
		};

		fragment@46 {

			__overlay__ {
				pinctrl-0 = <0x00 0x04>;
				pinctrl-1 = <0x00 0x04>;
			};
		};

		fragment@50 {

			__overlay__ {
				pinctrl-0 = <0x00>;
				pinctrl-1 = <0x00>;
				pinctrl-2 = <0x00>;
				pinctrl-3 = <0x00>;
				pinctrl-4 = <0x00>;
				pinctrl-5 = <0x00>;
				pinctrl-6 = <0x00>;
				pinctrl-7 = <0x00>;
				pinctrl-8 = <0x00>;
				pinctrl-9 = <0x00>;
				pinctrl-10 = <0x00>;
				pinctrl-11 = <0x00>;
				pinctrl-12 = <0x00>;
				pinctrl-13 = <0x00>;
				pinctrl-14 = <0x00>;
				pinctrl-15 = <0x00>;
				pinctrl-16 = <0x00>;
				pinctrl-17 = <0x00>;
				pinctrl-18 = <0x00>;
				pinctrl-19 = <0x00>;
				pinctrl-20 = <0x00>;
				pinctrl-21 = <0x00>;
				pinctrl-22 = <0x00>;
				pinctrl-23 = <0x00>;
				pinctrl-24 = <0x00>;
				pinctrl-25 = <0x00>;
				pinctrl-26 = <0x00>;
				pinctrl-27 = <0x00>;
				pinctrl-28 = <0x00>;
				pinctrl-29 = <0x00>;
				pinctrl-30 = <0x00>;
				pinctrl-31 = <0x00>;
				pinctrl-32 = <0x00>;
				pinctrl-33 = <0x00>;
				pinctrl-34 = <0x00>;
				pinctrl-35 = <0x00>;
				pinctrl-36 = <0x00>;
				pinctrl-37 = <0x00>;
				pinctrl-38 = <0x00>;
				pinctrl-39 = <0x00>;
				pinctrl-40 = <0x00>;
				pinctrl-41 = <0x00>;
			};
		};

		fragment@87 {

			__overlay__ {
				vtouch-supply = <0x00>;
			};
		};
	};
};
